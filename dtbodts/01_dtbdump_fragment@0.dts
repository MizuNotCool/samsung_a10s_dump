/dts-v1/;

/ {

	__fixups__ {
		accdet = "/fragment@14:target:0";
		audgpio = "/fragment@23:target:0";
		auxadc = "/fragment@34:target:0";
		bat_gm30 = "/fragment@20:target:0";
		charger = "/fragment@7:target:0";
		chosen = "/fragment@0:target:0";
		consys = "/fragment@13:target:0";
		dsi_te = "/fragment@54:target:0";
		finger_fp = "/fragment@18:target:0";
		firmware = "/fragment@33:target:0";
		flashlights_led191 = "/fragment@31:target:0";
		fpsensor_finger = "/fragment@17:target:0";
		gpio = "/fragment@47:target:0";
		gpio_usage_mapping = "/fragment@46:target:0";
		i2c0 = "/fragment@36:target:0";
		i2c1 = "/fragment@37:target:0";
		i2c2 = "/fragment@38:target:0";
		i2c3 = "/fragment@2:target:0", "/fragment@27:target:0", "/fragment@39:target:0";
		i2c4 = "/fragment@40:target:0";
		i2c5 = "/fragment@4:target:0", "/fragment@41:target:0";
		i2c6 = "/fragment@5:target:0", "/fragment@42:target:0";
		i2c7 = "/fragment@43:target:0";
		i2c8 = "/fragment@44:target:0";
		i2c9 = "/fragment@45:target:0";
		irq_nfc = "/fragment@52:target:0";
		irtx_pwm = "/fragment@21:target:0";
		kd_camera_hw1 = "/fragment@29:target:0";
		keypad = "/fragment@67:target:0";
		lcm = "/fragment@8:target:0";
		lk_charger = "/fragment@6:target:0";
		main_pmic = "/fragment@56:target:0";
		md1_sim1_hot_plug_eint = "/fragment@58:target:0";
		md1_sim2_hot_plug_eint = "/fragment@59:target:0";
		mrdump_ext_rst = "/fragment@50:target:0";
		msdc1_ins = "/fragment@49:target:0";
		mt6370_pmu = "/fragment@25:target:0";
		mt6370_typec = "/fragment@26:target:0";
		mt_pmic_vcama_ldo_reg = "/fragment@29/__overlay__:cam0_vcama-supply:0", "/fragment@29/__overlay__:cam1_vcama-supply:0", "/fragment@29/__overlay__:cam2_vcama-supply:0", "/fragment@60:target:0";
		mt_pmic_vcamd_ldo_reg = "/fragment@29/__overlay__:cam0_vcamd-supply:0", "/fragment@29/__overlay__:cam1_vcamd-supply:0", "/fragment@63:target:0";
		mt_pmic_vcamio_ldo_reg = "/fragment@29/__overlay__:cam0_vcamio-supply:0", "/fragment@29/__overlay__:cam1_vcamio-supply:0", "/fragment@29/__overlay__:cam2_vcamio-supply:0", "/fragment@64:target:0";
		mt_pmic_vldo28_ldo_reg = "/fragment@29/__overlay__:cam0_vcamaf-supply:0", "/fragment@65:target:0";
		mt_pmic_vsim1_ldo_reg = "/fragment@61:target:0";
		mt_pmic_vsim2_ldo_reg = "/fragment@62:target:0";
		odm = "/fragment@1:target:0";
		otg_iddig = "/fragment@57:target:0";
		pio = "/fragment@2/__overlay__/abov@20:interrupt-parent:0", "/fragment@2/__overlay__/abov@20:abov,irq-gpio:0", "/fragment@3:target:0", "/fragment@5/__overlay__/aw87319@58:reset-gpio:0", "/fragment@9:target:0", "/fragment@11:target:0", "/fragment@12:target:0", "/fragment@15:target:0", "/fragment@16/__overlay__/fingerprint@0:interrupt-parent:0", "/fragment@16/__overlay__/fingerprint@0:int-gpio:0", "/fragment@17/__overlay__:int-gpios:0", "/fragment@18/__overlay__:int-gpios:0", "/fragment@19:target:0", "/fragment@22:target:0", "/fragment@24:target:0", "/fragment@25/__overlay__:mt6370,intr_gpio:0", "/fragment@26/__overlay__:mt6370pd,intr_gpio:0", "/fragment@28:target:0", "/fragment@30:target:0", "/fragment@46/__overlay__:GPIO_SIM2_SIO:0", "/fragment@46/__overlay__:GPIO_SIM2_SRST:0", "/fragment@46/__overlay__:GPIO_SIM2_SCLK:0", "/fragment@46/__overlay__:GPIO_SIM1_SCLK:0", "/fragment@46/__overlay__:GPIO_SIM1_SRST:0", "/fragment@46/__overlay__:GPIO_SIM1_SIO:0", "/fragment@46/__overlay__:GPIO_SIM2_HOT_PLUG:0", "/fragment@46/__overlay__:GPIO_SIM1_HOT_PLUG:0", "/fragment@46/__overlay__:GPIO_FDD_BAND_SUPPORT_DETECT_1ST_PIN:0", "/fragment@46/__overlay__:GPIO_FDD_BAND_SUPPORT_DETECT_2ND_PIN:0", "/fragment@46/__overlay__:GPIO_FDD_BAND_SUPPORT_DETECT_3RD_PIN:0", "/fragment@48/__overlay__:interrupt-parent:0", "/fragment@49/__overlay__:interrupt-parent:0", "/fragment@50/__overlay__:interrupt-parent:0", "/fragment@51/__overlay__:interrupt-parent:0", "/fragment@52/__overlay__:interrupt-parent:0", "/fragment@53/__overlay__:interrupt-parent:0", "/fragment@54/__overlay__:interrupt-parent:0", "/fragment@55/__overlay__:interrupt-parent:0", "/fragment@55/__overlay__:deb-gpios:0", "/fragment@56/__overlay__:interrupt-parent:0", "/fragment@57/__overlay__:interrupt-parent:0";
		pmic_clock_buffer_ctrl = "/fragment@35:target:0";
		smart_pa = "/fragment@51:target:0";
		spi1 = "/fragment@16:target:0";
		spi3 = "/fragment@32:target:0";
		subpmic_pmu_eint = "/fragment@53:target:0";
		swtp = "/fragment@55:target:0";
		touch = "/fragment@10:target:0", "/fragment@48:target:0", "/fragment@66:target:0";
	};

	__local_fixups__ {

		fragment@10 {

			__overlay__ {
				pinctrl-0 = <0x0>;
				pinctrl-1 = <0x0>;
				pinctrl-2 = <0x0>;
				pinctrl-3 = <0x0>;
				pinctrl-4 = <0x0>;
				pinctrl-5 = <0x0>;
			};
		};

		fragment@13 {

			__overlay__ {
				pinctrl-0 = <0x0>;
				pinctrl-1 = <0x0>;
				pinctrl-2 = <0x0>;
				pinctrl-3 = <0x0>;
			};
		};

		fragment@14 {

			__overlay__ {
				pinctrl-0 = <0x0>;
				pinctrl-1 = <0x0>;
			};
		};

		fragment@16 {

			__overlay__ {

				fingerprint@0 {
					pinctrl-0 = <0x0>;
					pinctrl-1 = <0x0>;
					pinctrl-2 = <0x0>;
					pinctrl-3 = <0x0>;
					pinctrl-4 = <0x0>;
				};
			};
		};

		fragment@17 {

			__overlay__ {
				pinctrl-0 = <0x0>;
				pinctrl-1 = <0x0>;
				pinctrl-2 = <0x0>;
				pinctrl-3 = <0x0>;
				pinctrl-4 = <0x0>;
			};
		};

		fragment@18 {

			__overlay__ {
				pinctrl-0 = <0x0>;
				pinctrl-1 = <0x0>;
				pinctrl-2 = <0x0>;
				pinctrl-3 = <0x0>;
				pinctrl-4 = <0x0>;
			};
		};

		fragment@2 {

			__overlay__ {

				abov@20 {
					pinctrl-0 = <0x0>;
				};
			};
		};

		fragment@21 {

			__overlay__ {
				pinctrl-0 = <0x0>;
				pinctrl-1 = <0x0>;
			};
		};

		fragment@23 {

			__overlay__ {
				pinctrl-0 = <0x0>;
				pinctrl-1 = <0x0>;
				pinctrl-2 = <0x0>;
				pinctrl-3 = <0x0>;
				pinctrl-4 = <0x0>;
				pinctrl-5 = <0x0>;
				pinctrl-6 = <0x0>;
				pinctrl-7 = <0x0>;
				pinctrl-8 = <0x0>;
				pinctrl-9 = <0x0>;
			};
		};

		fragment@29 {

			__overlay__ {
				pinctrl-0 = <0x0>;
				pinctrl-1 = <0x0>;
				pinctrl-10 = <0x0>;
				pinctrl-11 = <0x0>;
				pinctrl-12 = <0x0>;
				pinctrl-13 = <0x0>;
				pinctrl-14 = <0x0>;
				pinctrl-15 = <0x0>;
				pinctrl-16 = <0x0>;
				pinctrl-17 = <0x0>;
				pinctrl-18 = <0x0>;
				pinctrl-19 = <0x0>;
				pinctrl-2 = <0x0>;
				pinctrl-20 = <0x0>;
				pinctrl-3 = <0x0>;
				pinctrl-4 = <0x0>;
				pinctrl-5 = <0x0>;
				pinctrl-6 = <0x0>;
				pinctrl-7 = <0x0>;
				pinctrl-8 = <0x0>;
				pinctrl-9 = <0x0>;
			};
		};

		fragment@31 {

			__overlay__ {
				pinctrl-0 = <0x0>;
				pinctrl-1 = <0x0>;
				pinctrl-2 = <0x0>;
				pinctrl-3 = <0x0>;
				pinctrl-4 = <0x0>;
			};
		};

		fragment@8 {

			__overlay__ {
				pinctrl-0 = <0x0>;
				pinctrl-1 = <0x0>;
				pinctrl-2 = <0x0>;
				pinctrl-3 = <0x0>;
				pinctrl-4 = <0x0>;
				pinctrl-5 = <0x0>;
			};
		};
	};

	__symbols__ {
		abov_int_default = "/fragment@3/__overlay__/abov_int_pin/abov_int_default";
		accdet_pins_default = "/fragment@15/__overlay__/accdetdefault";
		accdet_pins_eint_as_int = "/fragment@15/__overlay__/accdeteint@0";
		aud_clk_miso_off = "/fragment@24/__overlay__/aud_clk_miso_off";
		aud_clk_miso_on = "/fragment@24/__overlay__/aud_clk_miso_on";
		aud_clk_mosi_off = "/fragment@24/__overlay__/aud_clk_mosi_off";
		aud_clk_mosi_on = "/fragment@24/__overlay__/aud_clk_mosi_on";
		aud_dat_miso_off = "/fragment@24/__overlay__/aud_dat_miso_off";
		aud_dat_miso_on = "/fragment@24/__overlay__/aud_dat_miso_on";
		aud_dat_mosi_off = "/fragment@24/__overlay__/aud_dat_mosi_off";
		aud_dat_mosi_on = "/fragment@24/__overlay__/aud_dat_mosi_on";
		aud_pins_smartpa_off = "/fragment@24/__overlay__/aud_pins_smartpa_off";
		aud_pins_smartpa_on = "/fragment@24/__overlay__/aud_pins_smartpa_on";
		camera_main_af_mtk = "/fragment@38/__overlay__/camera_main_af@0c";
		camera_main_eeprom_mtk = "/fragment@38/__overlay__/camera_main_eeprom@50";
		camera_main_mtk = "/fragment@38/__overlay__/camera_main@1a";
		camera_main_two_af_mtk = "/fragment@40/__overlay__/camera_main_two_af@0c";
		camera_main_two_eeprom_mtk = "/fragment@40/__overlay__/camera_main_two_eeprom@50";
		camera_main_two_mtk = "/fragment@40/__overlay__/camera_main_two@2d";
		camera_pins_cam0_mclk_off = "/fragment@28/__overlay__/camera_pins_cam0_mclk_off";
		camera_pins_cam0_mclk_on = "/fragment@28/__overlay__/camera_pins_cam0_mclk_on";
		camera_pins_cam0_pnd_vcm0 = "/fragment@28/__overlay__/cam0@2";
		camera_pins_cam0_pnd_vcm1 = "/fragment@28/__overlay__/cam0@3";
		camera_pins_cam0_rst0 = "/fragment@28/__overlay__/cam0@0";
		camera_pins_cam0_rst1 = "/fragment@28/__overlay__/cam0@1";
		camera_pins_cam1_mclk_off = "/fragment@28/__overlay__/camera_pins_cam1_mclk_off";
		camera_pins_cam1_mclk_on = "/fragment@28/__overlay__/camera_pins_cam1_mclk_on";
		camera_pins_cam1_rst0 = "/fragment@28/__overlay__/cam1@0";
		camera_pins_cam1_rst1 = "/fragment@28/__overlay__/cam1@1";
		camera_pins_cam2_mclk_off = "/fragment@28/__overlay__/camera_pins_cam2_mclk_off";
		camera_pins_cam2_mclk_on = "/fragment@28/__overlay__/camera_pins_cam2_mclk_on";
		camera_pins_cam2_pnd0 = "/fragment@28/__overlay__/cam2@2";
		camera_pins_cam2_pnd1 = "/fragment@28/__overlay__/cam2@3";
		camera_pins_cam2_rst0 = "/fragment@28/__overlay__/cam2@0";
		camera_pins_cam2_rst1 = "/fragment@28/__overlay__/cam2@1";
		camera_pins_cam_ldo_sub_vcamd_0 = "/fragment@28/__overlay__/cam1@vcamd0";
		camera_pins_cam_ldo_sub_vcamd_1 = "/fragment@28/__overlay__/cam1@vcamd1";
		camera_pins_default = "/fragment@28/__overlay__/camdefault";
		camera_sub_eeprom_mtk = "/fragment@38/__overlay__/camera_sub_eeprom@52";
		camera_sub_mtk = "/fragment@38/__overlay__/camera_sub@2d";
		ccu_sensor_i2c_2_hw_mtk = "/fragment@38/__overlay__/ccu_sensor_i2c_2_hw@10";
		ccu_sensor_i2c_4_hw_mtk = "/fragment@40/__overlay__/ccu_sensor_i2c_4_hw@11";
		consys_pins_default = "/fragment@12/__overlay__/consys_default";
		ctp_pins_default = "/fragment@11/__overlay__/eint0default";
		ctp_pins_eint_as_int = "/fragment@11/__overlay__/eint@0";
		ctp_pins_eint_output0 = "/fragment@11/__overlay__/eintoutput0";
		ctp_pins_eint_output1 = "/fragment@11/__overlay__/eintoutput1";
		ctp_pins_rst_output0 = "/fragment@11/__overlay__/rstoutput0";
		ctp_pins_rst_output1 = "/fragment@11/__overlay__/rstoutput1";
		ext_buck_lp4_mtk = "/fragment@39/__overlay__/ext_buck_lp4@57";
		ext_buck_lp4x_mtk = "/fragment@39/__overlay__/ext_buck_lp4x@50";
		ext_buck_vgpu_mtk = "/fragment@42/__overlay__/ext_buck_vgpu@55";
		fingerfp_default = "/fragment@19/__overlay__/fingerfpdefault";
		fingerfp_irq = "/fragment@19/__overlay__/fp_eint@3";
		fingerfp_rst_high = "/fragment@19/__overlay__/fingerfp_reset_high";
		fingerfp_rst_low = "/fragment@19/__overlay__/fingerfp_reset_low";
		fingerprint_eint_as_int = "/fragment@19/__overlay__/eint_as_int";
		fingerprint_pins_default = "/fragment@19/__overlay__/fp_default";
		fingerprint_pwr_high = "/fragment@19/__overlay__/pwr_on";
		fingerprint_pwr_low = "/fragment@19/__overlay__/pwr_off";
		fingerprint_reset_high = "/fragment@19/__overlay__/state_reset_high";
		fingerprint_reset_low = "/fragment@19/__overlay__/state_reset_low";
		flash_default = "/fragment@30/__overlay__/flash_default_cfg";
		flash_en_pin0 = "/fragment@30/__overlay__/flash_en_pin0";
		flash_en_pin1 = "/fragment@30/__overlay__/flash_en_pin1";
		fpsensor_eint = "/fragment@19/__overlay__/fpsensor_eint";
		fpsensor_eint_in_float = "/fragment@19/__overlay__/fpsensor_eint_in_float";
		fpsensor_eint_in_low = "/fragment@19/__overlay__/fpsensor_eint_in_low";
		fpsensor_fpc_rst_high = "/fragment@19/__overlay__/fpsensor_fpc_rst_high";
		fpsensor_fpc_rst_low = "/fragment@19/__overlay__/fpsensor_fpc_rst_low";
		fts_touch_mtk = "/fragment@32/__overlay__/fts_touch@0";
		gpslna_pins_init = "/fragment@12/__overlay__/gpslna@0";
		gpslna_pins_oh = "/fragment@12/__overlay__/gpslna@1";
		gpslna_pins_ol = "/fragment@12/__overlay__/gpslna@2";
		hall_1 = "/fragment@1/__overlay__/hall_1";
		hall_2 = "/fragment@1/__overlay__/hall_2";
		i2c2_pin_sda_pull_en0 = "/fragment@28/__overlay__/i2c2_pin_sda_pull_en0";
		i2c2_pin_sda_pull_en1 = "/fragment@28/__overlay__/i2c2_pin_sda_pull_en1";
		i2c4_pin_sda_pull_en0 = "/fragment@28/__overlay__/i2c4_pin_sda_pull_en0";
		i2c4_pin_sda_pull_en1 = "/fragment@28/__overlay__/i2c4_pin_sda_pull_en1";
		irtx_gpio_led_default = "/fragment@22/__overlay__/irtx_gpio_led_def@gpio90";
		irtx_gpio_led_set = "/fragment@22/__overlay__/irtx_gpio_led_set@gpio90";
		lcm_pins_enn_output0 = "/fragment@9/__overlay__/ennoutput0";
		lcm_pins_enn_output1 = "/fragment@9/__overlay__/ennoutput1";
		lcm_pins_enp_output0 = "/fragment@9/__overlay__/enpoutput0";
		lcm_pins_enp_output1 = "/fragment@9/__overlay__/enpoutput1";
		lcm_pins_rst_output0 = "/fragment@9/__overlay__/resetoutput0";
		lcm_pins_rst_output1 = "/fragment@9/__overlay__/resetoutput1";
		led0 = "/fragment@1/__overlay__/led@0";
		led1 = "/fragment@1/__overlay__/led@1";
		led2 = "/fragment@1/__overlay__/led@2";
		led3 = "/fragment@1/__overlay__/led@3";
		led4 = "/fragment@1/__overlay__/led@4";
		led5 = "/fragment@1/__overlay__/led@5";
		led6 = "/fragment@1/__overlay__/led@6";
		nfc_mtk = "/fragment@39/__overlay__/nfc@08";
		slave_charger_mtk = "/fragment@39/__overlay__/slave_charger@4b";
		speaker_amp_mtk = "/fragment@39/__overlay__/speaker_amp@34";
		torch_en_pin0 = "/fragment@30/__overlay__/torch_en_pin0";
		torch_en_pin1 = "/fragment@30/__overlay__/torch_en_pin1";
		vibrator0 = "/fragment@1/__overlay__/vibrator@0";
	};

	fragment@0 {
		target = <0xffffffff>;

		__overlay__ {
			atag,videolfb-fb_base_h = <0x0>;
			atag,videolfb-fb_base_l = "^`P";
			atag,videolfb-fps = <0x1770>;
			atag,videolfb-islcm_inited = <0x0>;
			atag,videolfb-islcmfound = <0x1>;
			atag,videolfb-lcmname = "nt35695B_fhd_dsi_cmd_auo_rt5081_drv";
			atag,videolfb-vramSize = <0x17bb000>;
		};
	};

	fragment@1 {
		target = <0xffffffff>;

		__overlay__ {

			hall_1 {
				compatible = "mediatek,hall";
				linux,phandle = <0x51>;
				phandle = <0x51>;
			};

			hall_2 {
				compatible = "mediatek,hall";
				linux,phandle = <0x52>;
				phandle = <0x52>;
			};

			led@0 {
				compatible = "mediatek,red";
				data = <0x1>;
				led_mode = <0x0>;
				linux,phandle = <0x49>;
				phandle = <0x49>;
				pwm_config = <0x0 0x0 0x0 0x0 0x0>;
			};

			led@1 {
				compatible = "mediatek,green";
				data = <0x1>;
				led_mode = <0x0>;
				linux,phandle = <0x4a>;
				phandle = <0x4a>;
				pwm_config = <0x0 0x0 0x0 0x0 0x0>;
			};

			led@2 {
				compatible = "mediatek,blue";
				data = <0x1>;
				led_mode = <0x0>;
				linux,phandle = <0x4b>;
				phandle = <0x4b>;
				pwm_config = <0x0 0x0 0x0 0x0 0x0>;
			};

			led@3 {
				compatible = "mediatek,jogball-backlight";
				data = <0x1>;
				led_mode = <0x0>;
				linux,phandle = <0x4c>;
				phandle = <0x4c>;
				pwm_config = <0x0 0x0 0x0 0x0 0x0>;
			};

			led@4 {
				compatible = "mediatek,keyboard-backlight";
				data = <0x1>;
				led_mode = <0x0>;
				linux,phandle = <0x4d>;
				phandle = <0x4d>;
				pwm_config = <0x0 0x0 0x0 0x0 0x0>;
			};

			led@5 {
				compatible = "mediatek,button-backlight";
				data = <0x1>;
				led_mode = <0x0>;
				linux,phandle = <0x4e>;
				phandle = <0x4e>;
				pwm_config = <0x0 0x0 0x0 0x0 0x0>;
			};

			led@6 {
				compatible = "mediatek,lcd-backlight";
				data = <0x1>;
				led_mode = <0x4>;
				linux,phandle = <0x4f>;
				phandle = <0x4f>;
				pwm_config = <0x0 0x3 0x0 0x0 0x0>;
			};

			vibrator@0 {
				compatible = "mediatek,vibrator";
				linux,phandle = <0x50>;
				phandle = <0x50>;
				vib_limit = <0x9>;
				vib_timer = <0x19>;
				vib_vol = <0x9>;
			};
		};
	};

	fragment@10 {
		target = <0xffffffff>;

		__overlay__ {
			pinctrl-0 = <0x8>;
			pinctrl-1 = <0x9>;
			pinctrl-2 = <0xa>;
			pinctrl-3 = <0xb>;
			pinctrl-4 = <0xc>;
			pinctrl-5 = <0xd>;
			pinctrl-names = "default", "state_eint_as_int", "state_eint_output0", "state_eint_output1", "state_rst_output0", "state_rst_output1";
			status = "okay";
			tpd-filter-custom-prameters = <0x0 0x0 0x0 0x0 0x0 0x0 0x0 0x0 0x0 0x0 0x0 0x0>;
			tpd-filter-custom-speed = <0x0 0x0 0x0>;
			tpd-filter-enable = <0x0>;
			tpd-filter-pixel-density = <0x92>;
			tpd-key-dim-local = <0x5a 0x373 0x64 0x28 0xe6 0x373 0x64 0x28 0x172 0x373 0x64 0x28 0x0 0x0 0x0 0x0>;
			tpd-key-local = <0x8b 0xac 0x9e 0x0>;
			tpd-key-num = <0x3>;
			tpd-max-touch-num = <0xa>;
			tpd-resolution = <0x438 0x780>;
			use-tpd-button = <0x0>;
		};
	};

	fragment@11 {
		target = <0xffffffff>;

		__overlay__ {

			eint0default {
				linux,phandle = <0x8>;
				phandle = <0x8>;
			};

			eint@0 {
				linux,phandle = <0x9>;
				phandle = <0x9>;

				pins_cmd_dat {
					bias-disable;
					pinmux = <0x0>;
					slew-rate = <0x0>;
				};
			};

			eintoutput0 {
				linux,phandle = <0xa>;
				phandle = <0xa>;

				pins_cmd_dat {
					output-low;
					pinmux = <0x0>;
					slew-rate = <0x1>;
				};
			};

			eintoutput1 {
				linux,phandle = <0xb>;
				phandle = <0xb>;

				pins_cmd_dat {
					output-high;
					pinmux = <0x0>;
					slew-rate = <0x1>;
				};
			};

			rstoutput0 {
				linux,phandle = <0xc>;
				phandle = <0xc>;

				pins_cmd_dat {
					output-low;
					pinmux = <0xae00>;
					slew-rate = <0x1>;
				};
			};

			rstoutput1 {
				linux,phandle = <0xd>;
				phandle = <0xd>;

				pins_cmd_dat {
					output-high;
					pinmux = <0xae00>;
					slew-rate = <0x1>;
				};
			};
		};
	};

	fragment@12 {
		target = <0xffffffff>;

		__overlay__ {

			consys_default {
				linux,phandle = <0xe>;
				phandle = <0xe>;
			};

			gpslna@0 {
				linux,phandle = <0xf>;
				phandle = <0xf>;

				pins_cmd_dat {
					bias-disable;
					output-low;
					pinmux = <0x5b00>;
					slew-rate = <0x0>;
				};
			};

			gpslna@1 {
				linux,phandle = <0x10>;
				phandle = <0x10>;

				pins_cmd_dat {
					output-high;
					pinmux = <0x5b00>;
					slew-rate = <0x1>;
				};
			};

			gpslna@2 {
				linux,phandle = <0x11>;
				phandle = <0x11>;

				pins_cmd_dat {
					output-low;
					pinmux = <0x5b00>;
					slew-rate = <0x1>;
				};
			};
		};
	};

	fragment@13 {
		target = <0xffffffff>;

		__overlay__ {
			pinctrl-0 = <0xe>;
			pinctrl-1 = <0xf>;
			pinctrl-2 = <0x10>;
			pinctrl-3 = <0x11>;
			pinctrl-names = "default", "gps_lna_state_init", "gps_lna_state_oh", "gps_lna_state_ol";
			status = "okay";
		};
	};

	fragment@14 {
		target = <0xffffffff>;

		__overlay__ {
			accdet-mic-mode = <0x1>;
			accdet-mic-vol = <0x6>;
			accdet-plugout-debounce = <0x1>;
			headset-eint-level-pol = <0x8>;
			headset-four-key-threshold = <0x0 0x3a 0x79 0xc0 0x190>;
			headset-mode-setting = <0x500 0x500 0x1 0x1f0 0x800 0x800 0x20 0x44>;
			headset-three-key-threshold = <0x0 0x50 0xdc 0x190>;
			headset-three-key-threshold-CDD = <0x0 0x79 0xc0 0x258>;
			pinctrl-0 = <0x12>;
			pinctrl-1 = <0x13>;
			pinctrl-names = "default", "state_eint_as_int";
			status = "okay";
		};
	};

	fragment@15 {
		target = <0xffffffff>;

		__overlay__ {

			accdetdefault {
				linux,phandle = <0x12>;
				phandle = <0x12>;
			};

			accdeteint@0 {
				linux,phandle = <0x13>;
				phandle = <0x13>;

				pins_cmd_dat {
					bias-disable;
					pinmux = <0x900>;
					slew-rate = <0x0>;
				};
			};
		};
	};

	fragment@16 {
		target = <0xffffffff>;

		__overlay__ {
			#address-cells = <0x1>;
			#size-cells = <0x0>;

			fingerprint@0 {
				compatible = "mediatek,mt6762-finger", "fpc,fpc_spi";
				int-gpio = <0xffffffff 0x5 0x0>;
				interrupt-parent = <0xffffffff>;
				interrupts = <0x0 0x5 0x2>;
				pinctrl-0 = <0x14>;
				pinctrl-1 = <0x15>;
				pinctrl-2 = <0x16>;
				pinctrl-3 = <0x17>;
				pinctrl-4 = <0x18>;
				pinctrl-names = "finger_power_high", "finger_power_low", "finger_rst_low", "finger_rst_high", "eint_as_int";
				reg = <0x0>;
				spi-max-frequency = <0x7a1200>;
				status = "okay";
			};
		};
	};

	fragment@17 {
		target = <0xffffffff>;

		__overlay__ {
			int-gpios = <0xffffffff 0x5 0x0>;
			pinctrl-0 = <0x19>;
			pinctrl-1 = <0x1a>;
			pinctrl-2 = <0x1b>;
			pinctrl-3 = <0x1c>;
			pinctrl-4 = <0x1d>;
			pinctrl-names = "fpsensor_fpc_rst_low", "fpsensor_fpc_rst_high", "fpsensor_eint", "fpsensor_eint_in_low", "fpsensor_eint_in_float";
			status = "okay";
		};
	};

	fragment@18 {
		target = <0xffffffff>;

		__overlay__ {
			int-gpios = <0xffffffff 0x5 0x0>;
			pinctrl-0 = <0x1e>;
			pinctrl-1 = <0x1f>;
			pinctrl-2 = <0x20>;
			pinctrl-3 = <0x21>;
			pinctrl-4 = <0x22>;
			pinctrl-names = "default", "rst-low", "rst-high", "irq-init", "spi-default";
			status = "okay";
		};
	};

	fragment@19 {
		target = <0xffffffff>;

		__overlay__ {

			eint_as_int {
				linux,phandle = <0x18>;
				phandle = <0x18>;

				pins_cmd_dat {
					pinmux = <0x500>;
					slew-rate = <0x0>;
				};
			};

			fingerfp_reset_high {
				linux,phandle = <0x20>;
				phandle = <0x20>;

				pins_cmd_dat {
					output-high;
					pinmux = <0xab00>;
					slew-rate = <0x1>;
				};
			};

			fingerfp_reset_low {
				linux,phandle = <0x1f>;
				phandle = <0x1f>;

				pins_cmd_dat {
					output-low;
					pinmux = <0xab00>;
					slew-rate = <0x1>;
				};
			};

			fingerfpdefault {
				linux,phandle = <0x1e>;
				phandle = <0x1e>;
			};

			fp_default {
				linux,phandle = <0x22>;
				phandle = <0x22>;

				pins_cmd2_dat {
					bias-pull-down;
					pinmux = <0x1c01>;
					slew-rate = <0x1>;
				};

				pins_cmd3_dat {
					bias-pull-down;
					pinmux = <0x1901>;
					slew-rate = <0x0>;
				};

				pins_cmd4_dat {
					bias-pull-down;
					pinmux = <0x1b01>;
					slew-rate = <0x1>;
				};

				pins_cmd_dat {
					bias-pull-up;
					pinmux = <0x1a01>;
					slew-rate = <0x1>;
				};
			};

			fp_eint@3 {
				linux,phandle = <0x21>;
				phandle = <0x21>;

				pins_cmd_dat {
					bias-disable;
					pinmux = <0x500>;
					slew-rate = <0x0>;
				};
			};

			fpsensor_eint {
				linux,phandle = <0x1b>;
				phandle = <0x1b>;

				pins_cmd_dat {
					bias-disable;
					pinmux = <0x500>;
					slew-rate = <0x0>;
				};
			};

			fpsensor_eint_in_float {
				linux,phandle = <0x1d>;
				phandle = <0x1d>;

				pins_cmd_dat {
					bias-disable;
					pinmux = <0x500>;
					slew-rate = <0x0>;
				};
			};

			fpsensor_eint_in_low {
				linux,phandle = <0x1c>;
				phandle = <0x1c>;

				pins_cmd_dat {
					bias-pull-down = <0x0>;
					pinmux = <0x500>;
					slew-rate = <0x0>;
				};
			};

			fpsensor_fpc_rst_high {
				linux,phandle = <0x1a>;
				phandle = <0x1a>;

				pins_cmd_dat {
					output-high;
					pinmux = <0xab00>;
					slew-rate = <0x1>;
				};
			};

			fpsensor_fpc_rst_low {
				linux,phandle = <0x19>;
				phandle = <0x19>;

				pins_cmd_dat {
					output-low;
					pinmux = <0xab00>;
					slew-rate = <0x1>;
				};
			};

			pwr_off {
				linux,phandle = <0x15>;
				phandle = <0x15>;

				pins_cmd_dat {
					output-low;
					pinmux = <0xaa00>;
					slew-rate = <0x1>;
				};
			};

			pwr_on {
				linux,phandle = <0x14>;
				phandle = <0x14>;

				pins_cmd_dat {
					output-high;
					pinmux = <0xaa00>;
					slew-rate = <0x1>;
				};
			};

			state_reset_high {
				linux,phandle = <0x17>;
				phandle = <0x17>;

				pins_cmd_dat {
					output-high;
					pinmux = <0xab00>;
					slew-rate = <0x1>;
				};
			};

			state_reset_low {
				linux,phandle = <0x16>;
				phandle = <0x16>;

				pins_cmd_dat {
					output-low;
					pinmux = <0xab00>;
					slew-rate = <0x1>;
				};
			};
		};
	};

	fragment@2 {
		target = <0xffffffff>;

		__overlay__ {

			abov@20 {
				abov,irq-gpio = <0xffffffff 0x9 0x0>;
				cap,scan_period = <0x2>;
				cap,use_channel = <0xf>;
				cap,use_channel_bottom = <0x0>;
				cap,use_channel_top = <0x1>;
				compatible = "abov,abov_sar";
				interrupt-parent = <0xffffffff>;
				interrupts = <0x9 0x2 0x9 0x0>;
				label = "AbovCapSense";
				pinctrl-0 = <0x1>;
				pinctrl-names = "abov_int_default";
				reg = <0x20>;
				reg_array_len = <0x2>;
				reg_array_val = <0x18 0x5a 0x19 0x93>;
			};

			bias_i2c@3e {
				compatible = "mediatek,I2C_LCD_BIAS";
				reg = <0x3e>;
				status = "okay";
			};

			ext_buck_lp4@57 {
				regulator-max-microvolt = <0x13d620>;
				regulator-min-microvolt = <0x493e0>;
				regulator-name = "ext_buck_vdd2";
				vsel_pin = <0x0>;
			};

			ext_buck_lp4x@50 {
				regulator-max-microvolt = <0x13d620>;
				regulator-min-microvolt = <0x493e0>;
				regulator-name = "ext_buck_vddq";
				vsel_pin = <0x1>;
			};
		};
	};

	fragment@20 {
		target = <0xffffffff>;

		__overlay__ {
			EMBEDDED_SEL = <0x0>;
		};
	};

	fragment@21 {
		target = <0xffffffff>;

		__overlay__ {
			pinctrl-0 = <0x23>;
			pinctrl-1 = <0x24>;
			pinctrl-names = "irtx_gpio_led_default", "irtx_gpio_led_set";
			status = "okay";
		};
	};

	fragment@22 {
		target = <0xffffffff>;

		__overlay__ {

			irtx_gpio_led_def@gpio90 {
				linux,phandle = <0x23>;
				phandle = <0x23>;

				pins_cmd_dat {
					bias-disable;
					input-schmitt-enable = <0x0>;
					output-low;
					pinmux = <0x5a00>;
					slew-rate = <0x1>;
				};
			};

			irtx_gpio_led_set@gpio90 {
				linux,phandle = <0x24>;
				phandle = <0x24>;

				pins_cmd_dat {
					output-high;
					pinmux = <0x5a02>;
					slew-rate = <0x1>;
				};
			};
		};
	};

	fragment@23 {
		target = <0xffffffff>;

		__overlay__ {
			pinctrl-0 = <0x25>;
			pinctrl-1 = <0x26>;
			pinctrl-2 = <0x27>;
			pinctrl-3 = <0x28>;
			pinctrl-4 = <0x29>;
			pinctrl-5 = <0x2a>;
			pinctrl-6 = <0x2b>;
			pinctrl-7 = <0x2c>;
			pinctrl-8 = <0x2d>;
			pinctrl-9 = <0x2e>;
			pinctrl-names = "aud_clk_mosi_off", "aud_clk_mosi_on", "aud_clk_miso_off", "aud_clk_miso_on", "aud_dat_mosi_off", "aud_dat_mosi_on", "aud_dat_miso_off", "aud_dat_miso_on", "aud_smartpa_off", "aud_smartpa_on";
			status = "okay";
		};
	};

	fragment@24 {
		target = <0xffffffff>;

		__overlay__ {

			aud_clk_miso_off {
				linux,phandle = <0x27>;
				phandle = <0x27>;

				pins_cmd0_dat {
					pinmux = <0x8c00>;
				};
			};

			aud_clk_miso_on {
				linux,phandle = <0x28>;
				phandle = <0x28>;

				pins_cmd0_dat {
					pinmux = <0x8c01>;
				};
			};

			aud_clk_mosi_off {
				linux,phandle = <0x25>;
				phandle = <0x25>;

				pins_cmd0_dat {
					pinmux = <0x8800>;
				};
			};

			aud_clk_mosi_on {
				linux,phandle = <0x26>;
				phandle = <0x26>;

				pins_cmd0_dat {
					pinmux = <0x8801>;
				};
			};

			aud_dat_miso_off {
				linux,phandle = <0x2b>;
				phandle = <0x2b>;

				pins_cmd1_dat {
					bias-disable;
					input-enable;
					pinmux = <0x8e00>;
					slew-rate = <0x0>;
				};

				pins_cmd2_dat {
					bias-disable;
					input-enable;
					pinmux = <0x8f00>;
					slew-rate = <0x0>;
				};
			};

			aud_dat_miso_on {
				linux,phandle = <0x2c>;
				phandle = <0x2c>;

				pins_cmd1_dat {
					pinmux = <0x8e01>;
				};

				pins_cmd2_dat {
					pinmux = <0x8f01>;
				};
			};

			aud_dat_mosi_off {
				linux,phandle = <0x29>;
				phandle = <0x29>;

				pins_cmd1_dat {
					bias-disable;
					input-enable;
					pinmux = <0x8a00>;
					slew-rate = <0x0>;
				};

				pins_cmd2_dat {
					bias-disable;
					input-enable;
					pinmux = <0x8b00>;
					slew-rate = <0x0>;
				};
			};

			aud_dat_mosi_on {
				linux,phandle = <0x2a>;
				phandle = <0x2a>;

				pins_cmd1_dat {
					pinmux = <0x8a01>;
				};

				pins_cmd2_dat {
					pinmux = <0x8b01>;
				};
			};

			aud_pins_smartpa_off {
				linux,phandle = <0x2d>;
				phandle = <0x2d>;

				pins_cmd0_dat {
					pinmux = <0x1100>;
				};

				pins_cmd1_dat {
					pinmux = <0x1200>;
				};

				pins_cmd2_dat {
					pinmux = <0x1300>;
				};

				pins_cmd3_dat {
					pinmux = <0x1400>;
				};
			};

			aud_pins_smartpa_on {
				linux,phandle = <0x2e>;
				phandle = <0x2e>;

				pins_cmd0_dat {
					pinmux = <0x1106>;
				};

				pins_cmd1_dat {
					pinmux = <0x1206>;
				};

				pins_cmd2_dat {
					pinmux = <0x1306>;
				};

				pins_cmd3_dat {
					pinmux = <0x1406>;
				};
			};
		};
	};

	fragment@25 {
		target = <0xffffffff>;

		__overlay__ {
			mt6370,intr_gpio = <0xffffffff 0xb 0x0>;
			mt6370,intr_gpio_num = <0xb>;
		};
	};

	fragment@26 {
		target = <0xffffffff>;

		__overlay__ {
			mt6370pd,intr_gpio = <0xffffffff 0x29 0x0>;
			mt6370pd,intr_gpio_num = <0x29>;
		};
	};

	fragment@27 {
		target = <0xffffffff>;

		__overlay__ {
		};
	};

	fragment@28 {
		target = <0xffffffff>;

		__overlay__ {

			cam0@0 {
				linux,phandle = <0x30>;
				phandle = <0x30>;

				pins_cmd_dat {
					output-low;
					pinmux = <0x6500>;
					slew-rate = <0x1>;
				};
			};

			cam0@1 {
				linux,phandle = <0x31>;
				phandle = <0x31>;

				pins_cmd_dat {
					output-high;
					pinmux = <0x6500>;
					slew-rate = <0x1>;
				};
			};

			cam0@2 {
				linux,phandle = <0x38>;
				phandle = <0x38>;

				pins_cmd_dat {
					output-low;
					pinmux = <0xb100>;
					slew-rate = <0x1>;
				};
			};

			cam0@3 {
				linux,phandle = <0x39>;
				phandle = <0x39>;

				pins_cmd_dat {
					output-high;
					pinmux = <0xb100>;
					slew-rate = <0x1>;
				};
			};

			cam1@0 {
				linux,phandle = <0x32>;
				phandle = <0x32>;

				pins_cmd_dat {
					output-low;
					pinmux = <0x6600>;
					slew-rate = <0x1>;
				};
			};

			cam1@1 {
				linux,phandle = <0x33>;
				phandle = <0x33>;

				pins_cmd_dat {
					output-high;
					pinmux = <0x6600>;
					slew-rate = <0x1>;
				};
			};

			cam1@vcamd0 {
				linux,phandle = <0x53>;
				phandle = <0x53>;

				pins_cmd_dat {
					output-low;
					pinmux = <0xaf00>;
					slew-rate = <0x1>;
				};
			};

			cam1@vcamd1 {
				linux,phandle = <0x54>;
				phandle = <0x54>;

				pins_cmd_dat {
					output-high;
					pinmux = <0xaf00>;
					slew-rate = <0x1>;
				};
			};

			cam2@0 {
				linux,phandle = <0x34>;
				phandle = <0x34>;

				pins_cmd_dat {
					output-low;
					pinmux = <0x6d00>;
					slew-rate = <0x1>;
				};
			};

			cam2@1 {
				linux,phandle = <0x35>;
				phandle = <0x35>;

				pins_cmd_dat {
					output-high;
					pinmux = <0x6d00>;
					slew-rate = <0x1>;
				};
			};

			cam2@2 {
				linux,phandle = <0x36>;
				phandle = <0x36>;

				pins_cmd_dat {
					output-low;
					pinmux = <0x6b00>;
					slew-rate = <0x1>;
				};
			};

			cam2@3 {
				linux,phandle = <0x37>;
				phandle = <0x37>;

				pins_cmd_dat {
					output-high;
					pinmux = <0x6b00>;
					slew-rate = <0x1>;
				};
			};

			camdefault {
				linux,phandle = <0x2f>;
				phandle = <0x2f>;
			};

			camera_pins_cam0_mclk_off {
				linux,phandle = <0x3b>;
				phandle = <0x3b>;

				pins_cmd_dat {
					pinmux = <0x6300>;
				};
			};

			camera_pins_cam0_mclk_on {
				linux,phandle = <0x3a>;
				phandle = <0x3a>;

				pins_cmd_dat {
					pinmux = <0x6301>;
				};
			};

			camera_pins_cam1_mclk_off {
				linux,phandle = <0x3d>;
				phandle = <0x3d>;

				pins_cmd_dat {
					pinmux = <0x6400>;
				};
			};

			camera_pins_cam1_mclk_on {
				linux,phandle = <0x3c>;
				phandle = <0x3c>;

				pins_cmd_dat {
					pinmux = <0x6401>;
				};
			};

			camera_pins_cam2_mclk_off {
				linux,phandle = <0x3f>;
				phandle = <0x3f>;

				pins_cmd_dat {
					pinmux = <0x6c00>;
				};
			};

			camera_pins_cam2_mclk_on {
				linux,phandle = <0x3e>;
				phandle = <0x3e>;

				pins_cmd_dat {
					pinmux = <0x6c01>;
				};
			};

			i2c2_pin_sda_pull_en0 {
				linux,phandle = <0x40>;
				phandle = <0x40>;

				pins_cmd_dat {
					bias-pull-down = <0x0>;
					pinmux = <0x6801>;
				};
			};

			i2c2_pin_sda_pull_en1 {
				linux,phandle = <0x41>;
				phandle = <0x41>;

				pins_cmd_dat {
					bias-pull-up = <0xb>;
					pinmux = <0x6801>;
				};
			};

			i2c4_pin_sda_pull_en0 {
				linux,phandle = <0x42>;
				phandle = <0x42>;

				pins_cmd_dat {
					bias-pull-down = <0x0>;
					pinmux = <0x6a01>;
				};
			};

			i2c4_pin_sda_pull_en1 {
				linux,phandle = <0x43>;
				phandle = <0x43>;

				pins_cmd_dat {
					bias-pull-up = <0xb>;
					pinmux = <0x6a01>;
				};
			};
		};
	};

	fragment@29 {
		target = <0xffffffff>;

		__overlay__ {
			cam0_enable_sensor = "n8_hi1336_xl_mipi_raw n8_hi1336_txd_mipi_raw n8_s5k3l6_hlt_mipi_raw n8_hi1336_txd_jct_mipi_raw n8_hi1336_xl_jct_mipi_raw";
			cam0_vcama-supply = <0xffffffff>;
			cam0_vcamaf-supply = <0xffffffff>;
			cam0_vcamd-supply = <0xffffffff>;
			cam0_vcamio-supply = <0xffffffff>;
			cam1_enable_sensor = "n8_hi846_sht_mipi_raw n8_hi846_ly_mipi_raw n8_gc8034_txd_mipi_raw";
			cam1_vcama-supply = <0xffffffff>;
			cam1_vcamd-supply = <0xffffffff>;
			cam1_vcamio-supply = <0xffffffff>;
			cam2_enable_sensor = "n8_gc2375h_hlt_mipi_raw n8_gc2375a_qh_mipi_raw n8_bf2253_qh_mipi_raw n8_bf2253_qh_6_mipi_raw n8_bf2253_qh_7_mipi_raw";
			cam2_vcama-supply = <0xffffffff>;
			cam2_vcamio-supply = <0xffffffff>;
			pinctrl-0 = <0x2f>;
			pinctrl-1 = <0x30>;
			pinctrl-10 = <0x39>;
			pinctrl-11 = <0x3a>;
			pinctrl-12 = <0x3b>;
			pinctrl-13 = <0x3c>;
			pinctrl-14 = <0x3d>;
			pinctrl-15 = <0x3e>;
			pinctrl-16 = <0x3f>;
			pinctrl-17 = <0x40>;
			pinctrl-18 = <0x41>;
			pinctrl-19 = <0x42>;
			pinctrl-2 = <0x31>;
			pinctrl-20 = <0x43>;
			pinctrl-3 = <0x32>;
			pinctrl-4 = <0x33>;
			pinctrl-5 = <0x34>;
			pinctrl-6 = <0x35>;
			pinctrl-7 = <0x36>;
			pinctrl-8 = <0x37>;
			pinctrl-9 = <0x38>;
			pinctrl-names = "default", "cam0_rst0", "cam0_rst1", "cam1_rst0", "cam1_rst1", "cam2_rst0", "cam2_rst1", "cam2_pnd0", "cam2_pnd1", "cam0_pnd0_vcm", "cam0_pnd1_vcm", "cam0_mclk_on", "cam0_mclk_off", "cam1_mclk_on", "cam1_mclk_off", "cam2_mclk_on", "cam2_mclk_off", "i2c2_pin_sda_pull_en0", "i2c2_pin_sda_pull_en1", "i2c4_pin_sda_pull_en0", "i2c4_pin_sda_pull_en1";
			status = "okay";
		};
	};

	fragment@3 {
		target = <0xffffffff>;

		__overlay__ {

			abov_int_pin {

				abov_int_default {
					bias-pull-up;
					linux,phandle = <0x1>;
					phandle = <0x1>;
					pinmux = <0x900>;
					slew-rate = <0x2>;
				};
			};
		};
	};

	fragment@30 {
		target = <0xffffffff>;

		__overlay__ {

			flash_default_cfg {
				linux,phandle = <0x44>;
				phandle = <0x44>;
			};

			flash_en_pin0 {
				linux,phandle = <0x45>;
				phandle = <0x45>;

				pins_cmd_dat {
					output-low;
					pinmux = <0x9900>;
					slew-rate = <0x1>;
				};
			};

			flash_en_pin1 {
				linux,phandle = <0x46>;
				phandle = <0x46>;

				pins_cmd_dat {
					output-high;
					pinmux = <0x9900>;
					slew-rate = <0x1>;
				};
			};

			torch_en_pin0 {
				linux,phandle = <0x47>;
				phandle = <0x47>;

				pins_cmd_dat {
					output-low;
					pinmux = <0x9800>;
					slew-rate = <0x1>;
				};
			};

			torch_en_pin1 {
				linux,phandle = <0x48>;
				phandle = <0x48>;

				pins_cmd_dat {
					output-high;
					pinmux = <0x9800>;
					slew-rate = <0x1>;
				};
			};
		};
	};

	fragment@31 {
		target = <0xffffffff>;

		__overlay__ {
			pinctrl-0 = <0x44>;
			pinctrl-1 = <0x45>;
			pinctrl-2 = <0x46>;
			pinctrl-3 = <0x47>;
			pinctrl-4 = <0x48>;
			pinctrl-names = "flash_default", "flash_en_pin0", "flash_en_pin1", "torch_en_pin0", "torch_en_pin1";
			status = "okay";
		};
	};

	fragment@32 {
		target = <0xffffffff>;

		__overlay__ {

			fts_touch@0 {
				chipone,touch-charger-detect-enable;
				chipone,touch-charger-detect-psp = "POWER_SUPPLY_PROP_ONLINE";
				chipone,touch-charger-detect-psp-poll-interval = <0x3e8>;
				chipone,touch-charger-detect-psy-name = "charger";
				chipone,touch-charger-detect-type = "poll";
				compatible = "chipone-tddi", "mediatek,cap_touch", "focaltech,fts", "mediatek,himax_cap_touch", "mediatek,9882n_touch";
				linux,phandle = <0x55>;
				phandle = <0x55>;
				reg = <0x0>;
				spi-max-frequency = <0x989680>;
				status = "okay";
				tpd-filter-enable = <0x0>;
			};
		};
	};

	fragment@33 {
		target = <0xffffffff>;

		__overlay__ {

			android {
				compatible = "android,firmware";

				fstab {
					compatible = "android,fstab";

					product {
						compatible = "android,product";
						dev = "/dev/block/platform/bootdevice/by-name/product";
						fsmgr_flags = "wait,verify,avb";
						mnt_flags = "ro";
						type = "ext4";
					};

					vendor {
						compatible = "android,vendor";
						dev = "/dev/block/platform/bootdevice/by-name/vendor";
						fsmgr_flags = "wait,avb";
						mnt_flags = "ro";
						type = "ext4";
					};
				};

				vbmeta {
					compatible = "android,vbmeta";
					parts = "vbmeta,boot,recovery,dtbo,system,vendor,product";
				};
			};
		};
	};

	fragment@34 {
		target = <0xffffffff>;

		__overlay__ {

			adc_channel@ {
				compatible = "mediatek,adc_channel";
				mediatek,adc_fdd_rf_params_dynamic_custom_ch = <0x2>;
				mediatek,temperature0 = <0x0>;
				mediatek,temperature1 = <0x1>;
				status = "okay";
			};
		};
	};

	fragment@35 {
		target = <0xffffffff>;

		__overlay__ {
			mediatek,clkbuf-config = <0x2 0x1 0x1 0x2 0x0 0x0 0x0>;
			mediatek,clkbuf-driving-current = <0x1 0x1 0x1 0x1 0x1 0x1 0x1>;
			mediatek,clkbuf-quantity = <0x7>;
			status = "okay";
		};
	};

	fragment@36 {
		target = <0xffffffff>;

		__overlay__ {
			#address-cells = <0x1>;
			#size-cells = <0x0>;
			clock-frequency = <0x61a80>;
			mediatek,use-open-drain;
		};
	};

	fragment@37 {
		target = <0xffffffff>;

		__overlay__ {
			#address-cells = <0x1>;
			#size-cells = <0x0>;
			clock-frequency = <0x61a80>;
			mediatek,use-open-drain;
		};
	};

	fragment@38 {
		target = <0xffffffff>;

		__overlay__ {
			#address-cells = <0x1>;
			#size-cells = <0x0>;
			clock-frequency = <0x61a80>;
			mediatek,use-open-drain;

			camera_main@1a {
				compatible = "mediatek,camera_main";
				linux,phandle = <0x56>;
				phandle = <0x56>;
				reg = <0x1a>;
				status = "okay";
			};

			camera_main_af@0c {
				compatible = "mediatek,camera_main_af";
				linux,phandle = <0x58>;
				phandle = <0x58>;
				reg = <0xc>;
				status = "okay";
			};

			camera_main_eeprom@50 {
				compatible = "mediatek,camera_main_eeprom";
				linux,phandle = <0x57>;
				phandle = <0x57>;
				reg = <0x50>;
				status = "okay";
			};

			camera_sub@2d {
				compatible = "mediatek,camera_sub";
				linux,phandle = <0x59>;
				phandle = <0x59>;
				reg = <0x2d>;
				status = "okay";
			};

			camera_sub_eeprom@52 {
				compatible = "mediatek,camera_sub_eeprom";
				linux,phandle = <0x5a>;
				phandle = <0x5a>;
				reg = <0x52>;
				status = "okay";
			};

			ccu_sensor_i2c_2_hw@10 {
				compatible = "mediatek,ccu_sensor_i2c_2_hw";
				linux,phandle = <0x5b>;
				phandle = <0x5b>;
				reg = <0x10>;
				status = "okay";
			};
		};
	};

	fragment@39 {
		target = <0xffffffff>;

		__overlay__ {
			#address-cells = <0x1>;
			#size-cells = <0x0>;
			clock-frequency = <0x61a80>;
			mediatek,use-open-drain;

			ext_buck_lp4@57 {
				compatible = "mediatek,ext_buck_lp4";
				linux,phandle = <0x5f>;
				phandle = <0x5f>;
				reg = <0x57>;
				status = "okay";
			};

			ext_buck_lp4x@50 {
				compatible = "mediatek,ext_buck_lp4x";
				linux,phandle = <0x60>;
				phandle = <0x60>;
				reg = <0x50>;
				status = "okay";
			};

			nfc@08 {
				compatible = "mediatek,nfc";
				linux,phandle = <0x5e>;
				phandle = <0x5e>;
				reg = <0x8>;
				status = "okay";
			};

			slave_charger@4b {
				compatible = "mediatek,slave_charger";
				linux,phandle = <0x5d>;
				phandle = <0x5d>;
				reg = <0x4b>;
				status = "okay";
			};

			speaker_amp@34 {
				compatible = "mediatek,speaker_amp";
				linux,phandle = <0x5c>;
				phandle = <0x5c>;
				reg = <0x34>;
				status = "okay";
			};
		};
	};

	fragment@4 {
		target = <0xffffffff>;

		__overlay__ {

			bq24157@6A {
				compatible = "ti,bq2415x";
				reg = <0x6a>;
				ti,bq2415x,charge-current = <0x60e>;
				ti,bq2415x,charge-voltage = <0x1144>;
				ti,bq2415x,current-sensor-mohm = <0x37>;
				ti,bq2415x,enable-term;
				ti,bq2415x,input-current-limit = <0x5dc>;
				ti,bq2415x,input-voltage-limit = <0x11f8>;
				ti,bq2415x,safety-max-charge-current = <0x60e>;
				ti,bq2415x,safety-max-charge-voltage = <0x1144>;
				ti,bq2415x,term-current = <0x96>;
				ti,bq2415x,vbatlow-volt = <0xdac>;
			};
		};
	};

	fragment@40 {
		target = <0xffffffff>;

		__overlay__ {
			#address-cells = <0x1>;
			#size-cells = <0x0>;
			clock-frequency = <0x61a80>;
			mediatek,use-open-drain;

			camera_main_two@2d {
				compatible = "mediatek,camera_main_two";
				linux,phandle = <0x61>;
				phandle = <0x61>;
				reg = <0x2d>;
				status = "okay";
			};

			camera_main_two_af@0c {
				compatible = "mediatek,camera_main_two_af";
				linux,phandle = <0x63>;
				phandle = <0x63>;
				reg = <0xc>;
				status = "okay";
			};

			camera_main_two_eeprom@50 {
				compatible = "mediatek,camera_main_two_eeprom";
				linux,phandle = <0x62>;
				phandle = <0x62>;
				reg = <0x50>;
				status = "okay";
			};

			ccu_sensor_i2c_4_hw@11 {
				compatible = "mediatek,ccu_sensor_i2c_4_hw";
				linux,phandle = <0x64>;
				phandle = <0x64>;
				reg = <0x11>;
				status = "okay";
			};
		};
	};

	fragment@41 {
		target = <0xffffffff>;

		__overlay__ {
			#address-cells = <0x1>;
			#size-cells = <0x0>;
			clock-frequency = <0x61a80>;
			mediatek,use-open-drain;
		};
	};

	fragment@42 {
		target = <0xffffffff>;

		__overlay__ {
			#address-cells = <0x1>;
			#size-cells = <0x0>;
			clock-frequency = <0x61a80>;
			mediatek,use-open-drain;

			ext_buck_vgpu@55 {
				compatible = "mediatek,ext_buck_vgpu";
				linux,phandle = <0x65>;
				phandle = <0x65>;
				reg = <0x55>;
				status = "okay";
			};
		};
	};

	fragment@43 {
		target = <0xffffffff>;

		__overlay__ {
			#address-cells = <0x1>;
			#size-cells = <0x0>;
			clock-frequency = <0x61a80>;
			mediatek,use-open-drain;
		};
	};

	fragment@44 {
		target = <0xffffffff>;

		__overlay__ {
			#address-cells = <0x1>;
			#size-cells = <0x0>;
			clock-frequency = <0x61a80>;
			mediatek,use-open-drain;
		};
	};

	fragment@45 {
		target = <0xffffffff>;

		__overlay__ {
			#address-cells = <0x1>;
			#size-cells = <0x0>;
			clock-frequency = <0x61a80>;
			mediatek,use-open-drain;
		};
	};

	fragment@46 {
		target = <0xffffffff>;

		__overlay__ {
			GPIO_FDD_BAND_SUPPORT_DETECT_1ST_PIN = <0xffffffff 0xa3 0x0>;
			GPIO_FDD_BAND_SUPPORT_DETECT_2ND_PIN = <0xffffffff 0xa4 0x0>;
			GPIO_FDD_BAND_SUPPORT_DETECT_3RD_PIN = <0xffffffff 0xa5 0x0>;
			GPIO_SIM1_HOT_PLUG = <0xffffffff 0x2f 0x0>;
			GPIO_SIM1_SCLK = <0xffffffff 0x26 0x0>;
			GPIO_SIM1_SIO = <0xffffffff 0x28 0x0>;
			GPIO_SIM1_SRST = <0xffffffff 0x27 0x0>;
			GPIO_SIM2_HOT_PLUG = <0xffffffff 0x2e 0x0>;
			GPIO_SIM2_SCLK = <0xffffffff 0x25 0x0>;
			GPIO_SIM2_SIO = <0xffffffff 0x23 0x0>;
			GPIO_SIM2_SRST = <0xffffffff 0x24 0x0>;
		};
	};

	fragment@47 {
		target = <0xffffffff>;

		__overlay__ {
			gpio_init_default = <0x0 0x0 0x0 0x0 0x1 0x1 0x1 0x1 0x0 0x0 0x0 0x1 0x1 0x1 0x2 0x0 0x0 0x0 0x1 0x1 0x1 0x3 0x0 0x0 0x0 0x1 0x0 0x1 0x4 0x5 0x0 0x0 0x1 0x1 0x0 0x5 0x0 0x0 0x0 0x0 0x0 0x0 0x6 0x0 0x0 0x0 0x1 0x1 0x0 0x7 0x0 0x0 0x0 0x1 0x1 0x0 0x8 0x7 0x0 0x0 0x1 0x1 0x0 0x9 0x0 0x0 0x0 0x1 0x1 0x0 0xa 0x0 0x0 0x0 0x1 0x0 0x0 0xb 0x0 0x0 0x0 0x1 0x1 0x0 0xc 0x0 0x0 0x0 0x1 0x1 0x0 0xd 0x3 0x0 0x0 0x1 0x0 0x0 0xe 0x3 0x1 0x0 0x0 0x0 0x0 0xf 0x3 0x1 0x0 0x0 0x0 0x0 0x10 0x3 0x1 0x0 0x0 0x0 0x0 0x11 0x0 0x0 0x0 0x1 0x0 0x0 0x12 0x0 0x0 0x0 0x1 0x0 0x0 0x13 0x0 0x0 0x0 0x1 0x0 0x0 0x14 0x0 0x0 0x0 0x1 0x0 0x0 0x15 0x1 0x0 0x0 0x1 0x0 0x0 0x16 0x1 0x1 0x0 0x0 0x0 0x0 0x17 0x1 0x1 0x0 0x0 0x0 0x0 0x18 0x1 0x1 0x0 0x0 0x0 0x0 0x19 0x1 0x0 0x0 0x0 0x0 0x0 0x1a 0x1 0x0 0x0 0x1 0x1 0x0 0x1b 0x1 0x1 0x0 0x0 0x0 0x0 0x1c 0x1 0x0 0x0 0x0 0x0 0x0 0x1d 0x1 0x1 0x0 0x0 0x0 0x1 0x1e 0x1 0x0 0x0 0x1 0x1 0x1 0x1f 0x1 0x0 0x0 0x1 0x1 0x1 0x20 0x1 0x0 0x0 0x1 0x1 0x1 0x21 0x1 0x0 0x0 0x1 0x1 0x1 0x22 0x1 0x0 0x0 0x1 0x1 0x1 0x23 0x1 0x0 0x0 0x1 0x1 0x0 0x24 0x1 0x1 0x0 0x0 0x0 0x0 0x25 0x1 0x1 0x0 0x0 0x0 0x0 0x26 0x1 0x1 0x0 0x0 0x0 0x0 0x27 0x1 0x1 0x0 0x0 0x0 0x0 0x28 0x1 0x0 0x0 0x1 0x1 0x0 0x29 0x1 0x0 0x0 0x1 0x1 0x0 0x2a 0x0 0x0 0x0 0x1 0x0 0x0 0x2b 0x1 0x1 0x0 0x0 0x0 0x0 0x2c 0x1 0x0 0x0 0x1 0x0 0x0 0x2d 0x0 0x1 0x0 0x0 0x0 0x0 0x2e 0x1 0x0 0x0 0x1 0x1 0x0 0x2f 0x1 0x0 0x0 0x1 0x1 0x0 0x30 0x1 0x0 0x0 0x1 0x1 0x1 0x31 0x1 0x0 0x0 0x1 0x1 0x1 0x32 0x1 0x0 0x0 0x1 0x1 0x1 0x33 0x1 0x0 0x0 0x1 0x1 0x1 0x34 0x0 0x0 0x0 0x1 0x0 0x0 0x35 0x1 0x1 0x0 0x1 0x0 0x0 0x36 0x1 0x1 0x0 0x1 0x0 0x0 0x37 0x1 0x1 0x0 0x1 0x0 0x0 0x38 0x1 0x1 0x0 0x1 0x0 0x0 0x39 0x0 0x0 0x0 0x0 0x0 0x0 0x3a 0x0 0x0 0x0 0x1 0x0 0x0 0x3b 0x1 0x0 0x0 0x1 0x0 0x0 0x3c 0x1 0x0 0x0 0x1 0x0 0x0 0x3d 0x1 0x0 0x0 0x1 0x0 0x0 0x3e 0x1 0x0 0x0 0x1 0x0 0x0 0x3f 0x1 0x0 0x0 0x1 0x0 0x0 0x40 0x1 0x0 0x0 0x1 0x0 0x0 0x41 0x0 0x0 0x0 0x1 0x0 0x0 0x42 0x0 0x0 0x0 0x1 0x0 0x0 0x43 0x0 0x0 0x0 0x1 0x0 0x0 0x44 0x0 0x0 0x0 0x1 0x0 0x0 0x45 0x1 0x1 0x0 0x1 0x0 0x0 0x46 0x1 0x1 0x0 0x1 0x0 0x0 0x47 0x1 0x1 0x0 0x1 0x0 0x0 0x48 0x1 0x1 0x0 0x1 0x0 0x0 0x49 0x1 0x1 0x0 0x1 0x0 0x0 0x4a 0x1 0x1 0x0 0x1 0x0 0x0 0x4b 0x1 0x1 0x0 0x1 0x0 0x0 0x4c 0x1 0x1 0x0 0x1 0x0 0x0 0x4d 0x1 0x1 0x0 0x1 0x0 0x0 0x4e 0x1 0x1 0x0 0x1 0x0 0x0 0x4f 0x0 0x0 0x0 0x1 0x0 0x0 0x50 0x0 0x0 0x0 0x1 0x0 0x0 0x51 0x1 0x0 0x0 0x1 0x1 0x1 0x52 0x0 0x0 0x0 0x1 0x0 0x1 0x53 0x0 0x0 0x0 0x1 0x0 0x1 0x54 0x1 0x0 0x0 0x1 0x1 0x1 0x55 0x1 0x1 0x0 0x1 0x0 0x0 0x56 0x1 0x1 0x0 0x1 0x0 0x0 0x57 0x0 0x0 0x0 0x1 0x0 0x0 0x58 0x0 0x0 0x0 0x1 0x0 0x0 0x59 0x0 0x0 0x0 0x1 0x0 0x0 0x5a 0x0 0x0 0x0 0x1 0x0 0x0 0x5b 0x0 0x1 0x0 0x1 0x0 0x0 0x5c 0x0 0x0 0x0 0x1 0x0 0x0 0x5d 0x1 0x0 0x0 0x1 0x1 0x0 0x5e 0x1 0x0 0x0 0x1 0x1 0x0 0x5f 0x1 0x0 0x0 0x1 0x1 0x0 0x60 0x1 0x1 0x0 0x0 0x0 0x0 0x61 0x0 0x1 0x0 0x0 0x0 0x0 0x62 0x0 0x0 0x0 0x1 0x0 0x0 0x63 0x1 0x1 0x0 0x0 0x0 0x0 0x64 0x1 0x1 0x0 0x0 0x0 0x0 0x65 0x0 0x1 0x1 0x0 0x0 0x0 0x66 0x0 0x1 0x1 0x0 0x0 0x0 0x67 0x1 0x0 0x0 0x1 0x1 0x1 0x68 0x1 0x0 0x0 0x1 0x1 0x1 0x69 0x1 0x0 0x0 0x1 0x1 0x1 0x6a 0x1 0x0 0x0 0x1 0x1 0x1 0x6b 0x0 0x1 0x0 0x0 0x0 0x0 0x6c 0x1 0x1 0x0 0x0 0x0 0x0 0x6d 0x0 0x1 0x1 0x0 0x0 0x0 0x6e 0x0 0x0 0x0 0x1 0x0 0x0 0x6f 0x0 0x0 0x0 0x1 0x0 0x0 0x70 0x0 0x0 0x0 0x1 0x0 0x0 0x71 0x0 0x0 0x0 0x1 0x0 0x0 0x72 0x0 0x0 0x0 0x1 0x0 0x0 0x73 0x0 0x0 0x0 0x1 0x0 0x0 0x74 0x0 0x0 0x0 0x1 0x0 0x0 0x75 0x0 0x0 0x0 0x1 0x0 0x0 0x76 0x0 0x0 0x0 0x1 0x0 0x0 0x77 0x0 0x0 0x0 0x1 0x0 0x0 0x78 0x0 0x0 0x0 0x1 0x0 0x0 0x79 0x0 0x0 0x0 0x1 0x0 0x0 0x7a 0x1 0x0 0x0 0x1 0x1 0x1 0x7b 0x1 0x0 0x0 0x1 0x1 0x1 0x7c 0x1 0x1 0x0 0x0 0x0 0x1 0x7d 0x1 0x0 0x0 0x1 0x1 0x1 0x7e 0x1 0x0 0x0 0x1 0x1 0x1 0x7f 0x1 0x0 0x0 0x1 0x1 0x1 0x80 0x1 0x0 0x0 0x1 0x1 0x1 0x81 0x1 0x0 0x0 0x1 0x1 0x1 0x82 0x1 0x0 0x0 0x1 0x1 0x1 0x83 0x1 0x0 0x0 0x1 0x0 0x1 0x84 0x1 0x0 0x0 0x1 0x1 0x1 0x85 0x1 0x1 0x1 0x0 0x0 0x1 0x86 0x1 0x0 0x0 0x1 0x0 0x1 0x87 0x1 0x1 0x0 0x0 0x0 0x0 0x88 0x1 0x1 0x0 0x0 0x0 0x0 0x89 0x1 0x1 0x0 0x0 0x0 0x0 0x8a 0x1 0x1 0x0 0x0 0x0 0x0 0x8b 0x1 0x1 0x0 0x0 0x0 0x0 0x8c 0x1 0x0 0x0 0x1 0x0 0x0 0x8d 0x1 0x0 0x0 0x1 0x0 0x0 0x8e 0x1 0x0 0x0 0x1 0x0 0x0 0x8f 0x1 0x0 0x0 0x1 0x0 0x0 0x90 0x1 0x0 0x0 0x1 0x0 0x0 0x91 0x1 0x1 0x1 0x0 0x0 0x0 0x92 0x1 0x0 0x0 0x1 0x0 0x0 0x93 0x1 0x1 0x0 0x0 0x0 0x0 0x94 0x1 0x1 0x0 0x0 0x0 0x0 0x95 0x1 0x1 0x0 0x0 0x0 0x0 0x96 0x0 0x1 0x0 0x0 0x0 0x0 0x97 0x0 0x1 0x0 0x0 0x0 0x0 0x98 0x0 0x1 0x0 0x0 0x0 0x0 0x99 0x0 0x1 0x0 0x0 0x0 0x0 0x9a 0x0 0x1 0x0 0x0 0x0 0x0 0x9b 0x7 0x1 0x0 0x0 0x0 0x0 0x9c 0x7 0x0 0x0 0x1 0x0 0x0 0x9d 0x7 0x0 0x0 0x1 0x0 0x0 0x9e 0x7 0x0 0x0 0x1 0x0 0x0 0x9f 0x0 0x1 0x0 0x0 0x0 0x0 0xa0 0x0 0x0 0x0 0x1 0x0 0x0 0xa1 0x1 0x0 0x0 0x1 0x1 0x1 0xa2 0x1 0x0 0x0 0x1 0x1 0x1 0xa3 0x0 0x0 0x0 0x1 0x0 0x0 0xa4 0x0 0x0 0x0 0x1 0x0 0x0 0xa5 0x0 0x0 0x0 0x1 0x0 0x0 0xa6 0x0 0x0 0x0 0x1 0x0 0x0 0xa7 0x0 0x0 0x0 0x1 0x0 0x0 0xa8 0x0 0x0 0x0 0x1 0x1 0x0 0xa9 0x0 0x0 0x0 0x1 0x1 0x0 0xaa 0x0 0x1 0x0 0x0 0x0 0x0 0xab 0x0 0x0 0x0 0x1 0x0 0x0 0xac 0x0 0x0 0x0 0x1 0x1 0x0 0xad 0x0 0x0 0x0 0x1 0x0 0x0 0xae 0x0 0x1 0x0 0x0 0x0 0x0 0xaf 0x0 0x1 0x0 0x0 0x0 0x0 0xb0 0x0 0x0 0x0 0x1 0x0 0x0 0xb1 0x0 0x1 0x0 0x0 0x0 0x0 0xb2 0x0 0x1 0x0 0x0 0x0 0x0 0xb3 0x0 0x0 0x0 0x1 0x0 0x0>;
		};
	};

	fragment@48 {
		target = <0xffffffff>;

		__overlay__ {
			interrupt-parent = <0xffffffff>;
			interrupts = <0x0 0x2 0x0 0x0>;
			status = "okay";
		};
	};

	fragment@49 {
		target = <0xffffffff>;

		__overlay__ {
			interrupt-parent = <0xffffffff>;
			interrupts = <0x1 0x2 0x1 0x0>;
			status = "okay";
		};
	};

	fragment@5 {
		target = <0xffffffff>;

		__overlay__ {

			aw87319@58 {
				compatible = "awinic,aw87319_pa";
				reg = <0x58>;
				reset-gpio = <0xffffffff 0x9f 0x0>;
				status = "okay";
			};

			ext_buck_vgpu@55 {
				regulator-max-microvolt = <0x13d620>;
				regulator-min-microvolt = <0x493e0>;
				regulator-name = "ext_buck_vgpu";
				vsel_pin = <0x2>;
			};
		};
	};

	fragment@50 {
		target = <0xffffffff>;

		__overlay__ {
			force_mode = "SYSRST";
			interrupt-parent = <0xffffffff>;
			mode = "RST";
			status = "okay";
		};
	};

	fragment@51 {
		target = <0xffffffff>;

		__overlay__ {
			interrupt-parent = <0xffffffff>;
			interrupts = <0x7 0x8 0x7 0x0>;
			status = "okay";
		};
	};

	fragment@52 {
		target = <0xffffffff>;

		__overlay__ {
			interrupt-parent = <0xffffffff>;
			interrupts = <0xa 0x4 0xa 0x0>;
			status = "okay";
		};
	};

	fragment@53 {
		target = <0xffffffff>;

		__overlay__ {
			interrupt-parent = <0xffffffff>;
			interrupts = <0xb 0x2 0xb 0x0>;
			status = "okay";
		};
	};

	fragment@54 {
		target = <0xffffffff>;

		__overlay__ {
			interrupt-parent = <0xffffffff>;
			interrupts = <0x2c 0x1 0x2c 0x1>;
			status = "okay";
		};
	};

	fragment@55 {
		target = <0xffffffff>;

		__overlay__ {
			deb-gpios = <0xffffffff 0x39 0x0>;
			debounce = <0x3e800>;
			interrupt-parent = <0xffffffff>;
			interrupts = <0x39 0x4 0x39 0x0>;
			status = "okay";
		};
	};

	fragment@56 {
		target = <0xffffffff>;

		__overlay__ {
			interrupt-parent = <0xffffffff>;
			interrupts = <0x90 0x4 0x90 0x1>;
			status = "okay";
		};
	};

	fragment@57 {
		target = <0xffffffff>;

		__overlay__ {
			interrupt-parent = <0xffffffff>;
			interrupts = <0x93 0x8 0x29 0x1>;
			status = "okay";
		};
	};

	fragment@58 {
		target = <0xffffffff>;

		__overlay__ {
			compatible = "mediatek,md1_sim1_hot_plug_eint-eint";
			debounce = <0x0 0x2710>;
			dedicated = <0x0 0x0>;
			interrupts = <0x0 0x8>;
			sockettype = <0x0 0x0>;
			src_pin = <0x0 0x1>;
			status = "okay";
		};
	};

	fragment@59 {
		target = <0xffffffff>;

		__overlay__ {
			compatible = "mediatek,md1_sim2_hot_plug_eint-eint";
			debounce = <0x1 0x2710>;
			dedicated = <0x1 0x0>;
			interrupts = <0x1 0x8>;
			sockettype = <0x1 0x0>;
			src_pin = <0x1 0x2>;
			status = "okay";
		};
	};

	fragment@6 {
		target = <0xffffffff>;

		__overlay__ {
			ac_charger_current = <0x17a6b0>;
			ac_charger_input_current = <0x16e360>;
			charging_host_charger_current = <0x16e360>;
			max_charger_voltage = <0x632ea0>;
			non_std_ac_charger_current = <0x7a120>;
			temp_t1_threshold = <0x0>;
			temp_t3_threshold = <0x2d>;
			temp_t4_threshold = <0x32>;
			usb_charger_current = <0x7a120>;
		};
	};

	fragment@60 {
		target = <0xffffffff>;

		__overlay__ {
			regulator-default-on = <0x1>;
			regulator-name = "vcama";
			status = "okay";
		};
	};

	fragment@61 {
		target = <0xffffffff>;

		__overlay__ {
			regulator-default-on = <0x1>;
			regulator-name = "vsim1";
			status = "okay";
		};
	};

	fragment@62 {
		target = <0xffffffff>;

		__overlay__ {
			regulator-default-on = <0x1>;
			regulator-name = "vsim2";
			status = "okay";
		};
	};

	fragment@63 {
		target = <0xffffffff>;

		__overlay__ {
			regulator-default-on = <0x1>;
			regulator-name = "vcamd";
			status = "okay";
		};
	};

	fragment@64 {
		target = <0xffffffff>;

		__overlay__ {
			regulator-default-on = <0x1>;
			regulator-name = "vcamio";
			status = "okay";
		};
	};

	fragment@65 {
		target = <0xffffffff>;

		__overlay__ {
			regulator-default-on = <0x1>;
			regulator-name = "vldo28";
			status = "okay";
		};
	};

	fragment@66 {
		target = <0xffffffff>;

		__overlay__ {
			status = "okay";
		};
	};

	fragment@67 {
		target = <0xffffffff>;

		__overlay__ {
			mediatek,kpd-hw-init-map = <0x0 0x73 0x0 0x0 0x0 0x0 0x0 0x0 0x0 0x0 0x0 0x0 0x0 0x0 0x0 0x0 0x0 0x0 0x0 0x0 0x0 0x0 0x0 0x0 0x0 0x0 0x0 0x0 0x0 0x0 0x0 0x0 0x0 0x0 0x0 0x0 0x0 0x0 0x0 0x0 0x0 0x0 0x0 0x0 0x0 0x0 0x0 0x0 0x0 0x0 0x0 0x0 0x0 0x0 0x0 0x0 0x0 0x0 0x0 0x0 0x0 0x0 0x0 0x0 0x0 0x0 0x0 0x0 0x0 0x0 0x0 0x0>;
			mediatek,kpd-hw-map-num = <0x48>;
			mediatek,kpd-hw-pwrkey = <0x8>;
			mediatek,kpd-hw-rstkey = <0x11>;
			mediatek,kpd-key-debounce = <0x400>;
			mediatek,kpd-pwkey-gpio-din = <0x0>;
			mediatek,kpd-pwrkey-eint-gpio = <0x0>;
			mediatek,kpd-sw-pwrkey = <0x74>;
			mediatek,kpd-sw-rstkey = <0x72>;
			mediatek,kpd-use-extend-type = <0x0>;
			status = "okay";
		};
	};

	fragment@7 {
		target = <0xffffffff>;

		__overlay__ {
			ac_charger_current = <0x17a6b0>;
			ac_charger_input_current = <0x16e360>;
			apple_1_0a_charger_current = <0x9eb10>;
			apple_2_1a_charger_current = <0xc3500>;
			charging_host_charger_current = <0xdbba0>;
			enable_min_charge_temp;
			enable_sw_jeita;
			jeita_temp_above_t4_cc = <0x0>;
			jeita_temp_above_t4_cv = <0x3e8fa0>;
			jeita_temp_below_t0_cc = <0x0>;
			jeita_temp_below_t0_cv = <0x432380>;
			jeita_temp_t0_to_t1_cc = <0x61a80>;
			jeita_temp_t0_to_t1_cv = <0x432380>;
			jeita_temp_t1_to_t2_cc = <0x124f80>;
			jeita_temp_t1_to_t2_cv = <0x432380>;
			jeita_temp_t2_to_t3_cc = <0x16e360>;
			jeita_temp_t2_to_t3_cv = <0x432380>;
			jeita_temp_t3_to_t4_cc = <0x124f80>;
			jeita_temp_t3_to_t4_cv = <0x3e8fa0>;
			max_charge_temp = <0x37>;
			max_charge_temp_minus_x_degree = <0x34>;
			max_charger_voltage = <0x632ea0>;
			min_charge_temp = <0x0>;
			min_charge_temp_plus_x_degree = <0x6>;
			non_std_ac_charger_current = <0xdbba0>;
			ta_ac_charger_current = <0x16e360>;
			temp_neg_10_thres = <0x0>;
			temp_t0_thres = <0x0>;
			temp_t0_thres_plus_x_degree = <0x0>;
			temp_t1_thres = <0x5>;
			temp_t1_thres_plus_x_degree = <0x5>;
			temp_t2_thres = <0xa>;
			temp_t2_thres_plus_x_degree = <0xa>;
			temp_t3_thres = <0x2d>;
			temp_t3_thres_minus_x_degree = <0x2d>;
			temp_t4_thres = <0x37>;
			temp_t4_thres_minus_x_degree = <0x37>;
			usb_charger_current = <0x7a120>;
			usb_charger_current_configured = <0x7a120>;
			usb_charger_current_unconfigured = <0x11170>;
		};
	};

	fragment@8 {
		target = <0xffffffff>;

		__overlay__ {
			pinctrl-0 = <0x2>;
			pinctrl-1 = <0x3>;
			pinctrl-2 = <0x4>;
			pinctrl-3 = <0x5>;
			pinctrl-4 = <0x6>;
			pinctrl-5 = <0x7>;
			pinctrl-names = "state_enp_output0", "state_enp_output1", "state_enn_output0", "state_enn_output1", "state_reset_output0", "state_reset_output1";
			status = "okay";
		};
	};

	fragment@9 {
		target = <0xffffffff>;

		__overlay__ {

			ennoutput0 {
				linux,phandle = <0x4>;
				phandle = <0x4>;

				pins_cmd_dat {
					output-low;
					pinmux = <0x9700>;
					slew-rate = <0x1>;
				};
			};

			ennoutput1 {
				linux,phandle = <0x5>;
				phandle = <0x5>;

				pins_cmd_dat {
					output-high;
					pinmux = <0x9700>;
					slew-rate = <0x1>;
				};
			};

			enpoutput0 {
				linux,phandle = <0x2>;
				phandle = <0x2>;

				pins_cmd_dat {
					output-low;
					pinmux = <0x9600>;
					slew-rate = <0x1>;
				};
			};

			enpoutput1 {
				linux,phandle = <0x3>;
				phandle = <0x3>;

				pins_cmd_dat {
					output-high;
					pinmux = <0x9600>;
					slew-rate = <0x1>;
				};
			};

			resetoutput0 {
				linux,phandle = <0x6>;
				phandle = <0x6>;

				pins_cmd_dat {
					output-low;
					pinmux = <0x2d00>;
					slew-rate = <0x1>;
				};
			};

			resetoutput1 {
				linux,phandle = <0x7>;
				phandle = <0x7>;

				pins_cmd_dat {
					output-high;
					pinmux = <0x2d00>;
					slew-rate = <0x1>;
				};
			};
		};
	};

	fragment@model {
		target-path = [2f 00];

		__overlay__ {

			usb_notifier {
				compatible = "samsung,usb-notifier";
			};
		};
	};
};
