/dts-v1/;

/ {
	#address-cells = <0x2>;
	#size-cells = <0x2>;
	compatible = "mediatek,MT6765";
	interrupt-parent = <0x1>;
	model = "MT6765";

	__symbols__ {
		DPIDLE = "/cpus/idle-states/dpidle";
		MCDI_CLUSTER = "/cpus/idle-states/mcdi-cluster";
		MCDI_CPU = "/cpus/idle-states/mcdi-cpu";
		SODI = "/cpus/idle-states/sodi";
		SODI3 = "/cpus/idle-states/sodi3";
		STANDBY = "/cpus/idle-states/standby";
		SUSPEND = "/cpus/idle-states/suspend";
		accdet = "/accdet";
		apdma = "/dma-controller@11000580";
		apmixed = "/apmixed@1000c000";
		audgpio = "/mt_soc_dl1_pcm@11220000";
		audio = "/audio@11220000";
		auxadc = "/auxadc@11001000";
		bat_gm30 = "/battery";
		btcvsd_snd = "/mtk-btcvsd-snd@18050000";
		camsys = "/camsys@1a000000";
		charger = "/charger";
		chosen = "/chosen";
		clk26m = "/clocks/clk26m";
		clk32k = "/clocks/clk32k";
		consys = "/consys@18002000";
		cpu0 = "/cpus/cpu@000";
		cpu1 = "/cpus/cpu@001";
		cpu2 = "/cpus/cpu@002";
		cpu3 = "/cpus/cpu@003";
		cpu4 = "/cpus/cpu@100";
		cpu5 = "/cpus/cpu@101";
		cpu6 = "/cpus/cpu@102";
		cpu7 = "/cpus/cpu@103";
		cpu_dbgapb = "/cpu_dbgapb@0d410000";
		disp_color0 = "/disp_color0@1400f000";
		disp_mutex0 = "/disp_mutex0@14001000";
		dsi_te = "/dsi_te";
		dynamic_options = "/dynamic_options";
		finger_chipone = "/fingerprint_chipone";
		finger_fp = "/finger_fp";
		firmware = "/firmware";
		flashlight_core = "/flashlight_core";
		flashlights_led191 = "/flashlights_led191";
		flashlights_mt6370 = "/flashlights_mt6370";
		fpsensor_finger = "/fpsensor_finger";
		fpsensor_fp_eint = "/fpsensor_fp_eint";
		fpsensor_fp_eint_n6 = "/fpsensor_fp_eint_n6";
		gce = "/gce@10238000";
		gce_mbox = "/gce_mbox@10238000";
		gce_mbox_svp = "/gce_mbox_svp@10238000";
		gic = "/interrupt-controller@0c000000";
		gpio = "/gpio@10005000";
		gpio_usage_mapping = "/gpio";
		i2c0 = "/i2c0@11007000";
		i2c1 = "/i2c1@11008000";
		i2c2 = "/i2c2@11009000";
		i2c3 = "/i2c3@1100f000";
		i2c4 = "/i2c4@11011000";
		i2c5 = "/i2c5@11016000";
		i2c6 = "/i2c6@1100d000";
		i2c7 = "/i2c7";
		i2c8 = "/i2c8";
		i2c9 = "/i2c9";
		i2c_common = "/i2c_common";
		imgsys = "/imgsys@15020000";
		infracfg_ao = "/infracfg_ao@10001000";
		iommu = "/m4u@10205000";
		irq_nfc = "/irq_nfc";
		irtx_pwm = "/irtx_pwm";
		kd_camera_hw1 = "/kd_camera_hw1@1a040000";
		keypad = "/kp@10010000";
		lcm = "/lcm_gpio";
		lk_charger = "/lk_charger";
		main_pmic = "/mt-pmic";
		md1_sim1_hot_plug_eint = "/md1_sim1_hot_plug_eint";
		md1_sim2_hot_plug_eint = "/md1_sim2_hot_plug_eint";
		mdcldma = "/mdcldma@10014000";
		mdp_ccorr = "/mdp_ccorr0@14005000";
		mdp_rdma0 = "/mdp_rdma0@14004000";
		mdp_rsz0 = "/mdp_rsz0@14006000";
		mdp_rsz1 = "/mdp_rsz1@14007000";
		mdp_tdshp0 = "/mdp_tdshp0@1400a000";
		mdp_wdma0 = "/mdp_wdma0@14008000";
		mdp_wrot0 = "/mdp_wrot0@14009000";
		memory_ssmr_features = "/memory-ssmr-features";
		mfg_cfg = "/mfg_cfg@13ffe000";
		mipi_rx_ana_csi0a = "/mipi_rx_ana_csi0a@11c10000";
		mipi_rx_ana_csi0b = "/mipi_rx_ana_csi0b@11c11000";
		mipi_rx_ana_csi1a = "/mipi_rx_ana_csi1a@11c12000";
		mipi_rx_ana_csi1b = "/mipi_rx_ana_csi1b@11c13000";
		mipi_rx_ana_csi2a = "/mipi_rx_ana_csi2a@11c14000";
		mipi_rx_ana_csi2b = "/mipi_rx_ana_csi2b@11c15000";
		mmsys_config = "/mmsys_config@14000000";
		mrdump_ext_rst = "/mrdump_ext_rst";
		msdc0 = "/msdc@11230000";
		msdc0_pins_default = "/pinctrl@1000b000/msdc0@default";
		msdc0_pins_hs200 = "/pinctrl@1000b000/msdc0@hs200";
		msdc0_pins_hs400 = "/pinctrl@1000b000/msdc0@hs400";
		msdc0_register_setting_default = "/pinctrl@1000b000/msdc0@register_default";
		msdc1 = "/msdc@11240000";
		msdc1_ins = "/msdc1_ins@0";
		msdc1_pins_ddr50 = "/pinctrl@1000b000/msdc1@ddr50";
		msdc1_pins_default = "/pinctrl@1000b000/msdc1@default";
		msdc1_pins_sdr104 = "/pinctrl@1000b000/msdc1@sdr104";
		msdc1_pins_sdr50 = "/pinctrl@1000b000/msdc1@sdr50";
		msdc1_register_setting_default = "/pinctrl@1000b000/msdc1@register_default";
		msdc2 = "/msdc@11250000";
		msdc3 = "/msdc@11260000";
		msdc3_pins_default = "/pinctrl@1000b000/msdc3@default";
		msdc3_register_setting_default = "/pinctrl@1000b000/msdc3@register_default";
		mt6370_pmu = "/mt6370_pmu_dts";
		mt6370_typec = "/type_c_port0";
		mt_charger = "/mt_charger";
		mt_pmic_vaud28_ldo_reg = "/mt-pmic/ldo_regulators/ldo_vaud28";
		mt_pmic_vaux18_ldo_reg = "/mt-pmic/ldo_regulators/ldo_vaux18";
		mt_pmic_vcama_ldo_reg = "/mt-pmic/ldo_regulators/ldo_vcama";
		mt_pmic_vcamd_ldo_reg = "/mt-pmic/ldo_regulators/ldo_vcamd";
		mt_pmic_vcamio_ldo_reg = "/mt-pmic/ldo_regulators/ldo_vcamio";
		mt_pmic_vcn18_ldo_reg = "/mt-pmic/ldo_regulators/ldo_vcn18";
		mt_pmic_vcn28_ldo_reg = "/mt-pmic/ldo_regulators/ldo_vcn28";
		mt_pmic_vcn33_bt_ldo_reg = "/mt-pmic/ldo_regulators/ldo_vcn33_bt";
		mt_pmic_vcn33_wifi_ldo_reg = "/mt-pmic/ldo_regulators/ldo_vcn33_wifi";
		mt_pmic_vcore_buck_reg = "/mt-pmic/buck_regulators/buck_vcore";
		mt_pmic_vdram_ldo_reg = "/mt-pmic/ldo_regulators/ldo_vdram";
		mt_pmic_vefuse_ldo_reg = "/mt-pmic/ldo_regulators/ldo_vefuse";
		mt_pmic_vemc_ldo_reg = "/mt-pmic/ldo_regulators/ldo_vemc";
		mt_pmic_vfe28_ldo_reg = "/mt-pmic/ldo_regulators/ldo_vfe28";
		mt_pmic_vibr_ldo_reg = "/mt-pmic/ldo_regulators/ldo_vibr";
		mt_pmic_vio18_ldo_reg = "/mt-pmic/ldo_regulators/ldo_vio18";
		mt_pmic_vio28_ldo_reg = "/mt-pmic/ldo_regulators/ldo_vio28";
		mt_pmic_vldo28_ldo_reg = "/mt-pmic/ldo_regulators/ldo_vldo28";
		mt_pmic_vmc_ldo_reg = "/mt-pmic/ldo_regulators/ldo_vmc";
		mt_pmic_vmch_ldo_reg = "/mt-pmic/ldo_regulators/ldo_vmch";
		mt_pmic_vmodem_buck_reg = "/mt-pmic/buck_regulators/buck_vmodem";
		mt_pmic_vpa_buck_reg = "/mt-pmic/buck_regulators/buck_vpa";
		mt_pmic_vproc_buck_reg = "/mt-pmic/buck_regulators/buck_vproc";
		mt_pmic_vrf12_ldo_reg = "/mt-pmic/ldo_regulators/ldo_vrf12";
		mt_pmic_vrf18_ldo_reg = "/mt-pmic/ldo_regulators/ldo_vrf18";
		mt_pmic_vs1_buck_reg = "/mt-pmic/buck_regulators/buck_vs1";
		mt_pmic_vsim1_ldo_reg = "/mt-pmic/ldo_regulators/ldo_vsim1";
		mt_pmic_vsim2_ldo_reg = "/mt-pmic/ldo_regulators/ldo_vsim2";
		mt_pmic_vsram_others_ldo_reg = "/mt-pmic/ldo_regulators/ldo_vsram_others";
		mt_pmic_vsram_proc_ldo_reg = "/mt-pmic/ldo_regulators/ldo_vsram_proc";
		mt_pmic_vusb33_ldo_reg = "/mt-pmic/ldo_regulators/ldo_vusb33";
		mt_pmic_vxo22_ldo_reg = "/mt-pmic/ldo_regulators/ldo_vxo22";
		mtkfb = "/mtkfb@0";
		nfc = "/nfc";
		odm = "/odm";
		otg_iddig = "/otg_iddig";
		pd_adapter = "/pd_adapter";
		pericfg = "/pericfg@10003000";
		pio = "/pinctrl@1000b000";
		pmic_auxadc = "/mt-pmic/mt635x-auxadc";
		pmic_clock_buffer_ctrl = "/pmic_clock_buffer_ctrl";
		pwm = "/pwm@11006000";
		radio_md_cfg = "/radio_md_cfg";
		reserved_memory = "/reserved-memory";
		rt9465_slave_chr = "/rt9465_slave_chr";
		scpsys = "/scpsys@10001000";
		smart_pa = "/smart_pa";
		smi_larb0 = "/smi_larb0@14003000";
		smi_larb1 = "/smi_larb1@17010000";
		smi_larb2 = "/smi_larb2@15021000";
		smi_larb3 = "/smi_larb3@1a002000";
		spi0 = "/spi@1100a000";
		spi1 = "/spi@11010000";
		spi2 = "/spi@11012000";
		spi3 = "/spi@11013000";
		spi4 = "/spi@11014000";
		spi5 = "/spi@11015000";
		subpmic_pmu_eint = "/mt6370_pmu_eint";
		swtp = "/swtp";
		swtp1 = "/swtp1";
		syscfg_pctl_0 = "/syscfg_pctl_0@10005000";
		syscfg_pctl_1 = "/syscfg_pctl_1@0x10002000";
		syscfg_pctl_2 = "/syscfg_pctl_2@0x10002200";
		syscfg_pctl_3 = "/syscfg_pctl_3@0x10002400";
		syscfg_pctl_4 = "/syscfg_pctl_4@0x10002600";
		syscfg_pctl_5 = "/syscfg_pctl_5@0x10002800";
		syscfg_pctl_6 = "/syscfg_pctl_6@0x10002a00";
		syscfg_pctl_7 = "/syscfg_pctl_7@0x10002c00";
		sysirq = "/intpol-controller@10200a80";
		tcpc_pd = "/mt6370_pd_eint";
		topckgen = "/topckgen@10000000";
		touch = "/touch";
		uart0 = "/serial@11020000";
		uart1 = "/serial@11030000";
		venc_gcon = "/venc_gcon@17000000";
	};

	accdet {
		compatible = "mediatek,pmic-accdet";
		linux,phandle = <0x77>;
		phandle = <0x77>;
	};

	aes_top0@10016000 {
		compatible = "mediatek,aes_top0";
		reg = <0x0 0x10016000 0x0 0x1000>;
	};

	amms_control {
		compatible = "mediatek,amms";
		interrupts = <0x0 0x86 0x1>;
	};

	ap_ccif0@10209000 {
		compatible = "mediatek,ap_ccif0";
		interrupts = <0x0 0x94 0x8>;
		reg = <0x0 0x10209000 0x0 0x1000>;
	};

	ap_ccif1@1020b000 {
		compatible = "mediatek,ap_ccif1";
		interrupts = <0x0 0x96 0x8>;
		reg = <0x0 0x1020b000 0x0 0x1000>;
	};

	ap_ccif2@1023c000 {
		compatible = "mediatek,ap_ccif2";
		interrupts = <0x0 0x8f 0x8>;
		reg = <0x0 0x1023c000 0x0 0x1000>;
	};

	ap_ccif3@1023e000 {
		compatible = "mediatek,ap_ccif3";
		interrupts = <0x0 0x92 0x8>;
		reg = <0x0 0x1023e000 0x0 0x1000>;
	};

	ap_dma@11000000 {
		compatible = "mediatek,ap_dma";
		interrupts = <0x0 0x61 0x8>;
		reg = <0x0 0x11000000 0x0 0x1000>;
	};

	apcldmain@1021b000 {
		compatible = "mediatek,apcldmain";
		reg = <0x0 0x1021b000 0x0 0x0>;
	};

	apcldmain_ao@10014000 {
		compatible = "mediatek,apcldmain_ao";
		reg = <0x0 0x10014000 0x0 0x400>;
	};

	apcldmamisc@1021b800 {
		compatible = "mediatek,apcldmamisc";
		interrupts = <0x0 0xa5 0x4>;
		reg = <0x0 0x1021b800 0x0 0x0>;
	};

	apcldmamisc_ao@10014800 {
		compatible = "mediatek,apcldmamisc_ao";
		reg = <0x0 0x10014800 0x0 0x400>;
	};

	apcldmaout@1021b400 {
		compatible = "mediatek,apcldmaout";
		reg = <0x0 0x1021b400 0x0 0x0>;
	};

	apcldmaout_ao@10014400 {
		compatible = "mediatek,apcldmaout_ao";
		reg = <0x0 0x10014400 0x0 0x400>;
	};

	apmixed@1000c000 {
		#clock-cells = <0x1>;
		compatible = "mediatek,apmixed", "syscon";
		linux,phandle = <0x41>;
		phandle = <0x41>;
		reg = <0x0 0x1000c000 0x0 0x1000>;
	};

	apxgpt@10008000 {
		clocks = <0x1d>;
		compatible = "mediatek,apxgpt";
		interrupts = <0x0 0xaa 0x8>;
		reg = <0x0 0x10008000 0x0 0x1000>;
	};

	atf_logger {
		compatible = "mediatek,atf_logger";
		interrupts = <0x0 0xf7 0x1>;
	};

	audio@11220000 {
		#clock-cells = <0x1>;
		compatible = "mediatek,audio", "syscon";
		linux,phandle = <0x40>;
		mediatek,btcvsd_snd = <0x3f>;
		phandle = <0x40>;
		reg = <0x0 0x11220000 0x0 0x1000>;
	};

	audio_snd_card {
		compatible = "mediatek,audio_snd_card";
	};

	audio_sram@11221000 {
		compatible = "mediatek,audio_sram";
		reg = <0x0 0x11221000 0x0 0x9000>;
	};

	auxadc@11001000 {
		clock-names = "auxadc-main";
		clocks = <0x25 0x21>;
		compatible = "mediatek,auxadc";
		interrupts = <0x0 0x4c 0x2>;
		linux,phandle = <0x80>;
		phandle = <0x80>;
		reg = <0x0 0x11001000 0x0 0x10000>;
	};

	battery {
		CAR_TUNE_VALUE = <0x64>;
		DIFFERENCE_FULLOCV_ITH = <0xc8>;
		EMBEDDED_SEL = <0x1>;
		FG_METER_RESISTANCE = <0x4b>;
		KEEP_100_PERCENT = <0x1>;
		PMIC_MIN_VOL = <0x82dc>;
		PMIC_SHUTDOWN_CURRENT = <0x14>;
		POWERON_SYSTEM_IBOOT = <0x1f4>;
		Q_MAX_SYS_VOLTAGE_BAT0 = <0xd16>;
		Q_MAX_SYS_VOLTAGE_BAT1 = <0xd16>;
		Q_MAX_SYS_VOLTAGE_BAT2 = <0xd16>;
		Q_MAX_SYS_VOLTAGE_BAT3 = <0xd16>;
		R_FG_VALUE = <0xa>;
		SHUTDOWN_1_TIME = <0x1e>;
		SHUTDOWN_GAUGE0_VOLTAGE = <0x84d0>;
		TEMPERATURE_T0 = <0x32>;
		TEMPERATURE_T1 = <0x19>;
		TEMPERATURE_T2 = <0xa>;
		TEMPERATURE_T3 = <0x0>;
		TEMPERATURE_T4 = <0xfffffff6>;
		battery0_name = "N6_SCUD_4V4_4000mah";
		battery0_profile_t0 = <0x0 0xaaa0 0x370 0x192 0xaa0f 0x36c 0x325 0xa98a 0x36b 0x4b7 0xa90a 0x361 0x64a 0xa88b 0x357 0x7dc 0xa812 0x36a 0x96f 0xa79a 0x356 0xb01 0xa721 0x362 0xc93 0xa6a8 0x360 0xe26 0xa62f 0x352 0xfb8 0xa5b7 0x353 0x114b 0xa547 0x367 0x12dd 0xa4cf 0x35b 0x1470 0xa45b 0x35e 0x1602 0xa3ea 0x372 0x1794 0xa37a 0x384 0x1927 0xa309 0x384 0x1ab9 0xa298 0x384 0x1c4c 0xa228 0x384 0x1dde 0xa1b7 0x384 0x1f70 0xa147 0x386 0x2103 0xa0df 0x39b 0x2295 0xa06f 0x38b 0x2428 0xa002 0x391 0x25ba 0x9f98 0x39d 0x274d 0x9f31 0x3a1 0x28df 0x9ed0 0x3b5 0x2a71 0x9e68 0x3a3 0x2c04 0x9e05 0x39d 0x2d96 0x9da8 0x3af 0x2f29 0x9d4c 0x3cf 0x30bb 0x9ce4 0x3cf 0x324e 0x9c8b 0x3e2 0x33e0 0x9c38 0x3e8 0x3572 0x9be8 0x3f2 0x3705 0x9b95 0x401 0x3897 0x9b3d 0x401 0x3a2a 0x9aec 0x429 0x3bbc 0x9a9c 0x442 0x3d4f 0x9a4b 0x456 0x3ee1 0x99f6 0x460 0x4073 0x9995 0x44b 0x4206 0x9914 0x40e 0x4398 0x9893 0x3c2 0x452b 0x9820 0x392 0x46bd 0x97be 0x37e 0x4850 0x976f 0x36c 0x49e2 0x972e 0x380 0x4b74 0x96ee 0x384 0x4d07 0x96ad 0x379 0x4e99 0x9672 0x36b 0x502c 0x9641 0x36b 0x51be 0x9609 0x36b 0x5350 0x95d7 0x36b 0x54e3 0x95a7 0x36b 0x5675 0x957a 0x372 0x5808 0x9551 0x384 0x599a 0x9520 0x384 0x5b2d 0x94fe 0x396 0x5cbf 0x94d9 0x39d 0x5e51 0x94b0 0x39d 0x5fe4 0x9489 0x3a0 0x6176 0x9469 0x3b4 0x6309 0x9449 0x3b6 0x649b 0x9429 0x3c3 0x662e 0x940c 0x3e0 0x67c0 0x93f1 0x3fe 0x6952 0x93c9 0x3e9 0x6ae5 0x93a7 0x3e8 0x6c77 0x9370 0x3cb 0x6e0a 0x9328 0x39a 0x6f9c 0x92dd 0x370 0x712f 0x92a5 0x384 0x72c1 0x9274 0x384 0x7453 0x9244 0x384 0x75e6 0x9214 0x384 0x7778 0x91e6 0x384 0x790b 0x91bd 0x384 0x7a9d 0x919d 0x398 0x7c30 0x9177 0x38d 0x7dc2 0x914f 0x38f 0x7f54 0x911d 0x397 0x80e7 0x90d5 0x384 0x8279 0x909d 0x384 0x840c 0x9065 0x394 0x859e 0x901a 0x386 0x8730 0x8fd1 0x36b 0x88c3 0x8fab 0x36d 0x8a55 0x8f9b 0x381 0x8be8 0x8f91 0x3a6 0x8d7a 0x8f84 0x3c2 0x8f0d 0x8f6c 0x3e4 0x909f 0x8f33 0x411 0x9231 0x8e72 0x3c1 0x93c4 0x8cee 0x3c7 0x9556 0x8aed 0x3f5 0x96e9 0x884f 0x448 0x987b 0x84b8 0x4f2 0x9a0e 0x7ee7 0x6d5 0x9ba0 0x7030 0x721>;
		battery0_profile_t0_num = <0x64>;
		battery0_profile_t1 = <0x0 0xaa78 0x4e2 0x192 0xa9f7 0x4e2 0x325 0xa976 0x4d3 0x4b7 0xa8fa 0x4c9 0x64a 0xa881 0x4c9 0x7dc 0xa808 0x4c9 0x96f 0xa790 0x4c9 0xb01 0xa71d 0x4d9 0xc93 0xa6a8 0x4d7 0xe26 0xa62f 0x4c9 0xfb8 0xa5b7 0x4c9 0x114b 0xa547 0x4c9 0x12dd 0xa4cf 0x4c9 0x1470 0xa45b 0x4d5 0x1602 0xa3ea 0x4e2 0x1794 0xa37a 0x4e2 0x1927 0xa309 0x4e2 0x1ab9 0xa298 0x4f3 0x1c4c 0xa228 0x4fb 0x1dde 0xa1ba 0x502 0x1f70 0xa150 0x514 0x2103 0xa0e0 0x514 0x2295 0xa076 0x526 0x2428 0xa00c 0x52d 0x25ba 0x9fa2 0x52d 0x274d 0x9f3e 0x534 0x28df 0x9eed 0x55c 0x2a71 0x9e8e 0x572 0x2c04 0x9e22 0x578 0x2d96 0x9db5 0x581 0x2f29 0x9d4c 0x591 0x30bb 0x9ce4 0x591 0x324e 0x9c83 0x5a4 0x33e0 0x9c28 0x5b8 0x3572 0x9bd0 0x5cd 0x3705 0x9b79 0x5dc 0x3897 0x9b29 0x5dc 0x3a2a 0x9ae8 0x5f0 0x3bbc 0x9a96 0x5f5 0x3d4f 0x9a3d 0x5f5 0x3ee1 0x99e0 0x5ea 0x4073 0x9977 0x5c1 0x4206 0x98f6 0x55c 0x4398 0x9882 0x517 0x452b 0x981a 0x4e5 0x46bd 0x97be 0x4c3 0x4850 0x976e 0x4af 0x49e2 0x9726 0x49b 0x4b74 0x96ea 0x497 0x4d07 0x96b2 0x497 0x4e99 0x967a 0x497 0x502c 0x9641 0x497 0x51be 0x9609 0x497 0x5350 0x95de 0x4a8 0x54e3 0x95b1 0x4b0 0x5675 0x9584 0x4b7 0x5808 0x955b 0x4c7 0x599a 0x952a 0x4b3 0x5b2d 0x9508 0x4c2 0x5cbf 0x94e8 0x4e2 0x5e51 0x94c4 0x4f3 0x5fe4 0x949d 0x4e5 0x6176 0x947d 0x4f9 0x6309 0x945d 0x4fb 0x649b 0x943d 0x4fb 0x662e 0x9420 0x503 0x67c0 0x9406 0x514 0x6952 0x93e6 0x514 0x6ae5 0x93c5 0x514 0x6c77 0x93a5 0x506 0x6e0a 0x9381 0x4f2 0x6f9c 0x9359 0x4e2 0x712f 0x9331 0x4e2 0x72c1 0x9300 0x4ba 0x7453 0x92d6 0x4b0 0x75e6 0x92ae 0x4b0 0x7778 0x9286 0x4b0 0x790b 0x925d 0x4b0 0x7a9d 0x923d 0x4b0 0x7c30 0x921d 0x4cf 0x7dc2 0x91f0 0x4d7 0x7f54 0x91b8 0x4c9 0x80e7 0x917f 0x4c9 0x8279 0x9147 0x4c9 0x840c 0x9108 0x4c9 0x859e 0x90ba 0x4be 0x8730 0x906f 0x4b0 0x88c3 0x9041 0x4b2 0x8a55 0x9031 0x4c6 0x8be8 0x9021 0x4eb 0x8d7a 0x9015 0x51f 0x8f0d 0x9005 0x55b 0x909f 0x8fd9 0x58d 0x9231 0x8f48 0x564 0x93c4 0x8ddf 0x54e 0x9556 0x8bf1 0x56c 0x96e9 0x8960 0x5bf 0x987b 0x85cf 0x669 0x9a0e 0x7ff6 0x84c 0x9ba0 0x7260 0xcfd>;
		battery0_profile_t1_num = <0x64>;
		battery0_profile_t2 = <0x0 0xa906 0x834 0x192 0xa875 0x834 0x325 0xa7ea 0x843 0x4b7 0xa76a 0x84d 0x64a 0xa6f1 0x84d 0x7dc 0xa678 0x84d 0x96f 0xa600 0x84d 0xb01 0xa587 0x84d 0xc93 0xa50e 0x84d 0xe26 0xa498 0x84d 0xfb8 0xa427 0x84e 0x114b 0xa3b7 0x862 0x12dd 0xa346 0x866 0x1470 0xa2d5 0x872 0x1602 0xa264 0x87f 0x1794 0xa1f5 0x881 0x1927 0xa18c 0x895 0x1ab9 0xa11c 0x898 0x1c4c 0xa0ac 0x898 0x1dde 0xa03e 0x898 0x1f70 0x9fd7 0x89d 0x2103 0x9f7f 0x8c5 0x2295 0x9f26 0x8dc 0x2428 0x9ecd 0x90a 0x25ba 0x9e6c 0x93f 0x274d 0x9dfd 0x959 0x28df 0x9d6c 0x931 0x2a71 0x9cea 0x92e 0x2c04 0x9c74 0x92e 0x2d96 0x9c16 0x940 0x2f29 0x9bcd 0x964 0x30bb 0x9b85 0x978 0x324e 0x9b34 0x966 0x33e0 0x9ae4 0x952 0x3572 0x9a97 0x95a 0x3705 0x9a4b 0x974 0x3897 0x99f3 0x960 0x3a2a 0x9982 0x910 0x3bbc 0x990b 0x8cf 0x3d4f 0x9897 0x888 0x3ee1 0x982a 0x842 0x4073 0x97ca 0x81b 0x4206 0x977a 0x81b 0x4398 0x972f 0x80b 0x452b 0x96eb 0x802 0x46bd 0x96ad 0x802 0x4850 0x9675 0x802 0x49e2 0x963d 0x802 0x4b74 0x960b 0x812 0x4d07 0x95db 0x81b 0x4e99 0x95aa 0x81b 0x502c 0x957b 0x81d 0x51be 0x9552 0x831 0x5350 0x952a 0x845 0x54e3 0x9502 0x84d 0x5675 0x94dd 0x854 0x5808 0x94bb 0x866 0x599a 0x9493 0x866 0x5b2d 0x9479 0x889 0x5cbf 0x945c 0x898 0x5e51 0x943c 0x898 0x5fe4 0x941b 0x898 0x6176 0x93fb 0x898 0x6309 0x93e2 0x8aa 0x649b 0x93ca 0x8b1 0x662e 0x93b2 0x8b9 0x67c0 0x939a 0x8ca 0x6952 0x9382 0x8ca 0x6ae5 0x9369 0x8ca 0x6c77 0x9351 0x8ca 0x6e0a 0x9335 0x8d3 0x6f9c 0x9313 0x8de 0x712f 0x92eb 0x8ca 0x72c1 0x92ba 0x8ca 0x7453 0x9296 0x8d9 0x75e6 0x9272 0x8ed 0x7778 0x9247 0x906 0x790b 0x9217 0x92e 0x7a9d 0x91d7 0x92e 0x7c30 0x919c 0x94d 0x7dc2 0x9160 0x975 0x7f54 0x9118 0x992 0x80e7 0x90c1 0x994 0x8279 0x9089 0x9bc 0x840c 0x906b 0x9e4 0x859e 0x9057 0xa23 0x8730 0x9044 0xa74 0x88c3 0x902c 0xacc 0x8a55 0x9014 0xb81 0x8be8 0x8fab 0xbf3 0x8d7a 0x8e95 0xc34 0x8f0d 0x8cd0 0xc9b 0x909f 0x8a6f 0xd8c 0x9231 0x871a 0xf1e 0x93c4 0x8144 0x1334 0x9556 0x73f6 0x10c3 0x96e9 0x721a 0xe10 0x987b 0x721a 0xe10 0x9a0e 0x721a 0xe10 0x9ba0 0x721a 0xe10>;
		battery0_profile_t2_num = <0x64>;
		battery0_profile_t3 = <0x0 0xaa46 0x111c 0x192 0xa9b5 0x1118 0x325 0xa92a 0x1108 0x4b7 0xa8a6 0x10fe 0x64a 0xa827 0x10f9 0x7dc 0xa7ae 0x10e3 0x96f 0xa72d 0x10a7 0xb01 0xa6b9 0x109a 0xc93 0xa644 0x108f 0xe26 0xa5ce 0x1075 0xfb8 0xa55d 0x104e 0x114b 0xa4ed 0x103a 0x12dd 0xa475 0x1015 0x1470 0xa401 0x1004 0x1602 0xa390 0x1004 0x1794 0xa321 0x1006 0x1927 0xa2b8 0x101a 0x1ab9 0xa248 0x100c 0x1c4c 0xa1d8 0xff8 0x1dde 0xa16a 0xfeb 0x1f70 0xa101 0xfe9 0x2103 0xa099 0xfd4 0x2295 0xa030 0xfe4 0x2428 0x9fcb 0xfeb 0x25ba 0x9f70 0x1004 0x274d 0x9f1e 0x1041 0x28df 0x9ec6 0x107d 0x2a71 0x9e4f 0x106e 0x2c04 0x9dc6 0x103e 0x2d96 0x9d31 0x100b 0x2f29 0x9c9e 0xfe7 0x30bb 0x9c1d 0xfd3 0x324e 0x9bb3 0xfbf 0x33e0 0x9b5c 0xfb9 0x3572 0x9b0c 0xfb9 0x3705 0x9abb 0xfb0 0x3897 0x9a6b 0xf87 0x3a2a 0x9a0a 0xf4b 0x3bbc 0x99b0 0xf1e 0x3d4f 0x9957 0xf00 0x3ee1 0x98fc 0xee1 0x4073 0x989c 0xea5 0x4206 0x9843 0xe7d 0x4398 0x97f1 0xe74 0x452b 0x97a1 0xe5e 0x46bd 0x9753 0xe3c 0x4850 0x970b 0xe29 0x49e2 0x96ca 0xe29 0x4b74 0x9690 0xe39 0x4d07 0x9658 0xe4d 0x4e99 0x9620 0xe5b 0x502c 0x95e8 0xe5d 0x51be 0x95b8 0xe71 0x5350 0x958e 0xe96 0x54e3 0x9561 0xea6 0x5675 0x9534 0xead 0x5808 0x950b 0xebf 0x599a 0x94e3 0xebf 0x5b2d 0x94c2 0xed1 0x5cbf 0x949d 0xef1 0x5e51 0x9478 0xf12 0x5fe4 0x9457 0xf23 0x6176 0x9437 0xf23 0x6309 0x9417 0xf47 0x649b 0x93fc 0xf62 0x662e 0x93e4 0xf7f 0x67c0 0x93cd 0xfab 0x6952 0x93bd 0xfe7 0x6ae5 0x93a5 0xfeb 0x6c77 0x9393 0x1024 0x6e0a 0x937f 0x1058 0x6f9c 0x9368 0x107a 0x712f 0x9358 0x10cb 0x72c1 0x9340 0x111b 0x7453 0x9322 0x114e 0x75e6 0x9302 0x1176 0x7778 0x92e0 0x11a9 0x790b 0x92b7 0x11f9 0x7a9d 0x928f 0x1235 0x7c30 0x9261 0x1281 0x7dc2 0x9228 0x12d2 0x7f54 0x91ea 0x1328 0x80e7 0x91b1 0x138c 0x8279 0x9168 0x13dc 0x840c 0x9120 0x147e 0x859e 0x90d3 0x1506 0x8730 0x9092 0x1584 0x88c3 0x9072 0x163e 0x8a55 0x9051 0x172f 0x8be8 0x9038 0x1820 0x8d7a 0x9020 0x1965 0x8f0d 0x8ff4 0x1b00 0x909f 0x8f8d 0x1cc4 0x9231 0x8e6b 0x1e2e 0x93c4 0x8c79 0x2023 0x9556 0x89d4 0x235b 0x96e9 0x860b 0x28d6 0x987b 0x8067 0x2da9 0x9a0e 0x7602 0x1676 0x9ba0 0x7602 0x1676>;
		battery0_profile_t3_num = <0x64>;
		battery0_profile_t4 = <0x0 0xaa6e 0x24b8 0x192 0xa9ad 0x24b8 0x325 0xa90a 0x2513 0x4b7 0xa875 0x254e 0x64a 0xa7e7 0x2538 0x7dc 0xa75e 0x24ea 0x96f 0xa6dd 0x24ea 0xb01 0xa65d 0x249b 0xc93 0xa5e0 0x2441 0xe26 0xa567 0x23fd 0xfb8 0xa4ef 0x23d3 0x114b 0xa47f 0x2397 0x12dd 0xa40e 0x237c 0x1470 0xa39d 0x235c 0x1602 0xa32c 0x232d 0x1794 0xa2bc 0x22ef 0x1927 0xa24b 0x229e 0x1ab9 0xa1da 0x2292 0x1c4c 0xa16a 0x227a 0x1dde 0xa0fc 0x2259 0x1f70 0xa094 0x2245 0x2103 0xa034 0x2230 0x2295 0x9fd3 0x221c 0x2428 0x9f77 0x2222 0x25ba 0x9f13 0x2226 0x274d 0x9e9f 0x220e 0x28df 0x9e1f 0x21e6 0x2a71 0x9d80 0x2185 0x2c04 0x9ce4 0x2121 0x2d96 0x9c4f 0x20c5 0x2f29 0x9bc3 0x2081 0x30bb 0x9b4a 0x206d 0x324e 0x9ae9 0x2059 0x33e0 0x9a94 0x2062 0x3572 0x9a44 0x207f 0x3705 0x99f3 0x2099 0x3897 0x99a3 0x2085 0x3a2a 0x9952 0x2035 0x3bbc 0x9908 0x203f 0x3d4f 0x98bb 0x202a 0x3ee1 0x986b 0x1fff 0x4073 0x981a 0x203a 0x4206 0x97ca 0x2025 0x4398 0x977f 0x2021 0x452b 0x9737 0x2016 0x46bd 0x96f1 0x2008 0x4850 0x96b1 0x2008 0x49e2 0x9670 0x2008 0x4b74 0x9636 0x2008 0x4d07 0x95fe 0x201f 0x4e99 0x95c8 0x2054 0x502c 0x9597 0x20a0 0x51be 0x955f 0x20b4 0x5350 0x9534 0x20b7 0x54e3 0x950c 0x20ff 0x5675 0x94e4 0x213f 0x5808 0x94bb 0x2124 0x599a 0x9493 0x2175 0x5b2d 0x9472 0x21a2 0x5cbf 0x9457 0x21ca 0x5e51 0x943f 0x2219 0x5fe4 0x9427 0x229e 0x6176 0x940e 0x22ee 0x6309 0x93fd 0x232c 0x649b 0x93e8 0x239e 0x662e 0x93d3 0x242b 0x67c0 0x93c2 0x24aa 0x6952 0x93aa 0x24e6 0x6ae5 0x9399 0x255d 0x6c77 0x9383 0x25d6 0x6e0a 0x936b 0x2658 0x6f9c 0x9352 0x26ee 0x712f 0x933a 0x27a4 0x72c1 0x931a 0x286c 0x7453 0x92fa 0x2927 0x75e6 0x92da 0x29b3 0x7778 0x92b8 0x2a2d 0x790b 0x928f 0x2ae3 0x7a9d 0x9267 0x2bd4 0x7c30 0x9239 0x2cd5 0x7dc2 0x9204 0x2dfb 0x7f54 0x91cc 0x2f37 0x80e7 0x9193 0x3065 0x8279 0x914a 0x3193 0x840c 0x9108 0x32d1 0x859e 0x90cc 0x3440 0x8730 0x9099 0x35ec 0x88c3 0x9071 0x37d4 0x8a55 0x9049 0x39f3 0x8be8 0x9027 0x3c01 0x8d7a 0x8ffd 0x3e19 0x8f0d 0x8fb9 0x404d 0x909f 0x8f40 0x42a4 0x9231 0x8e3f 0x44d8 0x93c4 0x8c7b 0x46c5 0x9556 0x8a1b 0x46be 0x96e9 0x86c1 0x3fab 0x987b 0x8123 0x3181 0x9a0e 0x7ea4 0x2b8e 0x9ba0 0x7ea4 0x2b8e>;
		battery0_profile_t4_num = <0x64>;
		battery1_name = "N6_SUNWODA_4V4_4000mah";
		battery1_profile_t0 = <0x0 0xaaaa 0x384 0x193 0xaa19 0x384 0x327 0xa994 0x384 0x4ba 0xa917 0x384 0x64d 0xa89c 0x37e 0x7e1 0xa81b 0x36b 0x974 0xa7a2 0x36b 0xb07 0xa729 0x36b 0xc9b 0xa6b0 0x36b 0xe2e 0xa63a 0x372 0xfc1 0xa5c8 0x382 0x1155 0xa54f 0x36e 0x12e8 0xa4dd 0x37c 0x147b 0xa467 0x384 0x160f 0xa3f1 0x384 0x17a2 0xa380 0x384 0x1935 0xa30f 0x384 0x1ac9 0xa29e 0x396 0x1c5c 0xa22d 0x39d 0x1def 0xa1bc 0x39d 0x1f83 0xa14d 0x3a0 0x2116 0xa0e4 0x3b5 0x22a9 0xa073 0x3a3 0x243d 0xa007 0x39d 0x25d0 0x9f9d 0x3a7 0x2763 0x9f36 0x3bb 0x28f7 0x9ed5 0x3cf 0x2a8a 0x9e74 0x3cf 0x2c1d 0x9e13 0x3cf 0x2db1 0x9db2 0x3d9 0x2f44 0x9d52 0x3e8 0x30d7 0x9cf1 0x3e8 0x326b 0x9c90 0x3e8 0x33fe 0x9c36 0x3e8 0x3591 0x9be1 0x3f3 0x3725 0x9b91 0x407 0x38b8 0x9b40 0x41d 0x3a4b 0x9aef 0x445 0x3bdf 0x9a98 0x44c 0x3d72 0x9a44 0x458 0x3f05 0x99ee 0x45e 0x4099 0x998a 0x447 0x422c 0x9911 0x41f 0x43bf 0x9891 0x3e5 0x4553 0x981f 0x3b5 0x46e6 0x97c0 0x39d 0x4879 0x9771 0x39a 0x4a0d 0x9728 0x386 0x4ba0 0x96e7 0x384 0x4d33 0x96ac 0x384 0x4ec7 0x9673 0x384 0x505a 0x963c 0x384 0x51ed 0x960c 0x384 0x5381 0x95d4 0x384 0x5514 0x95a7 0x393 0x56a7 0x957b 0x39d 0x583b 0x954c 0x39d 0x59ce 0x9524 0x39d 0x5b61 0x94fc 0x3b1 0x5cf5 0x94d3 0x3b6 0x5e88 0x94ab 0x3b6 0x601b 0x9485 0x3bc 0x61af 0x9465 0x3cf 0x6342 0x9444 0x3cf 0x64d5 0x942b 0x3ef 0x6669 0x940e 0x401 0x67fc 0x93ee 0x401 0x698f 0x93cd 0x401 0x6b23 0x93a3 0x401 0x6cb6 0x936d 0x3de 0x6e49 0x9325 0x3b6 0x6fdd 0x92db 0x39d 0x7170 0x929d 0x39d 0x7303 0x926c 0x39d 0x7497 0x923c 0x39d 0x762a 0x920c 0x39d 0x77bd 0x91df 0x39d 0x7951 0x91b8 0x3a1 0x7ae4 0x9198 0x3b5 0x7c77 0x9170 0x3a3 0x7e0b 0x9147 0x3ab 0x7f9e 0x9114 0x3ac 0x8131 0x90d3 0x39d 0x82c5 0x9093 0x39d 0x8458 0x905a 0x39d 0x85eb 0x900f 0x38e 0x877f 0x8fcf 0x384 0x8912 0x8fa8 0x38a 0x8aa5 0x8f98 0x39e 0x8c39 0x8f90 0x3b2 0x8dcc 0x8f81 0x3d6 0x8f5f 0x8f64 0x3fe 0x90f3 0x8f18 0x40d 0x9286 0x8e6d 0x3e8 0x9419 0x8cea 0x3e8 0x95ad 0x8ae0 0x40a 0x9740 0x883a 0x462 0x98d3 0x847e 0x531 0x9a67 0x7ec0 0x92e 0x9bfa 0x6ff4 0x76c>;
		battery1_profile_t0_num = <0x64>;
		battery1_profile_t1 = <0x0 0xaa82 0x4ce 0x193 0xaa01 0x4ca 0x327 0xa986 0x4c9 0x4ba 0xa90d 0x4c9 0x64d 0xa894 0x4c9 0x7e1 0xa81b 0x4c9 0x974 0xa7a2 0x4c9 0xb07 0xa729 0x4b9 0xc9b 0xa6b5 0x4bb 0xe2e 0xa641 0x4c9 0xfc1 0xa5c9 0x4c9 0x1155 0xa558 0x4c9 0x12e8 0xa4e0 0x4c9 0x147b 0xa46c 0x4d5 0x160f 0xa3fb 0x4db 0x17a2 0xa38a 0x4cc 0x1935 0xa319 0x4e0 0x1ac9 0xa2a8 0x4f4 0x1c5c 0xa237 0x4fb 0x1def 0xa1ca 0x503 0x1f83 0xa15f 0x514 0x2116 0xa0ee 0x514 0x22a9 0xa085 0x527 0x243d 0xa01b 0x52d 0x25d0 0x9fb1 0x52d 0x2763 0x9f4b 0x536 0x28f7 0x9ef3 0x55f 0x2a8a 0x9e92 0x55f 0x2c1d 0x9e2b 0x56e 0x2db1 0x9dc2 0x582 0x2f44 0x9d57 0x591 0x30d7 0x9ce7 0x592 0x326b 0x9c86 0x5a6 0x33fe 0x9c2c 0x5ba 0x3591 0x9bd3 0x5c3 0x3725 0x9b7d 0x5c9 0x38b8 0x9b2d 0x5dc 0x3a4b 0x9ae4 0x5dc 0x3bdf 0x9a95 0x5ed 0x3d72 0x9a3f 0x5f5 0x3f05 0x99e1 0x5e0 0x4099 0x9976 0x5a3 0x422c 0x98fd 0x567 0x43bf 0x9884 0x518 0x4553 0x981a 0x4e1 0x46e6 0x97c0 0x4c1 0x4879 0x9771 0x4ad 0x4a0d 0x9728 0x499 0x4ba0 0x96e7 0x497 0x4d33 0x96ac 0x497 0x4ec7 0x9677 0x497 0x505a 0x9645 0x497 0x51ed 0x960c 0x497 0x5381 0x95dc 0x497 0x5514 0x95b1 0x4a6 0x56a7 0x9585 0x4b0 0x583b 0x9556 0x4b5 0x59ce 0x952e 0x4c9 0x5b61 0x950e 0x4dd 0x5cf5 0x94e7 0x4e2 0x5e88 0x94c3 0x4ed 0x601b 0x94a3 0x4fb 0x61af 0x9483 0x4fc 0x6342 0x9462 0x510 0x64d5 0x9442 0x514 0x6669 0x9422 0x514 0x67fc 0x9402 0x514 0x698f 0x93e1 0x512 0x6b23 0x93c0 0x4fe 0x6cb6 0x93a0 0x4fb 0x6e49 0x9380 0x4fb 0x6fdd 0x9359 0x4f3 0x7170 0x932a 0x4df 0x7303 0x9302 0x4cb 0x7497 0x92d9 0x4c9 0x762a 0x92ac 0x4bb 0x77bd 0x927f 0x4a7 0x7951 0x9259 0x49f 0x7ae4 0x9241 0x4c7 0x7c77 0x921a 0x4c9 0x7e0b 0x91ec 0x4c9 0x7f9e 0x91b4 0x4bf 0x8131 0x9177 0x4b9 0x82c5 0x9146 0x4e2 0x8458 0x9106 0x4e2 0x85eb 0x90b9 0x4d3 0x877f 0x9071 0x4b4 0x8912 0x903e 0x4a2 0x8aa5 0x902e 0x4ca 0x8c39 0x9026 0x4f3 0x8dcc 0x9017 0x51b 0x8f5f 0x9003 0x54f 0x90f3 0x8fd0 0x578 0x9286 0x8f4e 0x574 0x9419 0x8df3 0x54c 0x95ad 0x8bff 0x569 0x9740 0x8967 0x5b7 0x98d3 0x85b8 0x670 0x9a67 0x7fee 0xb0f 0x9bfa 0x7274 0xcfd>;
		battery1_profile_t1_num = <0x64>;
		battery1_profile_t2 = <0x0 0xa91a 0x820 0x193 0xa889 0x81c 0x327 0xa7fe 0x82a 0x4ba 0xa77d 0x82a 0x64d 0xa704 0x821 0x7e1 0xa68b 0x834 0x974 0xa612 0x834 0xb07 0xa59f 0x844 0xc9b 0xa52a 0x84d 0xe2e 0xa4b1 0x847 0xfc1 0xa439 0x836 0x1155 0xa3c8 0x84a 0x12e8 0xa357 0x84d 0x147b 0xa2e6 0x859 0x160f 0xa278 0x86d 0x17a2 0xa20e 0x87f 0x1935 0xa19d 0x87f 0x1ac9 0xa12c 0x87f 0x1c5c 0xa0c0 0x88c 0x1def 0xa058 0x898 0x1f83 0x9ff0 0x89f 0x2116 0x9f8f 0x8c7 0x22a9 0x9f36 0x8dd 0x243d 0x9edc 0x8ff 0x25d0 0x9e7e 0x928 0x2763 0x9e14 0x942 0x28f7 0x9d8b 0x92e 0x2a8a 0x9cfa 0x91a 0x2c1d 0x9c81 0x924 0x2db1 0x9c21 0x938 0x2f44 0x9bd4 0x94d 0x30d7 0x9b93 0x95f 0x326b 0x9b43 0x94b 0x33fe 0x9af2 0x947 0x3591 0x9aa1 0x952 0x3725 0x9a51 0x960 0x38b8 0x99fe 0x95c 0x3a4b 0x9995 0x91f 0x3bdf 0x991f 0x8e3 0x3d72 0x98a6 0x89a 0x3f05 0x9836 0x851 0x4099 0x97d7 0x81b 0x422c 0x9786 0x81b 0x43bf 0x973c 0x809 0x4553 0x96f9 0x802 0x46e6 0x96b8 0x802 0x4879 0x9679 0x7ff 0x4a0d 0x9641 0x7eb 0x4ba0 0x9610 0x7fc 0x4d33 0x95df 0x810 0x4ec7 0x95af 0x812 0x505a 0x9580 0x80a 0x51ed 0x9558 0x832 0x5381 0x952f 0x834 0x5514 0x9507 0x834 0x56a7 0x94df 0x83e 0x583b 0x94b8 0x852 0x59ce 0x9498 0x866 0x5b61 0x9478 0x87a 0x5cf5 0x9457 0x87f 0x5e88 0x943b 0x88a 0x601b 0x9421 0x898 0x61af 0x9401 0x899 0x6342 0x93e9 0x8ad 0x64d5 0x93ca 0x8a1 0x6669 0x93b3 0x8af 0x67fc 0x939e 0x8bd 0x698f 0x937f 0x89d 0x6b23 0x936e 0x8db 0x6cb6 0x9357 0x8d1 0x6e49 0x933a 0x8d7 0x6fdd 0x9313 0x8d3 0x7170 0x92e4 0x8b4 0x7303 0x92bc 0x8c8 0x7497 0x929b 0x8dc 0x762a 0x9275 0x8e3 0x77bd 0x9249 0x8f4 0x7951 0x9216 0x915 0x7ae4 0x91d5 0x915 0x7c77 0x919c 0x928 0x7e0b 0x9164 0x959 0x7f9e 0x9120 0x983 0x8131 0x90cf 0x98d 0x82c5 0x907f 0x979 0x8458 0x9066 0x9a1 0x85eb 0x9054 0x9d9 0x877f 0x9044 0xa2a 0x8912 0x9031 0xa9f 0x8aa5 0x9017 0xb3e 0x8c39 0x8fbe 0xba3 0x8dcc 0x8e9f 0xbc8 0x8f5f 0x8ce1 0xc41 0x90f3 0x8a83 0xd37 0x9286 0x875c 0xeaf 0x9419 0x8239 0x11c1 0x95ad 0x75d8 0x154a 0x9740 0x71d4 0xbd1 0x98d3 0x71d4 0xbd1 0x9a67 0x71d4 0xbd1 0x9bfa 0x71d4 0xbd1>;
		battery1_profile_t2_num = <0x64>;
		battery1_profile_t3 = <0x0 0xaa5a 0x109a 0x193 0xa9c9 0x109a 0x327 0xa944 0x109a 0x4ba 0xa8c3 0x1090 0x64d 0xa842 0x1076 0x7e1 0xa7c1 0x104e 0x974 0xa748 0x103a 0xb07 0xa6cf 0x1026 0xc9b 0xa65b 0x101d 0xe2e 0xa5ea 0x100a 0xfc1 0xa578 0xfd0 0x1155 0xa4ff 0xfbc 0x12e8 0xa48d 0xfb9 0x147b 0xa41c 0xfb9 0x160f 0xa3ab 0xfb9 0x17a2 0xa33a 0xfb7 0x1935 0xa2c9 0xfa2 0x1ac9 0xa25f 0xfb2 0x1c5c 0xa1f1 0xfac 0x1def 0xa184 0xf98 0x1f83 0xa119 0xf80 0x2116 0xa0a8 0xf58 0x22a9 0xa03f 0xf68 0x243d 0x9fda 0xf7c 0x25d0 0x9f7c 0xf9a 0x2763 0x9f25 0xfc7 0x28f7 0x9ed5 0x1004 0x2a8a 0x9e64 0x1018 0x2c1d 0x9de1 0x100e 0x2db1 0x9d4b 0xfd0 0x2f44 0x9cb1 0xf7c 0x30d7 0x9c29 0xf56 0x326b 0x9bc0 0xf6a 0x33fe 0x9b64 0xf5e 0x3591 0x9b14 0xf4a 0x3725 0x9ac9 0xf36 0x38b8 0x9a77 0xf1f 0x3a4b 0x9a16 0xee2 0x3bdf 0x99bc 0xec7 0x3d72 0x9963 0xea7 0x3f05 0x9908 0xe7f 0x4099 0x98a8 0xe59 0x422c 0x984f 0xe45 0x43bf 0x97f6 0xe0d 0x4553 0x97a8 0xe04 0x46e6 0x975c 0xe08 0x4879 0x970e 0xdf4 0x4a0d 0x96cd 0xde0 0x4ba0 0x9694 0xdf1 0x4d33 0x965c 0xde9 0x4ec7 0x9623 0xde7 0x505a 0x95ec 0xdfb 0x51ed 0x95bc 0xe0f 0x5381 0x958c 0xe10 0x5514 0x9561 0xe2d 0x56a7 0x9539 0xe55 0x583b 0x9510 0xe79 0x59ce 0x94e8 0xe8d 0x5b61 0x94c0 0xea1 0x5cf5 0x949d 0xeb5 0x5e88 0x947d 0xeca 0x601b 0x945d 0xee3 0x61af 0x943d 0xf09 0x6342 0x941c 0xef5 0x64d5 0x9402 0xf01 0x6669 0x93ea 0xf22 0x67fc 0x93d2 0xf4a 0x698f 0x93ba 0xf72 0x6b23 0x93aa 0xf9b 0x6cb6 0x939a 0xfb2 0x6e49 0x9385 0xfec 0x6fdd 0x936d 0x1025 0x7170 0x9354 0x1042 0x7303 0x933c 0x1093 0x7497 0x9324 0x10ac 0x762a 0x9306 0x10f7 0x77bd 0x92e3 0x1130 0x7951 0x92ba 0x1143 0x7ae4 0x9292 0x11a8 0x7c77 0x9262 0x11e7 0x7e0b 0x922c 0x1240 0x7f9e 0x91f0 0x1292 0x8131 0x91af 0x12d3 0x82c5 0x916f 0x1323 0x8458 0x9126 0x13d8 0x85eb 0x90d7 0x1432 0x877f 0x9097 0x14a3 0x8912 0x9070 0x155a 0x8aa5 0x905f 0x164b 0x8c39 0x903f 0x1714 0x8dcc 0x9025 0x184e 0x8f5f 0x8ff6 0x19e8 0x90f3 0x8f7f 0x1b94 0x9286 0x8e77 0x1cfb 0x9419 0x8c8b 0x1eb7 0x95ad 0x89eb 0x2212 0x9740 0x8629 0x27bf 0x98d3 0x80ae 0x2bc1 0x9a67 0x760c 0x1644 0x9bfa 0x760c 0x1644>;
		battery1_profile_t3_num = <0x64>;
		battery1_profile_t4 = <0x0 0xaa82 0x2486 0x193 0xa9c8 0x2486 0x327 0xa927 0x2486 0x4ba 0xa892 0x24a6 0x64d 0xa806 0x24af 0x7e1 0xa784 0x2439 0x974 0xa6fb 0x23fc 0xb07 0xa67f 0x239f 0xc9b 0xa606 0x2373 0xe2e 0xa58d 0x2346 0xfc1 0xa515 0x22c6 0x1155 0xa4a4 0x22da 0x12e8 0xa42c 0x2277 0x147b 0xa3b8 0x223b 0x160f 0xa34a 0x222e 0x17a2 0xa2e0 0x2222 0x1935 0xa26f 0x21bd 0x1ac9 0xa1fe 0x21b1 0x1c5c 0xa18d 0x218a 0x1def 0xa11c 0x215e 0x1f83 0xa0ae 0x214a 0x2116 0xa04d 0x2136 0x22a9 0x9fec 0x216c 0x243d 0x9f90 0x218d 0x25d0 0x9f32 0x2198 0x2763 0x9eca 0x217c 0x28f7 0x9e49 0x2103 0x2a8a 0x9db0 0x20da 0x2c1d 0x9d11 0x2066 0x2db1 0x9c78 0x202b 0x2f44 0x9beb 0x2035 0x30d7 0x9b6b 0x2020 0x326b 0x9b02 0x200c 0x33fe 0x9aa6 0x1fe8 0x3591 0x9a51 0x1fc0 0x3725 0x9a01 0x1f9e 0x38b8 0x99b1 0x1f90 0x3a4b 0x9968 0x1fcc 0x3bdf 0x9919 0x1f82 0x3d72 0x98c8 0x1f71 0x3f05 0x9877 0x1f84 0x4099 0x9828 0x1f6d 0x422c 0x97df 0x1f45 0x43bf 0x978f 0x1f40 0x4553 0x9744 0x1f33 0x46e6 0x96fe 0x1f27 0x4879 0x96be 0x1f34 0x4a0d 0x967d 0x1f84 0x4ba0 0x9644 0x1fb0 0x4d33 0x960c 0x1f94 0x4ec7 0x95d3 0x1f7b 0x505a 0x959c 0x1fa3 0x51ed 0x956c 0x201c 0x5381 0x953c 0x1ffa 0x5514 0x9511 0x2038 0x56a7 0x94e9 0x2089 0x583b 0x94c2 0x20c6 0x59ce 0x94a2 0x2102 0x5b61 0x9482 0x20da 0x5cf5 0x9461 0x213b 0x5e88 0x9445 0x21be 0x601b 0x942d 0x220f 0x61af 0x9415 0x2204 0x6342 0x93fd 0x22b9 0x64d5 0x93eb 0x233e 0x6669 0x93db 0x238a 0x67fc 0x93c8 0x23c6 0x698f 0x93b1 0x2431 0x6b23 0x93a0 0x24eb 0x6cb6 0x9389 0x257e 0x6e49 0x9371 0x25fe 0x6fdd 0x9359 0x265f 0x7170 0x9340 0x26a8 0x7303 0x9328 0x2735 0x7497 0x9309 0x280c 0x762a 0x92e3 0x28dc 0x77bd 0x92bb 0x29a6 0x7951 0x9292 0x2a6f 0x7ae4 0x926a 0x2b39 0x7c77 0x923a 0x2c4f 0x7e0b 0x9204 0x2d4d 0x7f9e 0x91cb 0x2e3f 0x8131 0x9191 0x2f3f 0x82c5 0x9151 0x306e 0x8458 0x9110 0x31b0 0x85eb 0x90d6 0x332f 0x877f 0x90a1 0x34e2 0x8912 0x9073 0x36d8 0x8aa5 0x904b 0x3938 0x8c39 0x902b 0x3be5 0x8dcc 0x9004 0x3e43 0x8f5f 0x8fc1 0x4076 0x90f3 0x8f40 0x42af 0x9286 0x8e56 0x4522 0x9419 0x8ca2 0x47a7 0x95ad 0x8a4a 0x47e5 0x9740 0x86f2 0x4005 0x98d3 0x8183 0x3287 0x9a67 0x7f08 0x2c24 0x9bfa 0x7f08 0x2c24>;
		battery1_profile_t4_num = <0x64>;
		battery2_name = "N6_NVT_4V4_4000mah";
		battery2_profile_t0 = <0x0 0xaa46 0x384 0x196 0xa9c4 0x384 0x32d 0xa948 0x394 0x4c3 0xa8ca 0x392 0x659 0xa84d 0x38a 0x7ef 0xa7db 0x39b 0x986 0xa761 0x387 0xb1c 0xa6e7 0x384 0xcb2 0xa672 0x391 0xe48 0xa5fd 0x395 0xfdf 0xa584 0x387 0x1175 0xa513 0x39b 0x130b 0xa499 0x39d 0x14a1 0xa425 0x39d 0x1638 0xa3b3 0x3a6 0x17ce 0xa340 0x3b1 0x1964 0xa2c6 0x39d 0x1afa 0xa25c 0x3b1 0x1c91 0xa1ec 0x3b6 0x1e27 0xa17b 0x3b6 0x1fbd 0xa10b 0x3bc 0x2154 0xa0a2 0x3cf 0x22ea 0xa038 0x3cf 0x2480 0x9fcd 0x3cf 0x2616 0x9f5d 0x3cf 0x27ad 0x9ef2 0x3cf 0x2943 0x9e91 0x3d3 0x2ad9 0x9e2f 0x3e7 0x2c6f 0x9dd5 0x3fb 0x2e06 0x9d70 0x401 0x2f9c 0x9d0b 0x401 0x3132 0x9cab 0x406 0x32c8 0x9c52 0x41a 0x345f 0x9c01 0x41a 0x35f5 0x9ba9 0x41a 0x378b 0x9b54 0x425 0x3921 0x9b03 0x441 0x3ab8 0x9ab2 0x465 0x3c4e 0x9a60 0x465 0x3de4 0x9a08 0x477 0x3f7b 0x99a9 0x47e 0x4111 0x9937 0x454 0x42a7 0x98b0 0x3fa 0x443d 0x9836 0x3d1 0x45d4 0x97d3 0x3bc 0x476a 0x9783 0x3b6 0x4900 0x973e 0x3b6 0x4a96 0x96fd 0x3b6 0x4c2d 0x96bd 0x3b6 0x4dc3 0x9684 0x3b6 0x4f59 0x964b 0x3a6 0x50ef 0x9616 0x3a8 0x5286 0x95e6 0x3b6 0x541c 0x95b5 0x3b6 0x55b2 0x9584 0x3b6 0x5748 0x9553 0x3a4 0x58df 0x9528 0x3aa 0x5a75 0x9503 0x3be 0x5c0b 0x94e1 0x3cf 0x5da1 0x94b8 0x3cf 0x5f38 0x948f 0x3cf 0x60ce 0x946d 0x3de 0x6264 0x944c 0x3f2 0x63fb 0x942e 0x406 0x6591 0x9415 0x41a 0x6727 0x93f5 0x41a 0x68bd 0x93d4 0x41a 0x6a54 0x93aa 0x40e 0x6bea 0x9370 0x3eb 0x6d80 0x9327 0x3b3 0x6f16 0x92dd 0x39f 0x70ad 0x92aa 0x3af 0x7243 0x9279 0x3b6 0x73d9 0x924c 0x3bf 0x756f 0x9220 0x3c7 0x7706 0x91e7 0x39e 0x789c 0x91c6 0x3b1 0x7a32 0x91a0 0x3b6 0x7bc8 0x917b 0x3c0 0x7d5f 0x9152 0x3c9 0x7ef5 0x9111 0x3b6 0x808b 0x90d0 0x3b6 0x8222 0x9095 0x3b6 0x83b8 0x9053 0x3b6 0x854e 0x900a 0x3af 0x86e4 0x8fc7 0x39d 0x887b 0x8fae 0x39d 0x8a11 0x8fa5 0x3c1 0x8ba7 0x8f97 0x3dd 0x8d3d 0x8f87 0x3fa 0x8ed4 0x8f6d 0x422 0x906a 0x8f2c 0x44b 0x9200 0x8e0d 0x3e9 0x9396 0x8c63 0x3fc 0x952d 0x8a34 0x444 0x96c3 0x8750 0x4b2 0x9859 0x8331 0x5ef 0x99ef 0x7a97 0x10ba 0x9b86 0x708a 0x87f 0x9d1c 0x708a 0x87f>;
		battery2_profile_t0_col = <0x3>;
		battery2_profile_t0_num = <0x64>;
		battery2_profile_t1 = <0x0 0xaad2 0x4e2 0x196 0xaa50 0x4e2 0x32d 0xa9d4 0x4e2 0x4c3 0xa95a 0x4e2 0x659 0xa8e0 0x4e2 0x7ef 0xa867 0x4e2 0x986 0xa7ed 0x4e2 0xb1c 0xa773 0x4e2 0xcb2 0xa6f9 0x4d5 0xe48 0xa682 0x4d1 0xfdf 0xa60f 0x4e2 0x1175 0xa595 0x4e2 0x130b 0xa523 0x4e2 0x14a1 0xa4ac 0x4e2 0x1638 0xa435 0x4e2 0x17ce 0xa3c4 0x4e7 0x1964 0xa352 0x4fb 0x1afa 0xa2e0 0x4fb 0x1c91 0xa26e 0x4fb 0x1e27 0xa1fb 0x506 0x1fbd 0xa18b 0x51b 0x2154 0xa121 0x52d 0x22ea 0xa0b8 0x52d 0x2480 0xa047 0x52d 0x2616 0x9fda 0x53a 0x27ad 0x9f77 0x54e 0x2943 0x9f1e 0x563 0x2ad9 0x9ec5 0x577 0x2c6f 0x9e5c 0x58b 0x2e06 0x9df2 0x5a0 0x2f9c 0x9d85 0x5aa 0x3132 0x9d15 0x5aa 0x32c8 0x9cac 0x5aa 0x345f 0x9c4a 0x5aa 0x35f5 0x9bef 0x5ba 0x378b 0x9b9a 0x5ce 0x3921 0x9b49 0x5dc 0x3ab8 0x9af9 0x5e0 0x3c4e 0x9ab8 0x609 0x3de4 0x9a69 0x60e 0x3f7b 0x9a08 0x5f4 0x4111 0x999f 0x5cb 0x42a7 0x9932 0x59f 0x443d 0x98b8 0x562 0x45d4 0x9846 0x512 0x476a 0x97e0 0x4de 0x4900 0x978a 0x4bf 0x4a96 0x9743 0x4b0 0x4c2d 0x9702 0x4b0 0x4dc3 0x96c1 0x4b0 0x4f59 0x9687 0x4b0 0x50ef 0x964e 0x4a5 0x5286 0x9618 0x497 0x541c 0x95e8 0x49b 0x55b2 0x95bf 0x4c4 0x5748 0x958f 0x4b7 0x58df 0x9564 0x4bd 0x5a75 0x953b 0x4c9 0x5c0b 0x9514 0x4cd 0x5da1 0x94f4 0x4e1 0x5f38 0x94cb 0x4e2 0x60ce 0x94a9 0x4f1 0x6264 0x9488 0x4fb 0x63fb 0x9467 0x4fb 0x6591 0x9446 0x4fc 0x6727 0x9426 0x510 0x68bd 0x940c 0x514 0x6a54 0x93f4 0x520 0x6bea 0x93d8 0x526 0x6d80 0x93b7 0x511 0x6f16 0x938e 0x4fd 0x70ad 0x936d 0x4fb 0x7243 0x9347 0x4ed 0x73d9 0x931e 0x4d9 0x756f 0x92f4 0x4c5 0x7706 0x92c3 0x4b1 0x789c 0x929a 0x4b0 0x7a32 0x9272 0x4b0 0x7bc8 0x924d 0x4ba 0x7d5f 0x922b 0x4c9 0x7ef5 0x9201 0x4c9 0x808b 0x91c8 0x4c9 0x8222 0x9189 0x4b8 0x83b8 0x914c 0x4bc 0x854e 0x910e 0x4c9 0x86e4 0x90c4 0x4c6 0x887b 0x9072 0x4b2 0x8a11 0x9054 0x4b0 0x8ba7 0x9041 0x4be 0x8d3d 0x9034 0x4e4 0x8ed4 0x902b 0x51c 0x906a 0x901a 0x545 0x9200 0x8fea 0x56e 0x9396 0x8f41 0x55a 0x952d 0x8df0 0x546 0x96c3 0x8bf7 0x557 0x9859 0x896c 0x59b 0x99ef 0x85b6 0x651 0x9b86 0x7e37 0xd8d 0x9d1c 0x74e0 0x1356>;
		battery2_profile_t1_col = <0x3>;
		battery2_profile_t1_num = <0x64>;
		battery2_profile_t2 = <0x0 0xaaa0 0x852 0x196 0xaa1e 0x84e 0x32d 0xa99c 0x84d 0x4c3 0xa91e 0x858 0x659 0xa8a4 0x866 0x7ef 0xa82b 0x864 0x986 0xa7b1 0x850 0xb1c 0xa737 0x84d 0xcb2 0xa6c2 0x84d 0xe48 0xa64d 0x84d 0xfdf 0xa5d3 0x84a 0x1175 0xa559 0x836 0x130b 0xa4e7 0x847 0x14a1 0xa475 0x84d 0x1638 0xa403 0x856 0x17ce 0xa392 0x866 0x1964 0xa320 0x866 0x1afa 0xa2ae 0x866 0x1c91 0xa23c 0x876 0x1e27 0xa1cb 0x874 0x1fbd 0xa15b 0x873 0x2154 0xa0f2 0x89a 0x22ea 0xa088 0x8ae 0x2480 0xa016 0x89f 0x2616 0x9fb3 0x8a5 0x27ad 0x9f5d 0x8ca 0x2943 0x9f09 0x903 0x2ad9 0x9ea7 0x92c 0x2c6f 0x9e3e 0x955 0x2e06 0x9dbd 0x951 0x2f9c 0x9d2f 0x933 0x3132 0x9ca5 0x91a 0x32c8 0x9c34 0x92f 0x345f 0x9beb 0x958 0x35f5 0x9ba2 0x960 0x378b 0x9b50 0x955 0x3921 0x9af9 0x940 0x3ab8 0x9aa8 0x92e 0x3c4e 0x9a56 0x92e 0x3de4 0x99fe 0x91c 0x3f7b 0x9995 0x8ee 0x4111 0x9923 0x8a9 0x42a7 0x98b3 0x85b 0x443d 0x9849 0x81e 0x45d4 0x97e7 0x7f4 0x476a 0x9792 0x7da 0x4900 0x9744 0x7c6 0x4a96 0x96ff 0x7bc 0x4c2d 0x96c6 0x7cf 0x4dc3 0x9685 0x7bb 0x4f59 0x9651 0x7c7 0x50ef 0x961c 0x7d0 0x5286 0x95e8 0x7d7 0x541c 0x95bf 0x7e9 0x55b2 0x958d 0x7e9 0x5748 0x955c 0x7d7 0x58df 0x9531 0x7de 0x5a75 0x950c 0x7f2 0x5c0b 0x94eb 0x80a 0x5da1 0x94cb 0x833 0x5f38 0x94a2 0x820 0x60ce 0x9480 0x82a 0x6264 0x945f 0x834 0x63fb 0x9441 0x83a 0x6591 0x9428 0x84d 0x6727 0x9408 0x84d 0x68bd 0x93ee 0x84d 0x6a54 0x93d6 0x859 0x6bea 0x93bd 0x866 0x6d80 0x93a5 0x866 0x6f16 0x938c 0x866 0x70ad 0x937b 0x866 0x7243 0x9360 0x866 0x73d9 0x9340 0x866 0x756f 0x931e 0x862 0x7706 0x92f5 0x84e 0x789c 0x92cc 0x84d 0x7a32 0x92a4 0x84d 0x7bc8 0x927b 0x862 0x7d5f 0x924e 0x87f 0x7ef5 0x9215 0x880 0x808b 0x91d4 0x894 0x8222 0x9198 0x8ba 0x83b8 0x915a 0x8d6 0x854e 0x910d 0x8db 0x86e4 0x90b3 0x8d0 0x887b 0x9082 0x8f9 0x8a11 0x906f 0x921 0x8ba7 0x905f 0x958 0x8d3d 0x904f 0x9a8 0x8ed4 0x903b 0xa12 0x906a 0x901a 0xa8c 0x9200 0x8f98 0xadd 0x9396 0x8e42 0xb1f 0x952d 0x8c42 0xb9d 0x96c3 0x8992 0xc99 0x9859 0x85dc 0xe7f 0x99ef 0x7f21 0x1421 0x9b86 0x7256 0xd16 0x9d1c 0x7256 0xd16>;
		battery2_profile_t2_col = <0x3>;
		battery2_profile_t2_num = <0x64>;
		battery2_profile_t3 = <0x0 0xaabe 0xe92 0x196 0xaa34 0xe8e 0x32d 0xa9b0 0xeac 0x4c3 0xa92e 0xebf 0x659 0xa8ae 0xeb2 0x7ef 0xa834 0xe8f 0x986 0xa7b2 0xea3 0xb1c 0xa73e 0xe95 0xcb2 0xa6c7 0xe8d 0xe48 0xa650 0xe85 0xfdf 0xa5dd 0xe71 0x1175 0xa563 0xe5d 0x130b 0xa4e9 0xe48 0x14a1 0xa475 0xe34 0x1638 0xa403 0xe32 0x17ce 0xa394 0xe42 0x1964 0xa32a 0xe42 0x1afa 0xa2b8 0xe42 0x1c91 0xa246 0xe42 0x1e27 0xa1d5 0xe42 0x1fbd 0xa165 0xe42 0x2154 0xa0fb 0xe42 0x22ea 0xa089 0xe42 0x2480 0xa024 0xe42 0x2616 0x9fc7 0xe5c 0x27ad 0x9f6d 0xe8d 0x2943 0x9f14 0xece 0x2ad9 0x9ebb 0xf1f 0x2c6f 0x9e42 0xefc 0x2e06 0x9db1 0xee2 0x2f9c 0x9d1b 0xeba 0x3132 0x9c8d 0xe83 0x32c8 0x9c0c 0xe5c 0x345f 0x9baa 0xe70 0x35f5 0x9b55 0xe74 0x378b 0x9b09 0xe74 0x3921 0x9aba 0xe60 0x3ab8 0x9a60 0xe23 0x3c4e 0x99fe 0xde6 0x3de4 0x99a4 0xdcc 0x3f7b 0x9945 0xdab 0x4111 0x98e4 0xd7a 0x42a7 0x9884 0xd48 0x443d 0x982b 0xd48 0x45d4 0x97d1 0xcfb 0x476a 0x9783 0xd01 0x4900 0x973a 0xd02 0x4a96 0x96f3 0xce9 0x4c2d 0x96b3 0xcfd 0x4dc3 0x967a 0xcfd 0x4f59 0x9641 0xcfd 0x50ef 0x960c 0xd08 0x5286 0x95d9 0xd0f 0x541c 0x95a2 0xcff 0x55b2 0x9579 0xd13 0x5748 0x9551 0xd39 0x58df 0x9528 0xd3b 0x5a75 0x94ff 0xd48 0x5c0b 0x94d8 0xd7a 0x5da1 0x94b8 0xd7a 0x5f38 0x948f 0xd8d 0x60ce 0x946d 0xda2 0x6264 0x9450 0xdb6 0x63fb 0x9436 0xdc5 0x6591 0x9415 0xdc6 0x6727 0x93fd 0xdef 0x68bd 0x93e5 0xe07 0x6a54 0x93d1 0xe1c 0x6bea 0x93bd 0xe29 0x6d80 0x93a7 0xe33 0x6f16 0x939f 0xe85 0x70ad 0x9388 0xe7b 0x7243 0x9370 0xe8f 0x73d9 0x9357 0xec1 0x756f 0x933d 0xef5 0x7706 0x931d 0xf09 0x789c 0x92f4 0xf1e 0x7a32 0x92cc 0xf50 0x7bc8 0x92a3 0xf8d 0x7d5f 0x9276 0xfd0 0x7ef5 0x923d 0x101e 0x808b 0x91fc 0x1032 0x8222 0x91bb 0x10ab 0x83b8 0x917a 0x1121 0x854e 0x9130 0x1178 0x86e4 0x90db 0x11c2 0x887b 0x90a2 0x1264 0x8a11 0x9086 0x12e2 0x8ba7 0x906e 0x13ae 0x8d3d 0x9055 0x14b3 0x8ed4 0x903a 0x15e9 0x906a 0x9011 0x177f 0x9200 0x8fa1 0x1929 0x9396 0x8e68 0x1ac4 0x952d 0x8c7d 0x1ce2 0x96c3 0x89d9 0x2044 0x9859 0x8640 0x25c8 0x99ef 0x8020 0x2eea 0x9b86 0x7576 0x1531 0x9d1c 0x7576 0x1531>;
		battery2_profile_t3_col = <0x3>;
		battery2_profile_t3_num = <0x64>;
		battery2_profile_t4 = <0x0 0xaadc 0x1edc 0x196 0xaa31 0x1edc 0x32d 0xa999 0x1f78 0x4c3 0xa90c 0x1fc0 0x659 0xa881 0x1f9e 0x7ef 0xa7f8 0x1f89 0x986 0xa776 0x1f75 0xb1c 0xa6fb 0x1f50 0xcb2 0xa681 0x1f33 0xe48 0xa607 0x1f10 0xfdf 0xa58d 0x1ed3 0x1175 0xa513 0x1e96 0x130b 0xa499 0x1e7e 0x14a1 0xa425 0x1e5c 0x1638 0xa3b3 0x1e33 0x17ce 0xa344 0x1e14 0x1964 0xa2da 0x1e14 0x1afa 0xa268 0x1e00 0x1c91 0xa1f6 0x1dfb 0x1e27 0xa185 0x1dda 0x1fbd 0xa115 0x1db0 0x2154 0xa0ac 0x1dae 0x22ea 0xa042 0x1d9a 0x2480 0x9fe5 0x1da9 0x2616 0x9f8b 0x1db0 0x27ad 0x9f2b 0x1da8 0x2943 0x9ebd 0x1d9b 0x2ad9 0x9e3b 0x1daf 0x2c6f 0x9da2 0x1d50 0x2e06 0x9cfc 0x1cf9 0x2f9c 0x9c5d 0x1c9e 0x3132 0x9bd3 0x1c3d 0x32c8 0x9b61 0x1bef 0x345f 0x9af8 0x1c18 0x35f5 0x9aa1 0x1bf0 0x378b 0x9a50 0x1be0 0x3921 0x99fc 0x1be7 0x3ab8 0x99a4 0x1bd5 0x3c4e 0x995b 0x1bd5 0x3de4 0x990b 0x1bc3 0x3f7b 0x98ba 0x1bbc 0x4111 0x9869 0x1ba3 0x42a7 0x9817 0x1b71 0x443d 0x97c6 0x1b71 0x45d4 0x9775 0x1b5e 0x476a 0x972f 0x1b3b 0x4900 0x96ea 0x1b4e 0x4a96 0x96a5 0x1b7a 0x4c2d 0x966d 0x1b41 0x4dc3 0x9634 0x1b92 0x4f59 0x95fb 0x1b83 0x50ef 0x95c6 0x1baa 0x5286 0x9596 0x1bf5 0x541c 0x9565 0x1c07 0x55b2 0x9534 0x1c07 0x5748 0x950b 0x1c60 0x58df 0x94e2 0x1c84 0x5a75 0x94bd 0x1c7c 0x5c0b 0x949c 0x1c81 0x5da1 0x947c 0x1cfb 0x5f38 0x945b 0x1d14 0x60ce 0x943b 0x1d37 0x6264 0x9422 0x1d6a 0x63fb 0x9410 0x1dac 0x6591 0x93f8 0x1dfd 0x6727 0x93f0 0x1e4e 0x68bd 0x93db 0x1eb0 0x6a54 0x93c7 0x1eff 0x6bea 0x93b6 0x1f5a 0x6d80 0x93a5 0x1fe3 0x6f16 0x938c 0x2049 0x70ad 0x9374 0x20c0 0x7243 0x935c 0x213a 0x73d9 0x9343 0x21bd 0x756f 0x9329 0x224b 0x7706 0x9309 0x22d9 0x789c 0x92e0 0x2354 0x7a32 0x92b8 0x23ce 0x7bc8 0x928b 0x249b 0x7d5f 0x925a 0x25a6 0x7ef5 0x9229 0x2686 0x808b 0x91f0 0x2765 0x8222 0x91b1 0x2887 0x83b8 0x916b 0x29c4 0x854e 0x9122 0x2b09 0x86e4 0x90db 0x2c63 0x887b 0x90a2 0x2e4a 0x8a11 0x907f 0x308d 0x8ba7 0x905e 0x32f5 0x8d3d 0x903a 0x35b2 0x8ed4 0x9010 0x38fc 0x906a 0x8fdf 0x3d08 0x9200 0x8f5f 0x4013 0x9396 0x8e40 0x4270 0x952d 0x8c76 0x4495 0x96c3 0x89fc 0x4558 0x9859 0x8686 0x3f14 0x99ef 0x8097 0x302c 0x9b86 0x7cb0 0x26ac 0x9d1c 0x7cb0 0x26ac>;
		battery2_profile_t4_col = <0x3>;
		battery2_profile_t4_num = <0x64>;
		compatible = "mediatek,bat_gm30";
		g_FG_PSEUDO100_T0 = <0x64>;
		g_FG_PSEUDO100_T1 = <0x64>;
		g_FG_PSEUDO100_T2 = <0x64>;
		g_FG_PSEUDO100_T3 = <0x64>;
		g_FG_PSEUDO100_T4 = <0x64>;
		linux,phandle = <0x7d>;
		phandle = <0x7d>;
	};

	bpi_bsi_slv0@1021e000 {
		compatible = "mediatek,bpi_bsi_slv0";
		reg = <0x0 0x1021e000 0x0 0x1000>;
	};

	bpi_bsi_slv1@1021f000 {
		compatible = "mediatek,bpi_bsi_slv1";
		reg = <0x0 0x1021f000 0x0 0x6000>;
	};

	bpi_bsi_slv2@10225000 {
		compatible = "mediatek,bpi_bsi_slv2";
		reg = <0x0 0x10225000 0x0 0x1000>;
	};

	btif@1100c000 {
		clock-names = "btifc", "apdmac";
		clocks = <0x25 0x1a 0x25 0x26>;
		compatible = "mediatek,btif";
		interrupts = <0x0 0x70 0x8 0x0 0x84 0x8 0x0 0x85 0x8>;
		reg = <0x0 0x1100c000 0x0 0x1000 0x0 0x11000880 0x0 0x80 0x0 0x11000900 0x0 0x80>;
	};

	bus_dbg@10208000 {
		compatible = "mediatek,bus_dbg-v2";
		interrupts = <0x0 0x8d 0x8>;
		mediatek,bus_dbg_con_offset = <0x2fc>;
		reg = <0x0 0x10208000 0x0 0x1000 0x0 0x10001000 0x0 0x1000>;
	};

	cam1@1a003000 {
		compatible = "mediatek,cam1";
		interrupts = <0x0 0xeb 0x8>;
		reg = <0x0 0x1a003000 0x0 0x1000>;
	};

	cam2@1a004000 {
		compatible = "mediatek,cam2";
		interrupts = <0x0 0xec 0x8>;
		reg = <0x0 0x1a004000 0x0 0x1000>;
	};

	cam3@1a005000 {
		compatible = "mediatek,cam3";
		interrupts = <0x0 0xed 0x8>;
		reg = <0x0 0x1a005000 0x0 0x1000>;
	};

	cam_clear@1a01b000 {
		compatible = "mediatek,cam_clear";
		reg = <0x0 0x1a01b000 0x0 0x1000>;
	};

	cam_inner@1a013000 {
		compatible = "mediatek,cam_inner";
		reg = <0x0 0x1a013000 0x0 0x1000>;
	};

	cam_set@1a00b000 {
		compatible = "mediatek,cam_set";
		reg = <0x0 0x1a00b000 0x0 0x1000>;
	};

	cama_clear@1a01c000 {
		compatible = "mediatek,cama_clear";
		reg = <0x0 0x1a01c000 0x0 0x1000>;
	};

	cama_ext@1a024000 {
		compatible = "mediatek,cama_ext";
		reg = <0x0 0x1a024000 0x0 0x1000>;
	};

	cama_inner@1a014000 {
		compatible = "mediatek,cama_inner";
		reg = <0x0 0x1a014000 0x0 0x1000>;
	};

	cama_set@1a00c000 {
		compatible = "mediatek,cama_set";
		reg = <0x0 0x1a00c000 0x0 0x1000>;
	};

	camb_clear@1a01d000 {
		compatible = "mediatek,camb_clear";
		reg = <0x0 0x1a01d000 0x0 0x1000>;
	};

	camb_ext@1a025000 {
		compatible = "mediatek,camb_ext";
		reg = <0x0 0x1a025000 0x0 0x1000>;
	};

	camb_inner@1a015000 {
		compatible = "mediatek,camb_inner";
		reg = <0x0 0x1a015000 0x0 0x1000>;
	};

	camb_set@1a00d000 {
		compatible = "mediatek,camb_set";
		reg = <0x0 0x1a00d000 0x0 0x1000>;
	};

	camsv1@1a050000 {
		compatible = "mediatek,camsv1";
		interrupts = <0x0 0xf3 0x8>;
		reg = <0x0 0x1a050000 0x0 0x1000>;
	};

	camsv2@1a051000 {
		compatible = "mediatek,camsv2";
		interrupts = <0x0 0xf4 0x8>;
		reg = <0x0 0x1a051000 0x0 0x1000>;
	};

	camsv3@1a052000 {
		compatible = "mediatek,camsv3";
		interrupts = <0x0 0xf1 0x8>;
		reg = <0x0 0x1a052000 0x0 0x1000>;
	};

	camsv4@1a053000 {
		compatible = "mediatek,camsv4";
		interrupts = <0x0 0xf2 0x8>;
		reg = <0x0 0x1a053000 0x0 0x1000>;
	};

	camsys@1a000000 {
		#clock-cells = <0x1>;
		compatible = "mediatek,camsys", "syscon";
		linux,phandle = <0x43>;
		phandle = <0x43>;
		reg = <0x0 0x1a000000 0x0 0x1000>;
	};

	ccu@1a0b0000 {
		clock-names = "CCU_CLK_CAM_CCU";
		clocks = <0x43 0x8>;
		compatible = "mediatek,ccu";
		interrupts = <0x0 0xf6 0x8>;
		reg = <0x0 0x1a0b1000 0x0 0x1000>;
	};

	charger {
		ac_charger_current = <0x1e8480>;
		ac_charger_input_current = <0x1e8480>;
		afc_charger_input_current = <0x186a00>;
		afc_data_gpio = <0x20 0x2a 0x0>;
		afc_data_gpio_num = <0x2a>;
		afc_ichg_level_threshold = <0xf4240>;
		afc_max_charger_voltage = <0x895440>;
		afc_min_charger_voltage = <0x401640>;
		afc_pre_input_curret = <0x7a120>;
		afc_start_battery_soc = <0x0>;
		afc_stop_battery_soc = <0x55>;
		afc_switch_gpio = <0x20 0x9f 0x0>;
		afc_switch_gpio_num = <0x9f>;
		algorithm_name = "SwitchCharging";
		apple_1_0a_charger_current = <0x9eb10>;
		apple_2_1a_charger_current = <0xc3500>;
		battery_cv = <0x432380>;
		bif_cv_under_threshold2 = <0x43e6d0>;
		bif_threshold1 = <0x40d990>;
		bif_threshold2 = <0x419ce0>;
		cable_imp_threshold = <0x2bb>;
		charging_host_charger_current = <0x16e360>;
		chg1_ta_ac_charger_current = <0x16e360>;
		chg2_ta_ac_charger_current = <0x16e360>;
		compatible = "mediatek,charger";
		disable_pd_dual;
		dual_polling_ieoc = <0x6ddd0>;
		enable_afc;
		enable_min_charge_temp;
		enable_pe_2;
		enable_sw_jeita;
		enable_type_c;
		high_temp_to_enter_pe40 = <0x27>;
		high_temp_to_leave_pe40 = <0x2e>;
		ibus_err = <0xe>;
		jeita_temp_above_t4_cc = <0x0>;
		jeita_temp_above_t4_cv = <0x3e8fa0>;
		jeita_temp_below_t0_cc = <0x0>;
		jeita_temp_below_t0_cv = <0x432380>;
		jeita_temp_t0_to_t1_cc = <0x61a80>;
		jeita_temp_t0_to_t1_cv = <0x432380>;
		jeita_temp_t1_to_t2_cc = <0x124f80>;
		jeita_temp_t1_to_t2_cv = <0x432380>;
		jeita_temp_t2_to_t3_cc = <0x1e8480>;
		jeita_temp_t2_to_t3_cv = <0x432380>;
		jeita_temp_t3_to_t4_cc = <0x155cc0>;
		jeita_temp_t3_to_t4_cv = <0x3e8fa0>;
		linux,phandle = <0xa5>;
		low_temp_to_enter_pe40 = <0x10>;
		low_temp_to_leave_pe40 = <0xa>;
		max_charge_temp = <0x3c>;
		max_charge_temp_minus_x_degree = <0x3c>;
		max_charger_voltage = <0x989680>;
		max_dmivr_charger_current = <0x155cc0>;
		min_charge_temp = <0x0>;
		min_charge_temp_plus_x_degree = <0x0>;
		min_charger_voltage = <0x4630c0>;
		min_charger_voltage_1 = <0x432380>;
		min_charger_voltage_2 = <0x401640>;
		non_std_ac_charger_current = <0xf4240>;
		pd_ichg_level_threshold = <0xf4240>;
		pd_stop_battery_soc = <0x50>;
		pd_vbus_low_bound = <0x4c4b40>;
		pd_vbus_upper_bound = <0x895440>;
		pe20_ichg_level_threshold = <0x1c1380>;
		pe40_dual_charger_chg1_current = <0x1e8480>;
		pe40_dual_charger_chg2_current = <0x1e8480>;
		pe40_dual_charger_input_current = <0x2dc6c0>;
		pe40_r_cable_1a_lower = <0x229>;
		pe40_r_cable_2a_lower = <0x19f>;
		pe40_r_cable_3a_lower = <0x113>;
		pe40_single_charger_current = <0x2dc6c0>;
		pe40_single_charger_input_current = <0x2dc6c0>;
		pe40_stop_battery_soc = <0x50>;
		pe_ichg_level_threshold = <0xf4240>;
		phandle = <0xa5>;
		power_path_support;
		slave_mivr_diff = <0x186a0>;
		ta_9v_support;
		ta_ac_7v_input_current = <0x30d400>;
		ta_ac_9v_input_current = <0x30d400>;
		ta_ac_charger_current = <0x2ab980>;
		ta_start_battery_soc = <0x0>;
		ta_stop_battery_soc = <0x55>;
		temp_neg_10_thres = <0x0>;
		temp_t0_thres = <0x1>;
		temp_t0_thres_plus_x_degree = <0x1>;
		temp_t1_thres = <0x5>;
		temp_t1_thres_plus_x_degree = <0x6>;
		temp_t2_thres = <0xa>;
		temp_t2_thres_plus_x_degree = <0xb>;
		temp_t3_thres = <0x2d>;
		temp_t3_thres_minus_x_degree = <0x2c>;
		temp_t4_thres = <0x37>;
		temp_t4_thres_minus_x_degree = <0x36>;
		usb_charger_current = <0x7a120>;
		usb_charger_current_configured = <0x7a120>;
		usb_charger_current_suspend = <0x0>;
		usb_charger_current_unconfigured = <0x11170>;
		vbat_cable_imp_threshold = <0x3b8260>;
		vsys_watt = <0x4c4b40>;
	};

	chipid@08000000 {
		compatible = "mediatek,chipid";
		reg = <0x0 0x8000000 0x0 0x4 0x0 0x8000004 0x0 0x4 0x0 0x8000008 0x0 0x4 0x0 0x800000c 0x0 0x4>;
	};

	chosen {
		bootargs = "console=tty0 console=ttyS0,921600n1 vmalloc=400M slub_debug=OFZPU page_owner=on swiotlb=noforce androidboot.hardware=mt6765 maxcpus=8 loop.max_part=7 firmware_class.path=/vendor/firmware";
		kaslr-seed = <0x0 0x0>;
		linux,phandle = <0x4c>;
		phandle = <0x4c>;
	};

	clocks {

		clk26m {
			#clock-cells = <0x0>;
			clock-frequency = <0x18cba80>;
			compatible = "fixed-clock";
			linux,phandle = <0x1f>;
			phandle = <0x1f>;
		};

		clk32k {
			#clock-cells = <0x0>;
			clock-frequency = <0x7d00>;
			compatible = "fixed-clock";
			linux,phandle = <0x1d>;
			phandle = <0x1d>;
		};
	};

	consys@18002000 {
		#address-cells = <0x2>;
		#size-cells = <0x2>;
		clock-names = "conn";
		clocks = <0x26 0x1>;
		compatible = "mediatek,mt6765-consys";
		interrupts = <0x0 0x10b 0x8 0x0 0x10d 0x8 0x0 0x10e 0x1>;
		linux,phandle = <0x1b>;
		phandle = <0x1b>;
		reg = <0x0 0x18002000 0x0 0x1000 0x0 0x10007000 0x0 0x100 0x0 0x10001000 0x0 0x1000 0x0 0x10006000 0x0 0x1000 0x0 0x18007000 0x0 0x1000 0x0 0x180b1000 0x0 0x1000 0x0 0x180a3000 0x0 0x1000 0x0 0x180a5000 0x0 0x800 0x0 0x180c1000 0x0 0x1000 0x0 0x18004000 0x0 0x1000 0x0 0x0 0x0 0x0 0x0 0x0 0x0 0x0 0x0 0x1020e000 0x0 0x1000>;
	};

	cpu_dbgapb@0d410000 {
		compatible = "mediatek,hw_dbg";
		linux,phandle = <0x4e>;
		num = <0x8>;
		phandle = <0x4e>;
		reg = <0x0 0xd410000 0x0 0x1000 0x0 0xd510000 0x0 0x1000 0x0 0xd610000 0x0 0x1000 0x0 0xd710000 0x0 0x1000 0x0 0xd810000 0x0 0x1000 0x0 0xd910000 0x0 0x1000 0x0 0xda10000 0x0 0x1000 0x0 0xdb10000 0x0 0x1000>;
	};

	cpus {
		#address-cells = <0x1>;
		#size-cells = <0x0>;

		cpu-map {

			cluster0 {

				core0 {
					cpu = <0x9>;
				};

				core1 {
					cpu = <0xa>;
				};

				core2 {
					cpu = <0xb>;
				};

				core3 {
					cpu = <0xc>;
				};
			};

			cluster1 {

				core0 {
					cpu = <0xd>;
				};

				core1 {
					cpu = <0xe>;
				};

				core2 {
					cpu = <0xf>;
				};

				core3 {
					cpu = <0x10>;
				};
			};
		};

		cpu@000 {
			clock-frequency = <0x89267940>;
			compatible = "arm,cortex-a53";
			cpu-idle-states = <0x2 0x3 0x4 0x5 0x6 0x7 0x8>;
			device_type = "cpu";
			enable-method = "psci";
			linux,phandle = <0x9>;
			phandle = <0x9>;
			reg = <0x0>;
		};

		cpu@001 {
			clock-frequency = <0x89267940>;
			compatible = "arm,cortex-a53";
			cpu-idle-states = <0x2 0x3 0x4 0x5 0x6 0x7 0x8>;
			device_type = "cpu";
			enable-method = "psci";
			linux,phandle = <0xa>;
			phandle = <0xa>;
			reg = <0x1>;
		};

		cpu@002 {
			clock-frequency = <0x89267940>;
			compatible = "arm,cortex-a53";
			cpu-idle-states = <0x2 0x3 0x4 0x5 0x6 0x7 0x8>;
			device_type = "cpu";
			enable-method = "psci";
			linux,phandle = <0xb>;
			phandle = <0xb>;
			reg = <0x2>;
		};

		cpu@003 {
			clock-frequency = <0x89267940>;
			compatible = "arm,cortex-a53";
			cpu-idle-states = <0x2 0x3 0x4 0x5 0x6 0x7 0x8>;
			device_type = "cpu";
			enable-method = "psci";
			linux,phandle = <0xc>;
			phandle = <0xc>;
			reg = <0x3>;
		};

		cpu@100 {
			clock-frequency = <0x6b49d200>;
			compatible = "arm,cortex-a53";
			cpu-idle-states = <0x2 0x3 0x4 0x5 0x6 0x7 0x8>;
			device_type = "cpu";
			enable-method = "psci";
			linux,phandle = <0xd>;
			phandle = <0xd>;
			reg = <0x100>;
		};

		cpu@101 {
			clock-frequency = <0x6b49d200>;
			compatible = "arm,cortex-a53";
			cpu-idle-states = <0x2 0x3 0x4 0x5 0x6 0x7 0x8>;
			device_type = "cpu";
			enable-method = "psci";
			linux,phandle = <0xe>;
			phandle = <0xe>;
			reg = <0x101>;
		};

		cpu@102 {
			clock-frequency = <0x6b49d200>;
			compatible = "arm,cortex-a53";
			cpu-idle-states = <0x2 0x3 0x4 0x5 0x6 0x7 0x8>;
			device_type = "cpu";
			enable-method = "psci";
			linux,phandle = <0xf>;
			phandle = <0xf>;
			reg = <0x102>;
		};

		cpu@103 {
			clock-frequency = <0x6b49d200>;
			compatible = "arm,cortex-a53";
			cpu-idle-states = <0x2 0x3 0x4 0x5 0x6 0x7 0x8>;
			device_type = "cpu";
			enable-method = "psci";
			linux,phandle = <0x10>;
			phandle = <0x10>;
			reg = <0x103>;
		};

		idle-states {
			entry-method = "arm,psci";

			dpidle {
				arm,psci-suspend-param = <0x1010004>;
				compatible = "arm,idle-state";
				entry-latency-us = <0x320>;
				exit-latency-us = <0x3e8>;
				linux,phandle = <0x7>;
				min-residency-us = <0x7d0>;
				phandle = <0x7>;
			};

			mcdi-cluster {
				arm,psci-suspend-param = <0x1010001>;
				compatible = "arm,idle-state";
				entry-latency-us = <0x258>;
				exit-latency-us = <0x258>;
				linux,phandle = <0x4>;
				min-residency-us = <0x4b0>;
				phandle = <0x4>;
			};

			mcdi-cpu {
				arm,psci-suspend-param = <0x10001>;
				compatible = "arm,idle-state";
				entry-latency-us = <0x258>;
				exit-latency-us = <0x258>;
				linux,phandle = <0x3>;
				min-residency-us = <0x4b0>;
				phandle = <0x3>;
			};

			sodi {
				arm,psci-suspend-param = <0x1010002>;
				compatible = "arm,idle-state";
				entry-latency-us = <0x320>;
				exit-latency-us = <0x3e8>;
				linux,phandle = <0x5>;
				min-residency-us = <0x7d0>;
				phandle = <0x5>;
			};

			sodi3 {
				arm,psci-suspend-param = <0x1010003>;
				compatible = "arm,idle-state";
				entry-latency-us = <0x320>;
				exit-latency-us = <0x3e8>;
				linux,phandle = <0x6>;
				min-residency-us = <0x7d0>;
				phandle = <0x6>;
			};

			standby {
				arm,psci-suspend-param = <0x1>;
				compatible = "arm,idle-state";
				entry-latency-us = <0x258>;
				exit-latency-us = <0x258>;
				linux,phandle = <0x2>;
				min-residency-us = <0x4b0>;
				phandle = <0x2>;
			};

			suspend {
				arm,psci-suspend-param = <0x1010005>;
				compatible = "arm,idle-state";
				entry-latency-us = <0x320>;
				exit-latency-us = <0x3e8>;
				linux,phandle = <0x8>;
				min-residency-us = <0x7d0>;
				phandle = <0x8>;
			};
		};
	};

	cq_dma@10212000 {
		clock-names = "cqdma";
		clocks = <0x25 0x43>;
		compatible = "mediatek,mt-cqdma-v1";
		interrupts = <0x0 0x71 0x8 0x0 0x72 0x8>;
		keep_clock_ao = "yes";
		nr_channel = <0x2>;
		reg = <0x0 0x10212000 0x0 0x80 0x0 0x10212080 0x0 0x80>;
	};

	dbg_apmcu_mp0@0d400000 {
		compatible = "mediatek,dbg_apmcu_mp0";
		reg = <0x0 0xd400000 0x0 0x1000>;
	};

	dbg_apmcu_mp0@0d410000 {
		compatible = "mediatek,dbg_apmcu_mp0";
		reg = <0x0 0xd410000 0x0 0x1000>;
	};

	dbg_apmcu_mp0@0d420000 {
		compatible = "mediatek,dbg_apmcu_mp0";
		reg = <0x0 0xd420000 0x0 0x1000>;
	};

	dbg_apmcu_mp0@0d430000 {
		compatible = "mediatek,dbg_apmcu_mp0";
		reg = <0x0 0xd430000 0x0 0x1000>;
	};

	dbg_apmcu_mp0@0d440000 {
		compatible = "mediatek,dbg_apmcu_mp0";
		reg = <0x0 0xd440000 0x0 0x1000>;
	};

	dbg_apmcu_mp0@0d510000 {
		compatible = "mediatek,dbg_apmcu_mp0";
		reg = <0x0 0xd510000 0x0 0x1000>;
	};

	dbg_apmcu_mp0@0d520000 {
		compatible = "mediatek,dbg_apmcu_mp0";
		reg = <0x0 0xd520000 0x0 0x1000>;
	};

	dbg_apmcu_mp0@0d530000 {
		compatible = "mediatek,dbg_apmcu_mp0";
		reg = <0x0 0xd530000 0x0 0x1000>;
	};

	dbg_apmcu_mp0@0d540000 {
		compatible = "mediatek,dbg_apmcu_mp0";
		reg = <0x0 0xd540000 0x0 0x1000>;
	};

	dbg_apmcu_mp0@0d610000 {
		compatible = "mediatek,dbg_apmcu_mp0";
		reg = <0x0 0xd610000 0x0 0x1000>;
	};

	dbg_apmcu_mp0@0d620000 {
		compatible = "mediatek,dbg_apmcu_mp0";
		reg = <0x0 0xd620000 0x0 0x1000>;
	};

	dbg_apmcu_mp0@0d630000 {
		compatible = "mediatek,dbg_apmcu_mp0";
		reg = <0x0 0xd630000 0x0 0x1000>;
	};

	dbg_apmcu_mp0@0d640000 {
		compatible = "mediatek,dbg_apmcu_mp0";
		reg = <0x0 0xd640000 0x0 0x1000>;
	};

	dbg_apmcu_mp0@0d710000 {
		compatible = "mediatek,dbg_apmcu_mp0";
		reg = <0x0 0xd710000 0x0 0x1000>;
	};

	dbg_apmcu_mp0@0d720000 {
		compatible = "mediatek,dbg_apmcu_mp0";
		reg = <0x0 0xd720000 0x0 0x1000>;
	};

	dbg_apmcu_mp0@0d730000 {
		compatible = "mediatek,dbg_apmcu_mp0";
		reg = <0x0 0xd730000 0x0 0x1000>;
	};

	dbg_apmcu_mp0@0d740000 {
		compatible = "mediatek,dbg_apmcu_mp0";
		reg = <0x0 0xd740000 0x0 0x1000>;
	};

	dbg_apmcu_mp1@0d800000 {
		compatible = "mediatek,dbg_apmcu_mp1";
		reg = <0x0 0xd800000 0x0 0x1000>;
	};

	dbg_apmcu_mp1@0d810000 {
		compatible = "mediatek,dbg_apmcu_mp1";
		reg = <0x0 0xd810000 0x0 0x1000>;
	};

	dbg_apmcu_mp1@0d820000 {
		compatible = "mediatek,dbg_apmcu_mp1";
		reg = <0x0 0xd820000 0x0 0x1000>;
	};

	dbg_apmcu_mp1@0d830000 {
		compatible = "mediatek,dbg_apmcu_mp1";
		reg = <0x0 0xd830000 0x0 0x1000>;
	};

	dbg_apmcu_mp1@0d840000 {
		compatible = "mediatek,dbg_apmcu_mp1";
		reg = <0x0 0xd840000 0x0 0x1000>;
	};

	dbg_apmcu_mp1@0d910000 {
		compatible = "mediatek,dbg_apmcu_mp1";
		reg = <0x0 0xd910000 0x0 0x1000>;
	};

	dbg_apmcu_mp1@0d920000 {
		compatible = "mediatek,dbg_apmcu_mp1";
		reg = <0x0 0xd920000 0x0 0x1000>;
	};

	dbg_apmcu_mp1@0d930000 {
		compatible = "mediatek,dbg_apmcu_mp1";
		reg = <0x0 0xd930000 0x0 0x1000>;
	};

	dbg_apmcu_mp1@0d940000 {
		compatible = "mediatek,dbg_apmcu_mp1";
		reg = <0x0 0xd940000 0x0 0x1000>;
	};

	dbg_apmcu_mp1@0da10000 {
		compatible = "mediatek,dbg_apmcu_mp1";
		reg = <0x0 0xda10000 0x0 0x1000>;
	};

	dbg_apmcu_mp1@0da20000 {
		compatible = "mediatek,dbg_apmcu_mp1";
		reg = <0x0 0xda20000 0x0 0x1000>;
	};

	dbg_apmcu_mp1@0da30000 {
		compatible = "mediatek,dbg_apmcu_mp1";
		reg = <0x0 0xda30000 0x0 0x1000>;
	};

	dbg_apmcu_mp1@0da40000 {
		compatible = "mediatek,dbg_apmcu_mp1";
		reg = <0x0 0xda40000 0x0 0x1000>;
	};

	dbg_apmcu_mp1@0db10000 {
		compatible = "mediatek,dbg_apmcu_mp1";
		reg = <0x0 0xdb10000 0x0 0x1000>;
	};

	dbg_apmcu_mp1@0db20000 {
		compatible = "mediatek,dbg_apmcu_mp1";
		reg = <0x0 0xdb20000 0x0 0x1000>;
	};

	dbg_apmcu_mp1@0db30000 {
		compatible = "mediatek,dbg_apmcu_mp1";
		reg = <0x0 0xdb30000 0x0 0x1000>;
	};

	dbg_apmcu_mp1@0db40000 {
		compatible = "mediatek,dbg_apmcu_mp1";
		reg = <0x0 0xdb40000 0x0 0x1000>;
	};

	dbg_cti@0d020000 {
		compatible = "mediatek,dbg_cti";
		reg = <0x0 0xd020000 0x0 0x10000>;
	};

	dbg_dem@0d0a0000 {
		compatible = "mediatek,dbg_dem";
		interrupts = <0x0 0x8c 0x8>;
		reg = <0x0 0xd0a0000 0x0 0x10000>;
	};

	dbg_etr@0d030000 {
		compatible = "mediatek,dbg_etr";
		reg = <0x0 0xd030000 0x0 0x10000>;
	};

	dbg_funnel@0d040000 {
		compatible = "mediatek,dbg_funnel";
		reg = <0x0 0xd040000 0x0 0x10000>;
	};

	dbg_mdsys1@0d0c0000 {
		compatible = "mediatek,dbg_mdsys1";
		reg = <0x0 0xd0c0000 0x0 0x40000>;
	};

	ddrphy@10015000 {
		compatible = "mediatek,ddrphy";
		reg = <0x0 0x10015000 0x0 0x1000>;
	};

	ddrphy@1001e000 {
		compatible = "mediatek,ddrphy";
		reg = <0x0 0x1001e000 0x0 0x1000>;
	};

	dev_ril_bridge_pdata {
		compatible = "samsung,dev_ril_bridge_pdata";
		status = "okay";
	};

	devapc@10207000 {
		clock-names = "devapc-infra-clock";
		clocks = <0x25 0x28>;
		compatible = "mediatek,devapc";
		interrupts = <0x0 0x8e 0x8>;
		reg = <0x0 0x10207000 0x0 0x1000 0x0 0x1000e000 0x0 0x1000>;
	};

	dfd@10200b00 {
		compatible = "mediatek,dfd";
		mediatek,chain_length = <0xc350>;
		mediatek,enabled = <0x1>;
		mediatek,rg_dfd_timeout = <0xa0>;
		reg = <0x0 0x10200b00 0x0 0x10000>;
	};

	dip1@15022000 {
		compatible = "mediatek,dip1";
		interrupts = <0x0 0xff 0x8>;
		reg = <0x0 0x15022000 0x0 0x3000>;
	};

	disp_aal0@14011000 {
		compatible = "mediatek,disp_aal0";
		interrupts = <0x0 0xde 0x8>;
		reg = <0x0 0x14011000 0x0 0x1000>;
	};

	disp_ccorr0@14010000 {
		compatible = "mediatek,disp_ccorr0";
		interrupts = <0x0 0xdd 0x8>;
		reg = <0x0 0x14010000 0x0 0x1000>;
	};

	disp_color0@1400f000 {
		clock-names = "MDP_COLOR";
		clocks = <0x27 0xc>;
		compatible = "mediatek,disp_color0";
		interrupts = <0x0 0xdc 0x8>;
		linux,phandle = <0x2e>;
		phandle = <0x2e>;
		reg = <0x0 0x1400f000 0x0 0x1000>;
	};

	disp_dither0@14013000 {
		compatible = "mediatek,disp_dither0";
		interrupts = <0x0 0xe0 0x8>;
		reg = <0x0 0x14013000 0x0 0x1000>;
	};

	disp_gamma0@14012000 {
		compatible = "mediatek,disp_gamma0";
		interrupts = <0x0 0xdf 0x8>;
		reg = <0x0 0x14012000 0x0 0x1000>;
	};

	disp_mutex0@14001000 {
		compatible = "mediatek,disp_mutex0";
		interrupts = <0x0 0xd2 0x8>;
		linux,phandle = <0x30>;
		phandle = <0x30>;
		reg = <0x0 0x14001000 0x0 0x1000>;
	};

	disp_ovl0@1400b000 {
		compatible = "mediatek,disp_ovl0";
		interrupts = <0x0 0xd9 0x8>;
		reg = <0x0 0x1400b000 0x0 0x1000>;
	};

	disp_ovl0_2l@1400c000 {
		compatible = "mediatek,disp_ovl0_2l";
		interrupts = <0x0 0xe5 0x8>;
		reg = <0x0 0x1400c000 0x0 0x1000>;
	};

	disp_pwm@1100e000 {
		compatible = "mediatek,disp_pwm";
		reg = <0x0 0x1100e000 0x0 0x1000>;
	};

	disp_rdma0@1400d000 {
		compatible = "mediatek,disp_rdma0";
		interrupts = <0x0 0xda 0x8>;
		reg = <0x0 0x1400d000 0x0 0x1000>;
	};

	disp_rsz0@14015000 {
		compatible = "mediatek,disp_rsz0";
		interrupts = <0x0 0x114 0x8>;
		reg = <0x0 0x14015000 0x0 0x1000>;
	};

	disp_wdma0@1400e000 {
		compatible = "mediatek,disp_wdma0";
		interrupts = <0x0 0xdb 0x8>;
		reg = <0x0 0x1400e000 0x0 0x1000>;
	};

	dispsys {
		clock-names = "MMSYS_MTCMOS", "MMSYS_SMI_COMMON", "MMSYS_SMI_LARB0", "MMSYS_GALS_COMM0", "MMSYS_GALS_COMM1", "MMSYS_DISP_OVL0", "MMSYS_DISP_OVL0_2L", "MMSYS_DISP_RDMA0", "MMSYS_DISP_WDMA0", "MMSYS_DISP_COLOR0", "MMSYS_DISP_CCORR0", "MMSYS_DISP_AAL0", "MMSYS_DISP_GAMMA0", "MMSYS_DISP_DITHER0", "MMSYS_DSI0_MM_CK", "MMSYS_DSI0_IF_CK", "MMSYS_26M", "MMSYS_DISP_RSZ0", "APMIXED_MIPI_26M", "TOP_MUX_DISP_PWM", "DISP_PWM", "TOP_26M", "TOP_UNIVPLL2_D4", "TOP_ULPOSC1_D2", "TOP_ULPOSC1_D8";
		clocks = <0x26 0x3 0x27 0x13 0x27 0x14 0x27 0x15 0x27 0x16 0x27 0x7 0x27 0x8 0x27 0xa 0x27 0xb 0x27 0xc 0x27 0xd 0x27 0xe 0x27 0xf 0x27 0x10 0x27 0x11 0x27 0x1c 0x27 0x1d 0x27 0x9 0x41 0x15 0x1e 0x73 0x25 0x31 0x1f 0x1e 0x1b 0x1e 0x2e 0x1e 0x30>;
		compatible = "mediatek,dispsys";
		mediatek,larb = <0x21>;
	};

	dma-controller@11000580 {
		#dma-cells = <0x1>;
		clock-names = "apdma";
		clocks = <0x25 0x26>;
		compatible = "mediatek,mt6577-uart-dma";
		interrupts = <0x0 0x6d 0x8 0x0 0x6e 0x8 0x0 0x6f 0x8 0x0 0x74 0x8>;
		linux,phandle = <0x32>;
		phandle = <0x32>;
		reg = <0x0 0x11000680 0x0 0x80 0x0 0x11000700 0x0 0x80 0x0 0x11000780 0x0 0x80 0x0 0x11000800 0x0 0x80>;
	};

	dpe@15028000 {
		clock-names = "DPE_CG_IMG_DPE";
		clocks = <0x42 0x3>;
		compatible = "mediatek,dpe";
		interrupts = <0x0 0x100 0x8>;
		reg = <0x0 0x15028000 0x0 0x1000>;
	};

	dramc0@1001d000 {
		compatible = "mediatek,dramc0";
		reg = <0x0 0x1001d000 0x0 0x1000>;
	};

	dramc@1022a000 {
		compatible = "mediatek,dramc";
		reg = <0x0 0x1022a000 0x0 0x2000 0x0 0x10232000 0x0 0x2000 0x0 0x1022c000 0x0 0x1000 0x0 0x10234000 0x0 0x1000 0x0 0x10228000 0x0 0x2000 0x0 0x10230000 0x0 0x2000 0x0 0x1022e000 0x0 0x1000 0x0 0x10236000 0x0 0x1000>;
	};

	dramc_nao@1021d000 {
		compatible = "mediatek,dramc_nao";
		reg = <0x0 0x1021d000 0x0 0x1000>;
	};

	dsi0@14014000 {
		compatible = "mediatek,dsi0";
		interrupts = <0x0 0xe1 0x8>;
		reg = <0x0 0x14014000 0x0 0x1000>;
	};

	dsi_te {
		compatible = "mediatek, DSI_TE-eint";
		linux,phandle = <0x9e>;
		phandle = <0x9e>;
		status = "disabled";
	};

	dvfsp@00110800 {
		compatible = "mediatek,mt6765-dvfsp";
		reg = <0x0 0x110800 0x0 0x1400 0x0 0x110800 0x0 0x1400>;
	};

	dvfsp@10227000 {
		compatible = "mediatek,dvfsp";
		reg = <0x0 0x10227000 0x0 0x1000>;
	};

	dvfsrc@10012000 {
		compatible = "mediatek,dvfsrc";
		reg = <0x0 0x10012000 0x0 0x1000 0x0 0x110780 0x0 0x80>;
	};

	dxcc_sec@10210000 {
		compatible = "mediatek,dxcc_sec";
		interrupts = <0x0 0xa2 0x4>;
		reg = <0x0 0x10210000 0x0 0x1000>;
	};

	dynamic_options {
		compatible = "mediatek,dynamic_options";
		linux,phandle = <0xb6>;
		phandle = <0xb6>;
	};

	eas {
		eff_turn_point = <0x1d3>;
		tiny = <0x32>;
	};

	eem_fsm@1100b000 {
		compatible = "mediatek,eem_fsm";
		interrupts = <0x0 0x7d 0x8>;
		reg = <0x0 0x1100b000 0x0 0x1000>;
	};

	efuse_dbg@10004000 {
		compatible = "mediatek,efuse_dbg";
		reg = <0x0 0x10004000 0x0 0x1000>;
	};

	efusec@11c50000 {
		compatible = "mediatek,efusec";
		reg = <0x0 0x11c50000 0x0 0x10000>;
	};

	emi@10219000 {
		compatible = "mediatek,emi";
		interrupts = <0x0 0x90 0x8>;
		reg = <0x0 0x10219000 0x0 0x1000 0x0 0x10226000 0x0 0x1000 0x0 0x1022d000 0x0 0x1000 0x0 0x10235000 0x0 0x1000>;
	};

	fdvt@1502b000 {
		clock-names = "FD_CLK_IMG_FDVT";
		clocks = <0x42 0x2>;
		compatible = "mediatek,fdvt";
		interrupts = <0x0 0x102 0x8>;
		reg = <0x0 0x1502b000 0x0 0x1000>;
	};

	fhctl@1000ce00 {
		compatible = "mediatek,fhctl";
		reg = <0x0 0x1000ce00 0x0 0x200>;
	};

	finger_fp {
		compatible = "mediatek,finger-fp";
		linux,phandle = <0x78>;
		phandle = <0x78>;
	};

	fingerprint_chipone {
		compatible = "mediatek,finger-chipone";
		linux,phandle = <0x79>;
		phandle = <0x79>;
	};

	firmware {
		linux,phandle = <0xad>;
		phandle = <0xad>;
	};

	flashlight_core {
		compatible = "mediatek,flashlight_core";
		linux,phandle = <0xa0>;
		phandle = <0xa0>;
	};

	flashlights_led191 {
		compatible = "mediatek,flashlights_led191";
		decouple = <0x1>;
		linux,phandle = <0xa2>;
		phandle = <0xa2>;

		channel@1 {
			ct = <0x0>;
			part = <0x0>;
			type = <0x0>;
		};
	};

	flashlights_mt6370 {
		compatible = "mediatek,flashlights_mt6370";
		decouple = <0x1>;
		linux,phandle = <0xa1>;
		phandle = <0xa1>;

		channel@1 {
			ct = <0x0>;
			part = <0x0>;
			type = <0x0>;
		};

		channel@2 {
			ct = <0x1>;
			part = <0x0>;
			type = <0x0>;
		};
	};

	fpsensor_finger {
		compatible = "mediatek,fingerprint";
		fpc,enable-wakeup;
		linux,phandle = <0x7c>;
		phandle = <0x7c>;
	};

	fpsensor_fp_eint {
		compatible = "mediatek,fpsensor_fp_eint";
		int-gpios = <0x20 0xe 0x0>;
		linux,phandle = <0x7a>;
		phandle = <0x7a>;
	};

	fpsensor_fp_eint_n6 {
		compatible = "mediatek,fpsensor_fp_eint_n6";
		int-gpios = <0x20 0x5 0x0>;
		linux,phandle = <0x7b>;
		phandle = <0x7b>;
	};

	gauge_timer {
		compatible = "mediatek,gauge_timer_service";
	};

	gce@10238000 {
		#clock-cells = <0x1>;
		ap_dma_base = <0x18010000 0x17 0xffff0000>;
		audio_base = <0x17000000 0x12 0xffff0000>;
		buf_underrun_event_0 = <0x8c>;
		camsys1_base = <0x180a0000 0x1c 0xffff0000>;
		camsys2_base = <0x180b0000 0x1d 0xffff0000>;
		camsys_base = <0x18080000 0x1b 0xffff0000>;
		clock-names = "GCE", "GCE_TIMER";
		clocks = <0x25 0x9 0x25 0x18>;
		compatible = "mediatek,gce", "syscon";
		conn_peri_base = <0x18820000 0x7 0xffff0000>;
		dip_cq_thread0_frame_done = <0x101>;
		dip_cq_thread10_frame_done = <0x10b>;
		dip_cq_thread11_frame_done = <0x10c>;
		dip_cq_thread12_frame_done = <0x10d>;
		dip_cq_thread13_frame_done = <0x10e>;
		dip_cq_thread14_frame_done = <0x10f>;
		dip_cq_thread15_frame_done = <0x110>;
		dip_cq_thread16_frame_done = <0x111>;
		dip_cq_thread17_frame_done = <0x112>;
		dip_cq_thread18_frame_done = <0x113>;
		dip_cq_thread1_frame_done = <0x102>;
		dip_cq_thread2_frame_done = <0x103>;
		dip_cq_thread3_frame_done = <0x104>;
		dip_cq_thread4_frame_done = <0x105>;
		dip_cq_thread5_frame_done = <0x106>;
		dip_cq_thread6_frame_done = <0x107>;
		dip_cq_thread7_frame_done = <0x108>;
		dip_cq_thread8_frame_done = <0x109>;
		dip_cq_thread9_frame_done = <0x10a>;
		disp_2l_ovl0_frame_done = <0x1c>;
		disp_2l_ovl0_sof = <0x8>;
		disp_aal0_frame_done = <0x22>;
		disp_aal0_sof = <0xd>;
		disp_ccorr0_frame_done = <0x21>;
		disp_ccorr0_sof = <0xc>;
		disp_color0_frame_done = <0x20>;
		disp_color0_sof = <0xb>;
		disp_dither0_frame_done = <0x24>;
		disp_dither0_sof = <0xf>;
		disp_dither_base = <0x14010000 0x2 0xffff0000>;
		disp_dsi0_frame_done = <0x25>;
		disp_dsi0_sof = <0x10>;
		disp_gamma0_frame_done = <0x23>;
		disp_gamma0_sof = <0xe>;
		disp_ovl0_frame_done = <0x1b>;
		disp_ovl0_frame_rst_done_pusle = <0x98>;
		disp_ovl0_sof = <0x7>;
		disp_pwm0_sof = <0x13>;
		disp_rdma0_frame_done = <0x1e>;
		disp_rdma0_sof = <0x9>;
		disp_rsz0_frame_done = <0x1d>;
		disp_rsz0_sof = <0x11>;
		disp_wdma0_frame_done = <0x1f>;
		disp_wdma0_rst_done = <0x93>;
		disp_wdma0_sof = <0xa>;
		dsi0_done_event = <0x8f>;
		dsi0_irq_event = <0x8e>;
		dsi0_te_event = <0x8d>;
		dve_frame_done = <0x114>;
		g3d_config_base = <0x13000000 0x0 0xffff0000>;
		gce_base = <0x18020000 0x18 0xffff0000>;
		gcpu_base = <0x10050000 0xf 0xffff0000>;
		img_dl_relay_sof = <0x12>;
		imgsys_base = <0x15020000 0x4 0xffff0000>;
		infra_na3_base = <0x10010000 0xb 0xffff0000>;
		infra_na4_base = <0x10020000 0xc 0xffff0000>;
		interrupts = <0x0 0x9a 0x8 0x0 0x9b 0x8>;
		jpgdec_done = <0x123>;
		jpgenc_done = <0x122>;
		kp_base = <0x18840000 0x9 0xffff0000>;
		linux,phandle = <0x7e>;
		max_prefetch_cnt = <0x1>;
		mboxes = <0x31 0x0 0x0 0x4 0x31 0x1 0x0 0x4 0x31 0x2 0x0 0x5 0x31 0x3 0x0 0x4 0x31 0x4 0x0 0x4 0x31 0x5 0x0 0x4 0x31 0x6 0x0 0x3 0x31 0x7 0xffffffff 0x2 0x31 0x8 0x0 0x1 0x31 0x9 0x0 0x1 0x31 0xa 0x0 0x1 0x31 0xb 0x0 0x1 0x31 0xc 0x0 0x1 0x31 0xd 0x0 0x1 0x31 0xe 0x0 0x1 0x31 0xf 0x0 0x1>;
		mcucfg_base = <0x10040000 0xe 0xffff0000>;
		mdp_ccorr0 = <0x2f>;
		mdp_ccorr0_frame_done = <0x15>;
		mdp_ccorr0_sof = <0x1>;
		mdp_color0 = <0x2e>;
		mdp_rdma0 = <0x28>;
		mdp_rdma0_frame_done = <0x14>;
		mdp_rdma0_rst_done = <0x97>;
		mdp_rdma0_sof = <0x0>;
		mdp_rsz0 = <0x29>;
		mdp_rsz0_frame_done = <0x16>;
		mdp_rsz0_sof = <0x2>;
		mdp_rsz1 = <0x2a>;
		mdp_rsz1_frame_done = <0x17>;
		mdp_rsz1_sof = <0x3>;
		mdp_tdshp0 = <0x2d>;
		mdp_tdshp0_frame_done = <0x1a>;
		mdp_tdshp0_sof = <0x6>;
		mdp_wdma0 = <0x2b>;
		mdp_wdma_frame_done = <0x19>;
		mdp_wdma_rst_done = <0x94>;
		mdp_wdma_sof = <0x4>;
		mdp_wrot0 = <0x2c>;
		mdp_wrot0_rst_done = <0x95>;
		mdp_wrot0_sof = <0x5>;
		mdp_wrot0_write_frame_done = <0x18>;
		mediatek,mailbox-gce = <0x31>;
		mipitx0_base = <0x11c80000 0x63 0xffff0000>;
		mm_mutex = <0x30>;
		mm_na_base = <0x14020000 0x3 0xffff0000>;
		mmsys_config = <0x27>;
		mmsys_config_base = <0x14000000 0x1 0xffff0000>;
		msdc2_base = <0x17020000 0x14 0xffff0000>;
		msdc3_base = <0x18000000 0x16 0xffff0000>;
		phandle = <0x7e>;
		prefetch_size = <0x60>;
		pwm_sw_base = <0x1100e000 0x63 0xffff0000>;
		reg = <0x0 0x10238000 0x0 0x4000>;
		rsc_frame_done = <0x116>;
		scp_base = <0x10030000 0xd 0xffff0000>;
		scp_sram_base = <0x10000000 0xa 0xffff0000>;
		secure_thread = <0x8 0xa>;
		sram_share_cnt = <0x1>;
		sram_share_engine = <0xa>;
		sram_share_event = <0x2c6>;
		sram_size_cpr_64 = <0x40>;
		stream_done_0 = <0x82>;
		stream_done_1 = <0x83>;
		stream_done_2 = <0x84>;
		stream_done_3 = <0x85>;
		stream_done_4 = <0x86>;
		stream_done_5 = <0x87>;
		stream_done_6 = <0x88>;
		stream_done_7 = <0x89>;
		stream_done_8 = <0x8a>;
		stream_done_9 = <0x8b>;
		thread_count = <0x10>;
		topckgen_base = <0x18830000 0x8 0xffff0000>;
		usb0_base = <0x10200000 0x10 0xffff0000>;
		usb_sif_base = <0x10280000 0x11 0xffff0000>;
		vdec1_base = <0x17030000 0x15 0xffff0000>;
		vdec2_base = <0x18040000 0x19 0xffff0000>;
		vdec3_base = <0x18050000 0x1a 0xffff0000>;
		vdec_base = <0x17010000 0x13 0xffff0000>;
		vdec_gcon_base = <0x18800000 0x5 0xffff0000>;
		venc_128byte_cnt_done = <0x125>;
		venc_done = <0x121>;
		venc_gcon_base = <0x18810000 0x6 0xffff0000>;
		venc_mb_done = <0x124>;
		wmf_frame_done = <0x115>;
	};

	gce_mbox@10238000 {
		#gce-event-cells = <0x1>;
		#gce-subsys-cells = <0x2>;
		#mbox-cells = <0x3>;
		clock-names = "gce", "GCE_TIMER";
		clocks = <0x25 0x9 0x25 0x18>;
		compatible = "mediatek,mailbox-gce";
		interrupts = <0x0 0x9a 0x8 0x0 0x9b 0x8>;
		linux,phandle = <0x31>;
		phandle = <0x31>;
		reg = <0x0 0x10238000 0x0 0x4000>;
	};

	gce_mbox_svp@10238000 {
		#mbox-cells = <0x3>;
		clock-names = "gce", "GCE_TIMER";
		clocks = <0x25 0x9 0x25 0x18>;
		compatible = "mediatek,mailbox-gce-svp";
		interrupts = <0x0 0x9a 0x8 0x0 0x9b 0x8>;
		linux,phandle = <0x7f>;
		phandle = <0x7f>;
		reg = <0x0 0x10238000 0x0 0x4000>;
	};

	gic500@0c000000 {
		compatible = "mediatek,gic500";
		reg = <0x0 0xc000000 0x0 0x1000>;
	};

	gic_cpu@0c400000 {
		compatible = "mediatek,gic_cpu";
		reg = <0x0 0xc400000 0x0 0x40000>;
	};

	gpio {
		compatible = "mediatek,gpio_usage_mapping";
		linux,phandle = <0x50>;
		phandle = <0x50>;
	};

	gpio@10005000 {
		compatible = "mediatek,gpio";
		linux,phandle = <0x51>;
		phandle = <0x51>;
		reg = <0x0 0x10005000 0x0 0x1000>;
	};

	gps {
		compatible = "mediatek,gps";
	};

	gpufreq {
		clock-names = "clk_mux", "clk_main_parent", "clk_sub_parent", "mtcmos_mfg_async", "mtcmos_mfg", "mtcmos_mfg_core0";
		clocks = <0x1e 0x64 0x1e 0x26 0x1f 0x26 0x8 0x26 0x4 0x26 0x7>;
		compatible = "mediatek,mt6765-gpufreq";
	};

	hacc@1000a000 {
		compatible = "mediatek,hacc";
		interrupts = <0x0 0xbd 0x8>;
		reg = <0x0 0x1000a000 0x0 0x1000>;
	};

	i2c0@11007000 {
		aed = <0x1a>;
		clock-div = <0x5>;
		clock-names = "main", "dma";
		clocks = <0x25 0xb 0x25 0x26>;
		compatible = "mediatek,i2c";
		eh_cfg = <0x20>;
		gpio_start = <0x10002a00>;
		id = <0x0>;
		interrupts = <0x0 0x54 0x8>;
		linux,phandle = <0x84>;
		mediatek,hs_only;
		mem_len = <0x200>;
		phandle = <0x84>;
		pu_cfg = <0x50>;
		reg = <0x0 0x11007000 0x0 0x1000 0x0 0x11000080 0x0 0x80>;
		rsel_cfg = <0x70>;
		scl-gpio-id = <0x53>;
		sda-gpio-id = <0x52>;
	};

	i2c1@11008000 {
		aed = <0x1a>;
		clock-div = <0x5>;
		clock-names = "main", "dma";
		clocks = <0x25 0xb 0x25 0x26>;
		compatible = "mediatek,i2c";
		eh_cfg = <0x20>;
		gpio_start = <0x10002a00>;
		id = <0x1>;
		interrupts = <0x0 0x55 0x8>;
		linux,phandle = <0x85>;
		mediatek,hs_only;
		mem_len = <0x200>;
		phandle = <0x85>;
		pu_cfg = <0x50>;
		reg = <0x0 0x11008000 0x0 0x1000 0x0 0x11000100 0x0 0x80>;
		rsel_cfg = <0x70>;
		scl-gpio-id = <0x54>;
		sda-gpio-id = <0x51>;
	};

	i2c2@11009000 {
		aed = <0x1a>;
		ch_offset_ccu = <0x200>;
		ch_offset_default = <0x100>;
		clock-div = <0x5>;
		clock-names = "main", "dma";
		clocks = <0x25 0xb 0x25 0x26>;
		compatible = "mediatek,i2c";
		eh_cfg = <0x20>;
		gpio_start = <0x10002800>;
		id = <0x2>;
		interrupts = <0x0 0x56 0x8>;
		linux,phandle = <0x86>;
		mediatek,hs_only;
		mem_len = <0x200>;
		phandle = <0x86>;
		pu_cfg = <0x60>;
		reg = <0x0 0x11009000 0x0 0x1000 0x0 0x11000180 0x0 0x180>;
		rsel_cfg = <0xa0>;
		scl-gpio-id = <0x67>;
		sda-gpio-id = <0x68>;
	};

	i2c3@1100f000 {
		aed = <0x1a>;
		ch_offset_default = <0x100>;
		clock-div = <0x5>;
		clock-names = "main", "dma";
		clocks = <0x25 0xb 0x25 0x26>;
		compatible = "mediatek,i2c";
		eh_cfg = <0x20>;
		gpio_start = <0x10002600>;
		id = <0x3>;
		interrupts = <0x0 0x57 0x8>;
		linux,phandle = <0x87>;
		mediatek,hs_only;
		mem_len = <0x200>;
		phandle = <0x87>;
		pu_cfg = <0x90>;
		reg = <0x0 0x1100f000 0x0 0x1000 0x0 0x11000300 0x0 0x100>;
		rsel_cfg = <0xb0>;
		scl-gpio-id = <0x32>;
		sda-gpio-id = <0x33>;
	};

	i2c4@11011000 {
		aed = <0x1a>;
		ch_offset_ccu = <0x200>;
		ch_offset_default = <0x100>;
		clock-div = <0x5>;
		clock-names = "main", "dma";
		clocks = <0x25 0xb 0x25 0x26>;
		compatible = "mediatek,i2c";
		eh_cfg = <0x20>;
		gpio_start = <0x10002800>;
		id = <0x4>;
		interrupts = <0x0 0x58 0x8>;
		linux,phandle = <0x88>;
		mediatek,hs_only;
		mem_len = <0x200>;
		phandle = <0x88>;
		pu_cfg = <0x60>;
		reg = <0x0 0x11011000 0x0 0x1000 0x0 0x11000400 0x0 0x180>;
		rsel_cfg = <0xa0>;
		scl-gpio-id = <0x69>;
		sda-gpio-id = <0x6a>;
	};

	i2c5@11016000 {
		aed = <0x1a>;
		clock-div = <0x5>;
		clock-names = "main", "dma";
		clocks = <0x25 0xb 0x25 0x26>;
		compatible = "mediatek,i2c";
		eh_cfg = <0x20>;
		gpio_start = <0x10002600>;
		id = <0x5>;
		interrupts = <0x0 0x82 0x8>;
		linux,phandle = <0x89>;
		mediatek,hs_only;
		mem_len = <0x200>;
		phandle = <0x89>;
		pu_cfg = <0x90>;
		reg = <0x0 0x11016000 0x0 0x1000 0x0 0x11000580 0x0 0x80>;
		rsel_cfg = <0xb0>;
		scl-gpio-id = <0x30>;
		sda-gpio-id = <0x31>;
	};

	i2c6@1100d000 {
		aed = <0x1a>;
		ch_offset_ccu = <0x200>;
		ch_offset_default = <0x100>;
		clock-div = <0x5>;
		clock-names = "main", "dma";
		clocks = <0x25 0xb 0x25 0x26>;
		compatible = "mediatek,i2c";
		eh_cfg = <0x20>;
		gpio_start = <0x10002c00>;
		id = <0x6>;
		interrupts = <0x0 0x83 0x8>;
		linux,phandle = <0x8a>;
		mediatek,hs_only;
		mem_len = <0x200>;
		phandle = <0x8a>;
		pu_cfg = <0x50>;
		reg = <0x0 0x1100d000 0x0 0x1000 0x0 0x11000600 0x0 0x80>;
		rsel_cfg = <0x70>;
		scl-gpio-id = <0xa1>;
		sda-gpio-id = <0xa2>;
	};

	i2c7 {
		linux,phandle = <0xaf>;
		phandle = <0xaf>;
	};

	i2c8 {
		linux,phandle = <0xb0>;
		phandle = <0xb0>;
	};

	i2c9 {
		linux,phandle = <0xb1>;
		phandle = <0xb1>;
	};

	i2c_common {
		check_max_freq = [01];
		cnt_constraint = [01];
		compatible = "mediatek,i2c_common";
		dma_support = [02];
		ext_time_config = [18 01];
		idvfs = [01];
		linux,phandle = <0x83>;
		phandle = <0x83>;
		set_dt_div = [01];
		set_ltiming = [01];
		ver = [02];
	};

	imgsys@15020000 {
		#clock-cells = <0x1>;
		clock-names = "ISP_SCP_SYS_DIS", "ISP_SCP_SYS_ISP", "ISP_SCP_SYS_CAM", "ISP_CLK_IMG_DIP", "ISP_CLK_CAM", "ISP_CLK_CAMTG", "ISP_CLK_CAM_SENINF", "ISP_CLK_CAMSV0", "ISP_CLK_CAMSV1", "ISP_CLK_CAMSV2";
		clocks = <0x26 0x3 0x26 0x5 0x26 0x9 0x42 0x1 0x43 0x2 0x43 0x3 0x43 0x4 0x43 0x5 0x43 0x6 0x43 0x7>;
		compatible = "mediatek,imgsys", "syscon";
		linux,phandle = <0x42>;
		phandle = <0x42>;
		reg = <0x0 0x15020000 0x0 0x1000>;
	};

	imp_iic@11017000 {
		compatible = "mediatek,imp_iic";
		reg = <0x0 0x11017000 0x0 0x1000>;
	};

	infra_mbist@1020d000 {
		compatible = "mediatek,infra_mbist";
		reg = <0x0 0x1020d000 0x0 0x1000>;
	};

	infracfg@1020e000 {
		compatible = "mediatek,infracfg";
		reg = <0x0 0x1020e000 0x0 0x1000>;
	};

	infracfg_ao@10001000 {
		#clock-cells = <0x1>;
		compatible = "mediatek,infracfg_ao", "syscon";
		interrupts = <0x0 0x93 0x1>;
		linux,phandle = <0x25>;
		phandle = <0x25>;
		reg = <0x0 0x10001000 0x0 0x1000>;
	};

	interrupt-controller@0c000000 {
		#address-cells = <0x2>;
		#interrupt-cells = <0x3>;
		#redistributor-regions = <0x1>;
		#size-cells = <0x2>;
		compatible = "arm,gic-v3";
		interrupt-controller;
		interrupt-parent = <0x11>;
		interrupts = <0x1 0x9 0x4>;
		linux,phandle = <0x11>;
		phandle = <0x11>;
		reg = <0x0 0xc000000 0x0 0x40000 0x0 0xc100000 0x0 0x200000 0x0 0x10200a80 0x0 0x50>;
	};

	intpol-controller@10200a80 {
		#interrupt-cells = <0x3>;
		compatible = "mediatek,mt6577-sysirq";
		interrupt-controller;
		interrupt-parent = <0x11>;
		linux,phandle = <0x1>;
		phandle = <0x1>;
		reg = <0x0 0x10200a80 0x0 0x50>;
	};

	io_cfg_bl@10002600 {
		compatible = "mediatek,io_cfg_bl";
		reg = <0x0 0x10002600 0x0 0x200>;
	};

	io_cfg_lb@10002400 {
		compatible = "mediatek,io_cfg_lb";
		reg = <0x0 0x10002400 0x0 0x200>;
	};

	io_cfg_lm@10002200 {
		compatible = "mediatek,io_cfg_lm";
		reg = <0x0 0x10002200 0x0 0x200>;
	};

	io_cfg_lt@10002000 {
		compatible = "mediatek,io_cfg_lt";
		reg = <0x0 0x10002000 0x0 0x200>;
	};

	io_cfg_rb@10002a00 {
		compatible = "mediatek,io_cfg_rb";
		reg = <0x0 0x10002a00 0x0 0x200>;
	};

	io_cfg_rr@10002800 {
		compatible = "mediatek,io_cfg_rr";
		reg = <0x0 0x10002800 0x0 0x200>;
	};

	io_cfg_rt@10002c00 {
		compatible = "mediatek,io_cfg_rt";
		reg = <0x0 0x10002c00 0x0 0x200>;
	};

	iocfg_0@10002000 {
		compatible = "mediatek,iocfg_0";
		reg = <0x0 0x10002000 0x0 0x200>;
	};

	iocfg_1@10002200 {
		compatible = "mediatek,iocfg_1";
		reg = <0x0 0x10002200 0x0 0x200>;
	};

	iocfg_2@10002400 {
		compatible = "mediatek,iocfg_2";
		reg = <0x0 0x10002400 0x0 0x200>;
	};

	iocfg_3@10002600 {
		compatible = "mediatek,iocfg_3";
		reg = <0x0 0x10002600 0x0 0x200>;
	};

	iocfg_4@10002800 {
		compatible = "mediatek,iocfg_4";
		reg = <0x0 0x10002800 0x0 0x200>;
	};

	iocfg_5@10002a00 {
		compatible = "mediatek,iocfg_5";
		reg = <0x0 0x10002a00 0x0 0x200>;
	};

	irq_nfc {
		compatible = "mediatek,irq_nfc-eint";
		linux,phandle = <0x9a>;
		phandle = <0x9a>;
	};

	irtx_pwm {
		compatible = "mediatek,irtx-pwm";
		linux,phandle = <0xaa>;
		phandle = <0xaa>;
		pwm_ch = <0x0>;
		pwm_data_invert = <0x0>;
	};

	kd_camera_hw1@1a040000 {
		clock-names = "CLK_TOP_CAMTG_SEL", "CLK_TOP_CAMTG1_SEL", "CLK_TOP_CAMTG2_SEL", "CLK_TOP_CAMTG3_SEL", "CLK_MCLK_6M", "CLK_MCLK_12M", "CLK_MCLK_13M", "CLK_MCLK_48M", "CLK_MCLK_52M", "CLK_MCLK_24M", "CLK_MCLK_26M", "CLK_CAM_SENINF_CG", "CLK_MIPI_C0_26M_CG", "CLK_MIPI_C1_26M_CG", "CLK_MIPI_ANA_0A_CG", "CLK_MIPI_ANA_0B_CG", "CLK_MIPI_ANA_1A_CG", "CLK_MIPI_ANA_1B_CG", "CLK_MIPI_ANA_2A_CG", "CLK_MIPI_ANA_2B_CG", "CLK_TOP_CAMTM_SEL_CG", "CLK_TOP_CAMTM_208_CG", "CLK_SCP_SYS_CAM";
		clocks = <0x1e 0x66 0x1e 0x67 0x1e 0x68 0x1e 0x69 0x1e 0x14 0x1e 0x13 0x1e 0x1d 0x1e 0x11 0x1e 0x1c 0x1e 0x12 0x1f 0x43 0x4 0x41 0xe 0x41 0x12 0x45 0x0 0x46 0x0 0x47 0x0 0x48 0x0 0x49 0x0 0x4a 0x0 0x1e 0x7d 0x1e 0x1a 0x26 0x9>;
		compatible = "mediatek,camera_hw";
		linux,phandle = <0x9f>;
		phandle = <0x9f>;
		reg = <0x0 0x1a040000 0x0 0x1000>;
	};

	kp@10010000 {
		compatible = "mediatek,kp";
		interrupts = <0x0 0xb4 0x2>;
		linux,phandle = <0x1a>;
		phandle = <0x1a>;
		reg = <0x0 0x10010000 0x0 0x1000>;
	};

	l2c_parity {
		compatible = "mediatek,l2c_parity-v1";
		interrupts = <0x0 0x18 0x4 0x0 0x19 0x4>;
	};

	lcm_gpio {
		compatible = "mediatek,lcm_gpio";
		linux,phandle = <0x75>;
		phandle = <0x75>;
	};

	lk_charger {
		ac_charger_current = <0x1e8480>;
		ac_charger_input_current = <0x1e8480>;
		charging_host_charger_current = <0x16e360>;
		compatible = "mediatek,lk_charger";
		enable_anime;
		enable_pd20_reset;
		enable_pe_plus;
		fast_charge_voltage = <0x2dc6c0>;
		linux,phandle = <0xa4>;
		max_charger_voltage = <0x632ea0>;
		non_std_ac_charger_current = <0xf4240>;
		pd_charger_current = <0x7a120>;
		phandle = <0xa4>;
		power_path_support;
		ta_ac_charger_current = <0x1e8480>;
		temp_t1_threshold = <0x0>;
		temp_t3_threshold = <0x2d>;
		temp_t4_threshold = <0x32>;
		usb_charger_current = <0x7a120>;
	};

	m4u@10205000 {
		#iommu-cells = <0x1>;
		cell-index = <0x0>;
		compatible = "mediatek,iommu_v0";
		interrupts = <0x0 0x9e 0x8>;
		linux,phandle = <0x4b>;
		mediatek,larbs = <0x21 0x22 0x23 0x24>;
		phandle = <0x4b>;
		reg = <0x0 0x10205000 0x0 0x1000>;
	};

	mbist@17050000 {
		compatible = "mediatek,mbist";
		reg = <0x0 0x17050000 0x0 0x10000>;
	};

	mbist_ao@10013000 {
		compatible = "mediatek,mbist_ao";
		reg = <0x0 0x10013000 0x0 0x1000>;
	};

	mcdi@0010fc00 {
		compatible = "mediatek,mt6765-mcdi";
		reg = <0x0 0x10fc00 0x0 0x800>;
	};

	mcucfg@10200000 {
		compatible = "mediatek,mcucfg";
		interrupts = <0x0 0x0 0x8>;
		reg = <0x0 0x10200000 0x0 0x1000>;
	};

	mcucfg_mp0_counter@10200000 {
		compatible = "mediatek,mcucfg_mp0_counter";
		reg = <0x0 0x10200000 0x0 0x4000>;
	};

	mcupm_reg@10216000 {
		compatible = "mediatek,mcupm_reg";
		reg = <0x0 0x10216000 0x0 0x1000>;
	};

	mcupm_sram0@10217000 {
		compatible = "mediatek,mcupm_sram0";
		reg = <0x0 0x10217000 0x0 0x1000>;
	};

	mcupm_sram1@10218000 {
		compatible = "mediatek,mcupm_sram1";
		reg = <0x0 0x10218000 0x0 0x1000>;
	};

	mcupm_sram2@10211000 {
		compatible = "mediatek,mcupm_sram2";
		reg = <0x0 0x10211000 0x0 0x1000>;
	};

	mcupm_sram3@10213000 {
		compatible = "mediatek,mcupm_sram3";
		reg = <0x0 0x10213000 0x0 0x1000>;
	};

	md1_sim1_hot_plug_eint {
		linux,phandle = <0xb3>;
		phandle = <0xb3>;
	};

	md1_sim2_hot_plug_eint {
		linux,phandle = <0xb4>;
		phandle = <0xb4>;
	};

	md_ccif0@1020a000 {
		compatible = "mediatek,md_ccif0";
		reg = <0x0 0x1020a000 0x0 0x1000>;
	};

	md_ccif1@1020c000 {
		compatible = "mediatek,md_ccif1";
		reg = <0x0 0x1020c000 0x0 0x1000>;
	};

	md_ccif2@1023d000 {
		compatible = "mediatek,md_ccif2";
		reg = <0x0 0x1023d000 0x0 0x1000>;
	};

	md_ccif3@1023f000 {
		compatible = "mediatek,md_ccif3";
		reg = <0x0 0x1023f000 0x0 0x1000>;
	};

	mdcldma@10014000 {
		clock-names = "scp-sys-md1-main", "infra-cldma-bclk", "infra-ccif-ap", "infra-ccif-md", "infra-ccif1-ap", "infra-ccif1-md", "infra-ccif2-ap", "infra-ccif2-md";
		clocks = <0x26 0x0 0x25 0x32 0x25 0x29 0x25 0x2c 0x25 0x23 0x25 0x24 0x25 0x51 0x25 0x52>;
		compatible = "mediatek,mdcldma";
		interrupts = <0x0 0xa5 0x4 0x0 0x94 0x8 0x0 0x95 0x8 0x0 0x105 0x2>;
		linux,phandle = <0x1c>;
		mediatek,cldma_capability = <0x6>;
		mediatek,md_id = <0x0>;
		phandle = <0x1c>;
		reg = <0x0 0x10014000 0x0 0x1000 0x0 0x1021b000 0x0 0x1000 0x0 0x10209000 0x0 0x1000 0x0 0x1020a000 0x0 0x1000>;
	};

	mdcldmain@1021c000 {
		compatible = "mediatek,mdcldmain";
		reg = <0x0 0x1021c000 0x0 0x400>;
	};

	mdcldmain_ao@10015000 {
		compatible = "mediatek,mdcldmain_ao";
		reg = <0x0 0x10015000 0x0 0x400>;
	};

	mdcldmamisc@1021c800 {
		compatible = "mediatek,mdcldmamisc";
		reg = <0x0 0x1021c800 0x0 0x1000>;
	};

	mdcldmamisc_ao@10015800 {
		compatible = "mediatek,mdcldmamisc_ao";
		reg = <0x0 0x10015800 0x0 0x400>;
	};

	mdcldmaout@1021c400 {
		compatible = "mediatek,mdcldmaout";
		reg = <0x0 0x1021c400 0x0 0x400>;
	};

	mdcldmaout_ao@10015400 {
		compatible = "mediatek,mdcldmaout_ao";
		reg = <0x0 0x10015400 0x0 0x400>;
	};

	mdp_ccorr0@14005000 {
		clock-names = "MDP_CCORR";
		clocks = <0x27 0x1>;
		compatible = "mediatek,mdp_ccorr0";
		interrupts = <0x0 0xe2 0x8>;
		linux,phandle = <0x2f>;
		phandle = <0x2f>;
		reg = <0x0 0x14005000 0x0 0x1000>;
	};

	mdp_rdma0@14004000 {
		clock-names = "MDP_RDMA0";
		clocks = <0x27 0x0>;
		compatible = "mediatek,mdp_rdma0";
		interrupts = <0x0 0xd3 0x8>;
		linux,phandle = <0x28>;
		phandle = <0x28>;
		reg = <0x0 0x14004000 0x0 0x1000>;
	};

	mdp_rsz0@14006000 {
		clock-names = "MDP_RSZ0";
		clocks = <0x27 0x2>;
		compatible = "mediatek,mdp_rsz0";
		interrupts = <0x0 0xd4 0x8>;
		linux,phandle = <0x29>;
		phandle = <0x29>;
		reg = <0x0 0x14006000 0x0 0x1000>;
	};

	mdp_rsz1@14007000 {
		clock-names = "MDP_RSZ1";
		clocks = <0x27 0x3>;
		compatible = "mediatek,mdp_rsz1";
		interrupts = <0x0 0xd5 0x8>;
		linux,phandle = <0x2a>;
		phandle = <0x2a>;
		reg = <0x0 0x14007000 0x0 0x1000>;
	};

	mdp_tdshp0@1400a000 {
		clock-names = "MDP_TDSHP";
		clocks = <0x27 0x4>;
		compatible = "mediatek,mdp_tdshp0";
		linux,phandle = <0x2d>;
		phandle = <0x2d>;
		reg = <0x0 0x1400a000 0x0 0x1000>;
	};

	mdp_wdma0@14008000 {
		clock-names = "MDP_WDMA";
		clocks = <0x27 0x6>;
		compatible = "mediatek,mdp_wdma0";
		interrupts = <0x0 0xd8 0x8>;
		linux,phandle = <0x2b>;
		phandle = <0x2b>;
		reg = <0x0 0x14008000 0x0 0x1000>;
	};

	mdp_wrot0@14009000 {
		clock-names = "MDP_WROT0";
		clocks = <0x27 0x5>;
		compatible = "mediatek,mdp_wrot0";
		interrupts = <0x0 0xd7 0x8>;
		linux,phandle = <0x2c>;
		phandle = <0x2c>;
		reg = <0x0 0x14009000 0x0 0x1000>;
	};

	memory {
		device_type = "memory";
		reg = <0x0 0x40000000 0x0 0x20000000>;
	};

	memory-ssmr-features {
		2d_fr-size = <0x0 0x8000000>;
		compatible = "mediatek,memory-ssmr-features";
		iris-recognition-size = <0x0 0x10000000>;
		linux,phandle = <0xac>;
		phandle = <0xac>;
		prot-sharedmem-size = <0x0 0x8000000>;
		sdsp-firmware-size = <0x0 0x1000000>;
		sdsp-tee-sharedmem-size = <0x0 0x1000000>;
		svp-size = <0x0 0x10000000>;
		ta-elf-size = <0x0 0x1000000>;
		ta-stack-heap-size = <0x0 0x6000000>;
		tui-size = <0x0 0x4000000>;
		wfd-size = <0x0 0x4000000>;
	};

	mfg_cfg@13ffe000 {
		#clock-cells = <0x1>;
		compatible = "mediatek,mfgcfg", "syscon";
		linux,phandle = <0x98>;
		phandle = <0x98>;
		reg = <0x0 0x13ffe000 0x0 0x1000>;
	};

	mfg_doma@13000000 {
		clock-frequency = <0x21f98280>;
		compatible = "mediatek,doma";
		interrupt-names = "RGX";
		interrupts = <0x0 0x103 0x8>;
		reg = <0x0 0x13000000 0x0 0x80000>;
	};

	mif_pdata {
		compatible = "sec_modem,modem_pdata";
		mif,ipc_version = <0x32>;
		mif,link_attrs = <0x7c8>;
		mif,link_name = "shmem";
		mif,link_types = <0x200>;
		mif,modem_net = <0x0>;
		mif,modem_type = <0xa>;
		mif,name = "MT6765ap";
		mif,num_iodevs = <0x5>;
		mif,use_handover = <0x0>;
		status = "okay";

		iodevs {

			io_device_0 {
				iod,app = "RIL";
				iod,attrs = <0x2>;
				iod,format = <0x0>;
				iod,id = <0xec>;
				iod,io_type = <0x0>;
				iod,links = <0x200>;
				iod,minor = <0x1e>;
				iod,name = "umts_boot0";
			};

			io_device_1 {
				iod,app = "RIL";
				iod,attrs = <0x2>;
				iod,format = <0x0>;
				iod,id = <0xec>;
				iod,io_type = <0x0>;
				iod,links = <0x200>;
				iod,minor = <0x1c>;
				iod,name = "umts_ipc0";
			};

			io_device_2 {
				iod,app = "RIL";
				iod,attrs = <0x2>;
				iod,format = <0x0>;
				iod,id = <0xec>;
				iod,io_type = <0x0>;
				iod,links = <0x200>;
				iod,minor = <0x1d>;
				iod,name = "umts_ipc1";
			};

			io_device_3 {
				iod,app = "smdexe";
				iod,attrs = <0x2>;
				iod,format = <0x1>;
				iod,id = <0xec>;
				iod,io_type = <0x0>;
				iod,links = <0x200>;
				iod,minor = <0x3>;
				iod,name = "umts_router";
			};

			io_device_4 {
				iod,app = "CSVT";
				iod,attrs = <0x2>;
				iod,format = <0x1>;
				iod,io_type = <0x0>;
				iod,links = <0x200>;
				iod,minor = <0x1e>;
				iod,name = "umts_csd";
			};
		};
	};

	mipi_rx_ana_csi0a@11c10000 {
		#clock-cells = <0x1>;
		compatible = "mediatek,mipi_rx_ana_csi0a", "syscon";
		linux,phandle = <0x45>;
		phandle = <0x45>;
		reg = <0x0 0x11c10000 0x0 0x1000>;
	};

	mipi_rx_ana_csi0b@11c11000 {
		#clock-cells = <0x1>;
		compatible = "mediatek,mipi_rx_ana_csi0b", "syscon";
		linux,phandle = <0x46>;
		phandle = <0x46>;
		reg = <0x0 0x11c11000 0x0 0x1000>;
	};

	mipi_rx_ana_csi1a@11c12000 {
		#clock-cells = <0x1>;
		compatible = "mediatek,mipi_rx_ana_csi1a", "syscon";
		linux,phandle = <0x47>;
		phandle = <0x47>;
		reg = <0x0 0x11c12000 0x0 0x1000>;
	};

	mipi_rx_ana_csi1b@11c13000 {
		#clock-cells = <0x1>;
		compatible = "mediatek,mipi_rx_ana_csi1b", "syscon";
		linux,phandle = <0x48>;
		phandle = <0x48>;
		reg = <0x0 0x11c13000 0x0 0x1000>;
	};

	mipi_rx_ana_csi2a@11c14000 {
		#clock-cells = <0x1>;
		compatible = "mediatek,mipi_rx_ana_csi2a", "syscon";
		linux,phandle = <0x49>;
		phandle = <0x49>;
		reg = <0x0 0x11c14000 0x0 0x1000>;
	};

	mipi_rx_ana_csi2b@11c15000 {
		#clock-cells = <0x1>;
		compatible = "mediatek,mipi_rx_ana_csi2b", "syscon";
		linux,phandle = <0x4a>;
		phandle = <0x4a>;
		reg = <0x0 0x11c15000 0x0 0x1000>;
	};

	mipi_tx0@11c80000 {
		compatible = "mediatek,mipi_tx0";
		reg = <0x0 0x11c80000 0x0 0x10000>;
	};

	mmdvfs_pmqos {
		cam_freq = "mm_step0", "mm_step1", "mm_step2";
		clock-names = "mmdvfs_clk_mm_sel_ck", "mmdvfs_clk_mmpll_ck", "mmdvfs_clk_univpll1_d2_ck", "mmdvfs_clk_mmpll_d2_ck";
		clocks = <0x1e 0x62 0x1e 0x21 0x1e 0x17 0x1e 0x22>;
		compatible = "mediatek,mmdvfs_pmqos";
		disp_freq = "mm_step0", "mm_step1", "mm_step2";
		img_freq = "mm_step0", "mm_step1", "mm_step2";
		mdp_freq = "mm_step0", "mm_step1", "mm_step2";
		mm_step0 = <0x1c9 0x1 0x0 0x1>;
		mm_step1 = <0x138 0x1 0x0 0x2>;
		mm_step2 = <0xe4 0x1 0x0 0x3>;
		vdec_freq = "mm_step0", "mm_step1", "mm_step2";
		venc_freq = "mm_step0", "mm_step1", "mm_step2";
		vopp_steps = <0x0 0x1 0x3>;
	};

	mmsys_config@14000000 {
		#clock-cells = <0x1>;
		clock-names = "CAM_MDP", "IMG_DL_RELAY", "IMG_DL_ASYNC_TOP";
		clocks = <0x27 0x17 0x27 0x1a 0x27 0x1b>;
		compatible = "mediatek,mmsys_config", "syscon";
		interrupts = <0x0 0xe3 0x8>;
		linux,phandle = <0x27>;
		phandle = <0x27>;
		reg = <0x0 0x14000000 0x0 0x1000>;
	};

	mobicore {
		compatible = "trustonic,mobicore";
		interrupts = <0x0 0x10f 0x1>;
	};

	modem_temp_share@10018000 {
		compatible = "mediatek,modem_temp_share";
		reg = <0x0 0x10018000 0x0 0x1000>;
	};

	mrdump_ext_rst {
		compatible = "mediatek, mrdump_ext_rst-eint";
		force_mode = "SYSRST";
		linux,phandle = <0x74>;
		mode = "RST";
		phandle = <0x74>;
		status = "okay";
	};

	msdc0_pad_macro@11cd0000 {
		compatible = "mediatek,msdc0_pad_macro";
		reg = <0x0 0x11cd0000 0x0 0x10000>;
	};

	msdc0_top@11cd0000 {
		compatible = "mediatek,msdc0_top";
		reg = <0x0 0x11cd0000 0x0 0x1000>;
	};

	msdc1_ins@0 {
		compatible = "mediatek,mt6765-sdcard-ins";
		linux,phandle = <0x96>;
		phandle = <0x96>;
	};

	msdc1_pad_macro@11c90000 {
		compatible = "mediatek,msdc1_pad_macro";
		reg = <0x0 0x11c90000 0x0 0x10000>;
	};

	msdc1_top@11c90000 {
		compatible = "mediatek,msdc1_top";
		reg = <0x0 0x11c90000 0x0 0x1000>;
	};

	msdc@11230000 {
		bootable;
		bus-width = <0x8>;
		cap-mmc-highspeed;
		clk_src = [01];
		clock-names = "msdc0-clock", "msdc0-hclock", "msdc0-aes-clock";
		clocks = <0x25 0x4c 0x25 0x1c 0x25 0x44>;
		compatible = "mediatek,msdc";
		host_function = [00];
		index = [00];
		interrupts = <0x0 0x4f 0x8>;
		linux,phandle = <0x92>;
		max-frequency = <0xbebc200>;
		mmc-ddr-1_8v;
		mmc-hs200-1_8v;
		mmc-hs400-1_8v;
		no-sd;
		no-sdio;
		non-removable;
		phandle = <0x92>;
		pinctl = <0x33>;
		pinctl_hs200 = <0x35>;
		pinctl_hs400 = <0x34>;
		reg = <0x0 0x11230000 0x0 0x10000>;
		register_setting = <0x36>;
		status = "okay";
		vmmc-supply = <0x37>;
	};

	msdc@11240000 {
		bus-width = <0x4>;
		cap-sd-highspeed;
		cd-gpios = <0x20 0x1 0x0>;
		cd_level = [01];
		clk_src = [02];
		clock-names = "msdc1-clock", "msdc1-hclock";
		clocks = <0x25 0x4d 0x25 0x1d>;
		compatible = "mediatek,msdc";
		host_function = [01];
		index = [01];
		interrupts = <0x0 0x50 0x8>;
		linux,phandle = <0x93>;
		max-frequency = <0xbebc200>;
		no-mmc;
		no-sdio;
		phandle = <0x93>;
		pinctl = <0x38>;
		pinctl_ddr50 = <0x3b>;
		pinctl_sdr104 = <0x39>;
		pinctl_sdr50 = <0x3a>;
		reg = <0x0 0x11240000 0x0 0x10000>;
		register_setting = <0x3c>;
		sd-uhs-ddr50;
		sd-uhs-sdr104;
		sd-uhs-sdr12;
		sd-uhs-sdr25;
		sd-uhs-sdr50;
		status = "okay";
		vmmc-supply = <0x3d>;
		vqmmc-supply = <0x3e>;
	};

	msdc@11250000 {
		compatible = "mediatek,msdc2";
		linux,phandle = <0x94>;
		phandle = <0x94>;
		reg = <0x0 0x11250000 0x0 0x10000>;
		status = "disable";
	};

	msdc@11260000 {
		compatible = "mediatek,msdc3";
		linux,phandle = <0x95>;
		phandle = <0x95>;
		reg = <0x0 0x11250000 0x0 0x10000>;
		status = "disable";
	};

	mt-pmic {
		compatible = "mediatek,mt_pmic";
		interrupt-controller;
		linux,phandle = <0x54>;
		phandle = <0x54>;

		buck_regulators {

			buck_vcore {
				linux,phandle = <0x58>;
				phandle = <0x58>;
				regulator-enable-ramp-delay = <0xdc>;
				regulator-max-microvolt = <0x1406f4>;
				regulator-min-microvolt = <0x7ea5e>;
				regulator-name = "vcore";
				regulator-ramp-delay = <0x186a>;
			};

			buck_vmodem {
				linux,phandle = <0x57>;
				phandle = <0x57>;
				regulator-enable-ramp-delay = <0xdc>;
				regulator-max-microvolt = <0x123716>;
				regulator-min-microvolt = <0x7a120>;
				regulator-name = "vmodem";
				regulator-ramp-delay = <0x186a>;
			};

			buck_vpa {
				linux,phandle = <0x5a>;
				phandle = <0x5a>;
				regulator-enable-ramp-delay = <0xdc>;
				regulator-max-microvolt = <0x37b1d0>;
				regulator-min-microvolt = <0x7a120>;
				regulator-name = "vpa";
				regulator-ramp-delay = <0xc350>;
			};

			buck_vproc {
				linux,phandle = <0x59>;
				phandle = <0x59>;
				regulator-enable-ramp-delay = <0xdc>;
				regulator-max-microvolt = <0x1406f4>;
				regulator-min-microvolt = <0x7ea5e>;
				regulator-name = "vproc";
				regulator-ramp-delay = <0x186a>;
			};

			buck_vs1 {
				linux,phandle = <0x56>;
				phandle = <0x56>;
				regulator-enable-ramp-delay = <0xdc>;
				regulator-max-microvolt = <0x2191c0>;
				regulator-min-microvolt = <0x124f80>;
				regulator-name = "vs1";
				regulator-ramp-delay = <0x30d4>;
			};
		};

		ldo_regulators {

			ldo_vaud28 {
				compatible = "regulator-fixed";
				linux,phandle = <0x6b>;
				phandle = <0x6b>;
				regulator-enable-ramp-delay = <0x108>;
				regulator-max-microvolt = <0x2ab980>;
				regulator-min-microvolt = <0x2ab980>;
				regulator-name = "vaud28";
			};

			ldo_vaux18 {
				compatible = "regulator-fixed";
				linux,phandle = <0x6a>;
				phandle = <0x6a>;
				regulator-enable-ramp-delay = <0x108>;
				regulator-max-microvolt = <0x1b7740>;
				regulator-min-microvolt = <0x1b7740>;
				regulator-name = "vaux18";
			};

			ldo_vcama {
				linux,phandle = <0x64>;
				phandle = <0x64>;
				regulator-enable-ramp-delay = <0x108>;
				regulator-max-microvolt = <0x2ab980>;
				regulator-min-microvolt = <0x2625a0>;
				regulator-name = "vcama";
			};

			ldo_vcamd {
				linux,phandle = <0x65>;
				phandle = <0x65>;
				regulator-enable-ramp-delay = <0x108>;
				regulator-max-microvolt = <0x1b7740>;
				regulator-min-microvolt = <0xf4240>;
				regulator-name = "vcamd";
			};

			ldo_vcamio {
				compatible = "regulator-fixed";
				linux,phandle = <0x66>;
				phandle = <0x66>;
				regulator-enable-ramp-delay = <0x108>;
				regulator-max-microvolt = <0x1b7740>;
				regulator-min-microvolt = <0x1b7740>;
				regulator-name = "vcamio";
			};

			ldo_vcn18 {
				compatible = "regulator-fixed";
				linux,phandle = <0x63>;
				phandle = <0x63>;
				regulator-enable-ramp-delay = <0x108>;
				regulator-max-microvolt = <0x1b7740>;
				regulator-min-microvolt = <0x1b7740>;
				regulator-name = "vcn18";
			};

			ldo_vcn28 {
				compatible = "regulator-fixed";
				linux,phandle = <0x62>;
				phandle = <0x62>;
				regulator-enable-ramp-delay = <0x108>;
				regulator-max-microvolt = <0x2ab980>;
				regulator-min-microvolt = <0x2ab980>;
				regulator-name = "vcn28";
			};

			ldo_vcn33_bt {
				linux,phandle = <0x60>;
				phandle = <0x60>;
				regulator-enable-ramp-delay = <0x108>;
				regulator-max-microvolt = <0x3567e0>;
				regulator-min-microvolt = <0x325aa0>;
				regulator-name = "vcn33_bt";
			};

			ldo_vcn33_wifi {
				linux,phandle = <0x61>;
				phandle = <0x61>;
				regulator-enable-ramp-delay = <0x108>;
				regulator-max-microvolt = <0x3567e0>;
				regulator-min-microvolt = <0x325aa0>;
				regulator-name = "vcn33_wifi";
			};

			ldo_vdram {
				linux,phandle = <0x6e>;
				phandle = <0x6e>;
				regulator-enable-ramp-delay = <0xce4>;
				regulator-max-microvolt = <0x124f80>;
				regulator-min-microvolt = <0x10c8e0>;
				regulator-name = "vdram";
			};

			ldo_vefuse {
				linux,phandle = <0x5f>;
				phandle = <0x5f>;
				regulator-enable-ramp-delay = <0x108>;
				regulator-max-microvolt = <0x325aa0>;
				regulator-min-microvolt = <0x124f80>;
				regulator-name = "vefuse";
			};

			ldo_vemc {
				linux,phandle = <0x37>;
				phandle = <0x37>;
				regulator-enable-ramp-delay = <0x2c>;
				regulator-max-microvolt = <0x325aa0>;
				regulator-min-microvolt = <0x2c4020>;
				regulator-name = "vemc";
			};

			ldo_vfe28 {
				compatible = "regulator-fixed";
				linux,phandle = <0x5b>;
				phandle = <0x5b>;
				regulator-enable-ramp-delay = <0x108>;
				regulator-max-microvolt = <0x2ab980>;
				regulator-min-microvolt = <0x2ab980>;
				regulator-name = "vfe28";
			};

			ldo_vibr {
				linux,phandle = <0x71>;
				phandle = <0x71>;
				regulator-enable-ramp-delay = <0x2c>;
				regulator-max-microvolt = <0x325aa0>;
				regulator-min-microvolt = <0x124f80>;
				regulator-name = "vibr";
			};

			ldo_vio18 {
				compatible = "regulator-fixed";
				linux,phandle = <0x6d>;
				phandle = <0x6d>;
				regulator-enable-ramp-delay = <0x108>;
				regulator-max-microvolt = <0x1b7740>;
				regulator-min-microvolt = <0x1b7740>;
				regulator-name = "vio18";
			};

			ldo_vio28 {
				compatible = "regulator-fixed";
				linux,phandle = <0x6c>;
				phandle = <0x6c>;
				regulator-enable-ramp-delay = <0x108>;
				regulator-max-microvolt = <0x2ab980>;
				regulator-min-microvolt = <0x2ab980>;
				regulator-name = "vio28";
			};

			ldo_vldo28 {
				linux,phandle = <0x67>;
				phandle = <0x67>;
				regulator-enable-ramp-delay = <0x108>;
				regulator-max-microvolt = <0x2dc6c0>;
				regulator-min-microvolt = <0x2ab980>;
				regulator-name = "vldo28";
			};

			ldo_vmc {
				linux,phandle = <0x3e>;
				phandle = <0x3e>;
				regulator-enable-ramp-delay = <0x2c>;
				regulator-max-microvolt = <0x325aa0>;
				regulator-min-microvolt = <0x1b7740>;
				regulator-name = "vmc";
			};

			ldo_vmch {
				linux,phandle = <0x3d>;
				phandle = <0x3d>;
				regulator-enable-ramp-delay = <0x2c>;
				regulator-max-microvolt = <0x325aa0>;
				regulator-min-microvolt = <0x2c4020>;
				regulator-name = "vmch";
			};

			ldo_vrf12 {
				compatible = "regulator-fixed";
				linux,phandle = <0x5e>;
				phandle = <0x5e>;
				regulator-enable-ramp-delay = <0x6e>;
				regulator-max-microvolt = <0x124f80>;
				regulator-min-microvolt = <0x124f80>;
				regulator-name = "vrf12";
			};

			ldo_vrf18 {
				compatible = "regulator-fixed";
				linux,phandle = <0x5d>;
				phandle = <0x5d>;
				regulator-enable-ramp-delay = <0x6e>;
				regulator-max-microvolt = <0x1b7740>;
				regulator-min-microvolt = <0x1b7740>;
				regulator-name = "vrf18";
			};

			ldo_vsim1 {
				linux,phandle = <0x6f>;
				phandle = <0x6f>;
				regulator-enable-ramp-delay = <0x108>;
				regulator-max-microvolt = <0x2f4d60>;
				regulator-min-microvolt = <0x19f0a0>;
				regulator-name = "vsim1";
			};

			ldo_vsim2 {
				linux,phandle = <0x70>;
				phandle = <0x70>;
				regulator-enable-ramp-delay = <0x108>;
				regulator-max-microvolt = <0x2f4d60>;
				regulator-min-microvolt = <0x19f0a0>;
				regulator-name = "vsim2";
			};

			ldo_vsram_others {
				linux,phandle = <0x68>;
				phandle = <0x68>;
				regulator-enable-ramp-delay = <0x6e>;
				regulator-max-microvolt = <0x1406f4>;
				regulator-min-microvolt = <0x7ea5e>;
				regulator-name = "vsram_others";
				regulator-ramp-delay = <0x186a>;
			};

			ldo_vsram_proc {
				linux,phandle = <0x69>;
				phandle = <0x69>;
				regulator-enable-ramp-delay = <0x6e>;
				regulator-max-microvolt = <0x1406f4>;
				regulator-min-microvolt = <0x7ea5e>;
				regulator-name = "vsram_proc";
				regulator-ramp-delay = <0x186a>;
			};

			ldo_vusb33 {
				linux,phandle = <0x72>;
				phandle = <0x72>;
				regulator-enable-ramp-delay = <0x108>;
				regulator-max-microvolt = <0x2f4d60>;
				regulator-min-microvolt = <0x2dc6c0>;
				regulator-name = "vusb33";
			};

			ldo_vxo22 {
				linux,phandle = <0x5c>;
				phandle = <0x5c>;
				regulator-enable-ramp-delay = <0x6e>;
				regulator-max-microvolt = <0x249f00>;
				regulator-min-microvolt = <0x2191c0>;
				regulator-name = "vxo22";
			};
		};

		mt635x-auxadc {
			#io-channel-cells = <0x1>;
			compatible = "mediatek,mt635x-auxadc";
			linux,phandle = <0x55>;
			phandle = <0x55>;

			accdet {
				channel = <0x9>;
			};

			bat_temp {
				channel = <0x3>;
				resistance-ratio = <0x1 0x1>;
			};

			batadc {
				avg-num = <0x80>;
				channel = <0x0>;
				resistance-ratio = <0x3 0x1>;
			};

			chip_temp {
				channel = <0x5>;
			};

			dcxo_temp {
				avg-num = <0x10>;
				channel = <0xd>;
			};

			hpofs_cal {
				avg-num = <0x100>;
				channel = <0xc>;
			};

			isense {
				avg-num = <0x80>;
				channel = <0x1>;
				resistance-ratio = <0x3 0x1>;
			};

			tsx_temp {
				avg-num = <0x80>;
				channel = <0xb>;
			};

			vbif {
				channel = <0xe>;
				resistance-ratio = <0x1 0x1>;
			};

			vcdt {
				channel = <0x2>;
			};

			vcore_temp {
				channel = <0x6>;
			};

			vproc_temp {
				channel = <0x7>;
			};
		};
	};

	mt6357_gauge {
		alias_name = "mt6357";
		compatible = "mediatek,mt6357_gauge";
		gauge_name = "gauge";
	};

	mt6370_pd_eint {
		linux,phandle = <0xa9>;
		phandle = <0xa9>;
	};

	mt6370_pmu_dts {
		#interrupt-cells = <0x1>;
		interrupt-controller;
		linux,phandle = <0xb7>;
		mt6370,intr_gpio = <0x20 0x3 0x0>;
		mt6370,intr_gpio_num = <0x3>;
		phandle = <0xb7>;

		bled {
			compatible = "mediatek,mt6370_pmu_bled";
			interrupt-names = "bled_ocp";
			mt,bl_ocp_level = <0x2>;
			mt,bl_ovp_level = <0x3>;
			mt,bled_flash_ramp = <0x1>;
			mt,bled_name = "mt6370_pmu_bled";
			mt,bled_ramptime = <0x3>;
			mt,chan_en = <0xf>;
			mt,map_linear;
			mt,max_bled_brightness = <0x2aa>;
			mt,pwm_avg_cycle = <0x0>;
			mt,pwm_deglitch = <0x1>;
			mt,pwm_fsample = <0x2>;
			mt,pwm_hys = <0x0>;
			mt,pwm_hys_en = <0x1>;
			mt,use_pwm;
		};

		charger {
			aicr = <0x7a120>;
			charger_name = "primary_chg";
			compatible = "mediatek,mt6370_pmu_charger";
			cv = <0x432380>;
			dc_wdt = <0x3d0900>;
			enable_te;
			enable_wdt;
			ichg = <0x1e8480>;
			ieoc = <0x249f0>;
			interrupt-names = "chg_mivr", "chg_aiclmeasi", "attachi", "ovpctrl_uvp_d_evt", "chg_wdtmri", "chg_vbusov", "chg_tmri", "chg_treg";
			ircmp_resistor = <0x61a8>;
			ircmp_vclamp = <0x7d00>;
			load_switch_name = "primary_load_switch";
			mivr = <0x432380>;
			safety_timer = <0xc>;
		};

		core {
			compatible = "mediatek,mt6370_pmu_core";
			i2cstmr_rst_tmr = <0x0>;
			int_deg = <0x0>;
			int_wdt = <0x0>;
			interrupt-names = "otp", "vdda_ovp", "vdda_uv";
			mrstb_en;
			mrstb_tmr = <0x3>;
		};

		dsv {
			compatible = "mediatek,mt6370_pmu_dsv";
			db_delay = <0x3>;
			db_ext_en = <0x0>;
			db_freq_pm = <0x0>;
			db_periodic_fix = <0x0>;
			db_periodic_mode = <0x0>;
			db_single_pin = <0x0>;
			db_startup = <0x0>;
			db_vbst = <0x1644>;
			db_vneg_20ms = <0x1>;
			db_vneg_disc = <0x0>;
			db_vneg_slew = <0x1>;
			db_vpos_20ms = <0x1>;
			db_vpos_disc = <0x1>;
			db_vpos_slew = <0x1>;
			interrupt-names = "dsv_vneg_ocp", "dsv_vpos_ocp", "dsv_bst_ocp", "dsv_vneg_scp", "dsv_vpos_scp";

			mt6370_dsvn {
				regulator-max-microvolt = <0x5b8d80>;
				regulator-min-microvolt = <0x3d0900>;
				regulator-name = "dsv_neg";
			};

			mt6370_dsvp {
				regulator-max-microvolt = <0x5b8d80>;
				regulator-min-microvolt = <0x3d0900>;
				regulator-name = "dsv_pos";
			};
		};

		ldo {
			compatible = "mediatek,mt6370_pmu_ldo";
			interrupt-names = "ldo_oc";
			ldo_oms = <0x1>;
			ldo_vrc_lt = <0x1>;

			mt6370_ldo {
				regulator-always-on = "yes";
				regulator-boot-on = "yes";
				regulator-max-microvolt = <0x3d0900>;
				regulator-min-microvolt = <0x186a00>;
				regulator-name = "irtx_ldo";
			};
		};

		mt6370_pmu_fled1 {
			compatible = "mediatek,mt6370_pmu_fled1";
			fled_enable = <0x1>;
			interrupt-names = "fled_lvf", "fled2_short", "fled1_short";
			strobe_cur = <0x124f80>;
			strobe_timeout = <0x960>;
			torch_cur = <0x493e0>;
		};

		mt6370_pmu_fled2 {
			compatible = "mediatek,mt6370_pmu_fled2";
			fled_enable = <0x1>;
			strobe_cur = <0xf4240>;
			strobe_timeout = <0x4b0>;
			torch_cur = <0x30d40>;
		};

		rgbled {
			compatible = "mediatek,mt6370_pmu_rgbled";
			interrupt-names = "isink4_short", "isink3_short", "isink2_short", "isink1_short", "isink4_open", "isink3_open", "isink2_open", "isink1_open";
			mt,led_default_trigger = "cc_mode", "cc_mode", "cc_mode", "none";
			mt,led_name = "mt6370_pmu_led1", "mt6370_pmu_led2", "mt6370_pmu_led3", "mt6370_pmu_led4";
		};
	};

	mt6370_pmu_eint {
		linux,phandle = <0xa8>;
		phandle = <0xa8>;
	};

	mt_charger {
		compatible = "mediatek,mt-charger";
		linux,phandle = <0xa3>;
		phandle = <0xa3>;
	};

	mt_soc_anc_pcm {
		compatible = "mediatek,mt_soc_pcm_anc";
	};

	mt_soc_codec_dummy_name {
		compatible = "mediatek,mt_soc_codec_dummy";
	};

	mt_soc_codec_name {
		compatible = "mediatek,mt_soc_codec_63xx";
		use_hp_depop_flow = <0x0>;
		use_ul_260k = <0x0>;
	};

	mt_soc_dai_name {
		compatible = "mediatek,mt_soc_dai_stub";
	};

	mt_soc_deep_buffer_dl_pcm {
		compatible = "mediatek,mt_soc_pcm_deep_buffer_dl";
	};

	mt_soc_dl1_awb_pcm {
		compatible = "mediatek,mt_soc_pcm_dl1_awb";
	};

	mt_soc_dl1_pcm@11220000 {
		clock-names = "aud_afe_clk", "aud_dac_clk", "aud_dac_predis_clk", "aud_adc_clk", "aud_apll22m_clk", "aud_apll1_tuner_clk", "aud_tml_clk", "aud_infra_clk", "mtkaif_26m_clk", "top_mux_audio", "top_mux_audio_int", "top_sys_pll1_d4", "top_mux_aud_1", "top_apll1_ck", "top_mux_aud_eng1", "top_apll1_d8", "apmixed_apll1", "top_clk26m_clk";
		clocks = <0x40 0x0 0x40 0x4 0x40 0x5 0x40 0x3 0x40 0x1 0x40 0x2 0x40 0x6 0x25 0x2b 0x25 0x33 0x1e 0x6f 0x1e 0x70 0x1e 0x3 0x1e 0x71 0x1e 0x29 0x1e 0x72 0x1e 0x2c 0x41 0x8 0x1f>;
		compatible = "mediatek,mt_soc_pcm_dl1";
		interrupts = <0x0 0x99 0x8>;
		linux,phandle = <0x97>;
		phandle = <0x97>;
		reg = <0x0 0x11220000 0x0 0x1000>;
	};

	mt_soc_dl2_pcm {
		compatible = "mediatek,mt_soc_pcm_dl2";
	};

	mt_soc_dummy_pcm {
		compatible = "mediatek,mt_soc_pcm_dummy";
	};

	mt_soc_fm_i2s_awb_pcm {
		compatible = "mediatek,mt_soc_pcm_fm_i2s_awb";
	};

	mt_soc_fm_i2s_pcm {
		compatible = "mediatek,mt_soc_pcm_fm_i2s";
	};

	mt_soc_fm_mrgtx_pcm {
		compatible = "mediatek,mt_soc_pcm_fmtx";
	};

	mt_soc_hp_impedance_pcm {
		compatible = "mediatek,mt_soc_pcm_hp_impedance";
	};

	mt_soc_i2s0_awb_pcm {
		compatible = "mediatek,mt_soc_pcm_i2s0_awb";
	};

	mt_soc_i2s0_pcm {
		compatible = "mediatek,mt_soc_pcm_dl1_i2s0";
	};

	mt_soc_i2s0dl1_pcm {
		compatible = "mediatek,mt_soc_pcm_dl1_i2s0dl1";
	};

	mt_soc_mrgrx_awb_pcm {
		compatible = "mediatek,mt_soc_pcm_mrgrx_awb";
	};

	mt_soc_mrgrx_pcm {
		compatible = "mediatek,mt_soc_pcm_mrgrx";
	};

	mt_soc_pcm_dl1_scp_spk {
		compatible = "mediatek,mt_soc_pcm_dl1_scp_spk";
	};

	mt_soc_pcm_voice_scp {
		compatible = "mediatek,mt_soc_pcm_voice_scp";
	};

	mt_soc_pcm_voice_ultra {
		compatible = "mediatek,mt_soc_pcm_voice_ultra";
	};

	mt_soc_pcm_voice_usb {
		compatible = "mediatek,mt_soc_pcm_voice_usb";
	};

	mt_soc_pcm_voice_usb_echoref {
		compatible = "mediatek,mt_soc_pcm_voice_usb_echoref";
	};

	mt_soc_routing_dai_name {
		compatible = "mediatek,mt_soc_dai_routing";
	};

	mt_soc_routing_pcm {
		compatible = "mediatek,mt_soc_pcm_routing";
	};

	mt_soc_tdmrx_pcm {
		compatible = "mediatek,mt_soc_tdm_capture";
	};

	mt_soc_ul1_pcm {
		compatible = "mediatek,mt_soc_pcm_capture";
	};

	mt_soc_ul2_pcm {
		compatible = "mediatek,mt_soc_pcm_capture2";
	};

	mt_soc_uldlloopback_pcm {
		compatible = "mediatek,mt_soc_pcm_uldlloopback";
	};

	mt_soc_voice_md1 {
		compatible = "mediatek,mt_soc_pcm_voice_md1";
	};

	mt_soc_voice_md1_bt {
		compatible = "mediatek,mt_soc_pcm_voice_md1_bt";
	};

	mt_soc_voice_md2 {
		compatible = "mediatek,mt_soc_pcm_voice_md2";
	};

	mt_soc_voice_md2_bt {
		compatible = "mediatek,mt_soc_pcm_voice_md2_bt";
	};

	mt_soc_voip_bt_in {
		compatible = "mediatek,mt_soc_pcm_bt_dai";
	};

	mt_soc_voip_bt_out {
		compatible = "mediatek,mt_soc_pcm_dl1_bt";
	};

	mtk-btcvsd-snd@18050000 {
		compatible = "mediatek,mtk-btcvsd-snd";
		interrupts = <0x0 0x10a 0x8>;
		linux,phandle = <0x3f>;
		mediatek,infracfg = <0x25>;
		mediatek,offset = <0xf00 0x800 0x140 0x144 0x148>;
		phandle = <0x3f>;
		reg = <0x0 0x18050000 0x0 0x1000 0x0 0x18080000 0x0 0x10000>;
	};

	mtkfb@0 {
		compatible = "mediatek,mtkfb";
		linux,phandle = <0x9b>;
		phandle = <0x9b>;
	};

	nfc {
		compatible = "mediatek,nfc-gpio-v2";
		linux,phandle = <0x99>;
		phandle = <0x99>;
	};

	nfi@11018000 {
		compatible = "mediatek,nfi";
		reg = <0x0 0x11018000 0x0 0x1000>;
	};

	nfiecc@11019000 {
		compatible = "mediatek,nfiecc";
		reg = <0x0 0x11019000 0x0 0x1000>;
	};

	odm {
		compatible = "simple-bus";
		linux,phandle = <0xab>;
		phandle = <0xab>;
	};

	otg_iddig {
		compatible = "mediatek,usb_iddig_bi_eint";
		linux,phandle = <0x73>;
		phandle = <0x73>;
	};

	pd_adapter {
		adapter_name = "pd_adapter";
		compatible = "mediatek,pd_adapter";
		linux,phandle = <0xa6>;
		phandle = <0xa6>;
	};

	pericfg@10003000 {
		#clock-cells = <0x1>;
		compatible = "mediatek,pericfg", "syscon";
		linux,phandle = <0x4f>;
		phandle = <0x4f>;
		reg = <0x0 0x10003000 0x0 0x1000>;
	};

	pinctrl@1000b000 {
		#gpio-cells = <0x2>;
		#interrupt-cells = <0x4>;
		compatible = "mediatek,mt6765-pinctrl";
		gpio-controller;
		interrupt-controller;
		interrupts = <0x0 0xab 0x4>;
		linux,phandle = <0x20>;
		mediatek,pctl-regmap = <0x12 0x13 0x14 0x15 0x16 0x17 0x18 0x19>;
		phandle = <0x20>;
		pins-are-numbered;
		reg = <0x0 0x1000b000 0x0 0x1000>;

		msdc0@default {
			linux,phandle = <0x33>;
			phandle = <0x33>;

			pins_clk {
				drive-strength = [03];
			};

			pins_cmd {
				drive-strength = [03];
			};

			pins_dat {
				drive-strength = [03];
			};

			pins_ds {
				drive-strength = [03];
			};

			pins_rst {
				drive-strength = [03];
			};
		};

		msdc0@hs200 {
			linux,phandle = <0x35>;
			phandle = <0x35>;

			pins_clk {
				drive-strength = [04];
			};

			pins_cmd {
				drive-strength = [03];
			};

			pins_dat {
				drive-strength = [04];
			};

			pins_ds {
				drive-strength = [04];
			};

			pins_rst {
				drive-strength = [03];
			};
		};

		msdc0@hs400 {
			linux,phandle = <0x34>;
			phandle = <0x34>;

			pins_clk {
				drive-strength = [04];
			};

			pins_cmd {
				drive-strength = [03];
			};

			pins_dat {
				drive-strength = [04];
			};

			pins_ds {
				drive-strength = [04];
			};

			pins_rst {
				drive-strength = [03];
			};
		};

		msdc0@register_default {
			cmd_edge = [00];
			linux,phandle = <0x36>;
			phandle = <0x36>;
			rdata_edge = [00];
			wdata_edge = [00];
		};

		msdc1@ddr50 {
			linux,phandle = <0x3b>;
			phandle = <0x3b>;

			pins_clk {
				drive-strength = [03];
			};

			pins_cmd {
				drive-strength = [03];
			};

			pins_dat {
				drive-strength = [03];
			};
		};

		msdc1@default {
			linux,phandle = <0x38>;
			phandle = <0x38>;

			pins_clk {
				drive-strength = [03];
			};

			pins_cmd {
				drive-strength = [03];
			};

			pins_dat {
				drive-strength = [03];
			};
		};

		msdc1@register_default {
			cmd_edge = [00];
			linux,phandle = <0x3c>;
			phandle = <0x3c>;
			rdata_edge = [00];
			wdata_edge = [00];
		};

		msdc1@sdr104 {
			linux,phandle = <0x39>;
			phandle = <0x39>;

			pins_clk {
				drive-strength = [03];
			};

			pins_cmd {
				drive-strength = [03];
			};

			pins_dat {
				drive-strength = [03];
			};
		};

		msdc1@sdr50 {
			linux,phandle = <0x3a>;
			phandle = <0x3a>;

			pins_clk {
				drive-strength = [03];
			};

			pins_cmd {
				drive-strength = [03];
			};

			pins_dat {
				drive-strength = [03];
			};
		};

		msdc3@default {
			linux,phandle = <0x52>;
			phandle = <0x52>;

			pins_clk {
				drive-strength = [04];
			};

			pins_cmd {
				drive-strength = [04];
			};

			pins_dat {
				drive-strength = [04];
			};
		};

		msdc3@register_default {
			cmd_edge = [01];
			linux,phandle = <0x53>;
			phandle = <0x53>;
			rdata_edge = [01];
			wdata_edge = [01];
		};
	};

	plat_sram_flag@0011db00 {
		compatible = "mediatek,plat_sram_flag";
		reg = <0x0 0x10e5f0 0x0 0x10>;
	};

	pmic_clock_buffer_ctrl {
		compatible = "mediatek,pmic_clock_buffer";
		linux,phandle = <0xae>;
		mediatek,clkbuf-config = <0x2 0x1 0x1 0x2 0x0 0x0 0x0>;
		mediatek,clkbuf-driving-current = <0x1 0x1 0x1 0x1 0x1 0x1 0x1>;
		mediatek,clkbuf-quantity = <0x7>;
		phandle = <0xae>;
	};

	pmu {
		compatible = "arm,armv8-pmuv3";
		interrupt-parent = <0x11>;
		interrupts = <0x1 0x7 0x8>;
	};

	psci {
		compatible = "arm,psci-1.0";
		method = "smc";
	};

	pseudo_m4u {
		compatible = "mediatek,mt-pseudo_m4u";
		iommus = <0x4b 0x2>;
	};

	pseudo_m4u-larb0 {
		compatible = "mediatek,mt-pseudo_m4u-port";
		iommus = <0x4b 0x0 0x4b 0x1 0x4b 0x2 0x4b 0x3 0x4b 0x4 0x4b 0x5 0x4b 0x6 0x4b 0x7>;
		mediatek,larbid = <0x0>;
	};

	pseudo_m4u-larb1 {
		compatible = "mediatek,mt-pseudo_m4u-port";
		iommus = <0x4b 0x20 0x4b 0x21>;
		mediatek,larbid = <0x1>;
	};

	pseudo_m4u-larb2 {
		compatible = "mediatek,mt-pseudo_m4u-port";
		iommus = <0x4b 0x40 0x4b 0x41>;
		mediatek,larbid = <0x2>;
	};

	pseudo_m4u-larb3 {
		compatible = "mediatek,mt-pseudo_m4u-port";
		iommus = <0x4b 0x60 0x4b 0x61>;
		mediatek,larbid = <0x3>;
	};

	pwm@11006000 {
		clock-names = "PWM1-main", "PWM2-main", "PWM3-main", "PWM4-main", "PWM5-main", "PWM6-main", "PWM-HCLK-main", "PWM-main";
		clocks = <0x25 0x10 0x25 0x11 0x25 0x12 0x25 0x13 0x25 0x14 0x25 0x30 0x25 0xf 0x25 0x15>;
		compatible = "mediatek,pwm";
		interrupts = <0x0 0x4d 0x8>;
		linux,phandle = <0x8b>;
		phandle = <0x8b>;
		reg = <0x0 0x11006000 0x0 0x10000>;
	};

	pwrap@1000d000 {
		compatible = "mediatek,pwrap";
		interrupts = <0x0 0xb3 0x4>;
		reg = <0x0 0x1000d000 0x0 0x1000>;
	};

	radio_md_cfg {
		compatible = "mediatek,radio_md_cfg";
		linux,phandle = <0xb5>;
		phandle = <0xb5>;
	};

	reserved-memory {
		#address-cells = <0x2>;
		#size-cells = <0x2>;
		linux,phandle = <0x4d>;
		phandle = <0x4d>;
		ranges;

		cccimdee-reserved-memory@48400000 {
			compatible = "mediatek,ccci-md-ee-dump";
			reg = <0x0 0x48400000 0x0 0x1c2000>;
		};

		consys-reserve-memory {
			alignment = <0x0 0x1000000>;
			alloc-ranges = <0x0 0x40000000 0x0 0x80000000>;
			compatible = "mediatek,consys-reserve-memory";
			no-map;
			size = <0x0 0x400000>;
		};

		reserve-memory-scp_share {
			alignment = <0x0 0x1000000>;
			alloc-ranges = <0x0 0x40000000 0x0 0x50000000>;
			compatible = "mediatek,reserve-memory-scp_share";
			no-map;
			size = <0x0 0x300000>;
		};

		reserve-memory-sspm_share {
			alignment = <0x0 0x10000>;
			alloc-ranges = <0x0 0x40000000 0x0 0x60000000>;
			compatible = "mediatek,reserve-memory-sspm_share";
			no-map;
			size = <0x0 0x510000>;
			status = "okay";
		};

		sec-autocomment-reserve-memory@0x47400000 {
			reg = <0x0 0x47400000 0x0 0x10000>;
		};

		sec-extrainfo-reserve-memory@0x47410000 {
			reg = <0x0 0x47410000 0x0 0x3f0000>;
		};

		sec-lastklog@0x46E00000 {
			reg = <0x0 0x46e00000 0x0 0x200000>;
		};

		sec-log-reserve-memory@0x46C00000 {
			reg = <0x0 0x46c00000 0x0 0x200000>;
		};

		sec-logger-reserve-memory@0x47000000 {
			reg = <0x0 0x47000000 0x0 0x400000>;
		};

		wifi-reserve-memory {
			alignment = <0x0 0x1000000>;
			alloc-ranges = <0x0 0x40000000 0x0 0x80000000>;
			compatible = "mediatek,wifi-reserve-memory";
			no-map;
			size = <0x0 0x300000>;
		};
	};

	rt-pd-manager {
		compatible = "mediatek,rt-pd-manager";
	};

	rt9465_slave_chr {
		compatible = "richtek,rt9465";
		linux,phandle = <0xa7>;
		phandle = <0xa7>;
		status = "disabled";
	};

	scp@10500000 {
		compatible = "mediatek,scp";
		core_1 = "enable";
		interrupts = <0x0 0xc0 0x4>;
		reg = <0x0 0x10500000 0x0 0x40000 0x0 0x105c0000 0x0 0x3000 0x0 0x105c4000 0x0 0x1000 0x0 0x105d4000 0x0 0x6000>;
		scp_sramSize = <0x40000>;
		status = "okay";
	};

	scp_dvfs {
		clock-names = "clk_mux", "clk_pll_0", "clk_pll_1", "clk_pll_2", "clk_pll_3", "clk_pll_4", "clk_pll_5", "clk_pll_6";
		clocks = <0x1e 0x63 0x1f 0x1e 0xe 0x1e 0x1a 0x1e 0x2 0x1e 0x17 0x1e 0x6 0x1e 0x19>;
		compatible = "mediatek,scp_dvfs";
	};

	scpsys@10001000 {
		#clock-cells = <0x1>;
		compatible = "mediatek,scpsys", "syscon";
		linux,phandle = <0x26>;
		phandle = <0x26>;
		reg = <0x0 0x10001000 0x0 0x1000 0x0 0x10006000 0x0 0x1000 0x0 0x14002000 0x0 0x1000 0x0 0x1020e000 0x0 0x1000 0x0 0x18004000 0x0 0x1000 0x0 0x18002000 0x0 0x1000>;
	};

	security_ao@1001a000 {
		compatible = "mediatek,security_ao";
		reg = <0x0 0x1001a000 0x0 0x1000>;
	};

	seninf1@1a040000 {
		compatible = "mediatek,seninf1";
		reg = <0x0 0x1a040000 0x0 0x1000>;
	};

	seninf2@1a041000 {
		compatible = "mediatek,seninf2";
		reg = <0x0 0x1a041000 0x0 0x1000>;
	};

	seninf3@1a042000 {
		compatible = "mediatek,seninf3";
		reg = <0x0 0x1a042000 0x0 0x1000>;
	};

	seninf4@1a043000 {
		compatible = "mediatek,seninf4";
		reg = <0x0 0x1a043000 0x0 0x1000>;
	};

	serial@11020000 {
		clock-names = "baud", "bus";
		clocks = <0x1f 0x25 0x16>;
		compatible = "mediatek,mt6758-uart", "mediatek,mt6577-uart";
		dma-names = "tx", "rx";
		dmas = <0x32 0x0 0x32 0x1>;
		interrupts = <0x0 0x5b 0x8>;
		linux,phandle = <0x81>;
		phandle = <0x81>;
		reg = <0x0 0x11002000 0x0 0x1000>;
	};

	serial@11030000 {
		clock-names = "baud", "bus";
		clocks = <0x1f 0x25 0x17>;
		compatible = "mediatek,mt6758-uart", "mediatek,mt6577-uart";
		interrupts = <0x0 0x5c 0x8>;
		linux,phandle = <0x82>;
		phandle = <0x82>;
		reg = <0x0 0x11003000 0x0 0x1000>;
	};

	sleep@10006000 {
		compatible = "mediatek,sleep";
		interrupts = <0x0 0xb5 0x8>;
		reg = <0x0 0x10006000 0x0 0x1000>;
		wakeup-source = <0x1a 0x0 0x4 0x1b 0x1 0x20 0x1c 0x3 0x2000000>;
	};

	sleep_reg_md@1000f000 {
		compatible = "mediatek,sleep_reg_md";
		reg = <0x0 0x1000f000 0x0 0x1000>;
	};

	smart_pa {
		linux,phandle = <0xb2>;
		phandle = <0xb2>;
	};

	smi_common@14002000 {
		clock-names = "mtcmos-mm", "smi-common-gals-comm0", "smi-common-gals-comm1", "smi-common", "mmdvfs_clk_mm_sel_ck", "mmdvfs_clk_mmpll_ck", "mmdvfs_clk_univpll1_d2_ck", "mmdvfs_clk_mmpll_d2_ck";
		clocks = <0x26 0x3 0x27 0x15 0x27 0x16 0x27 0x13 0x1e 0x62 0x1e 0x21 0x1e 0x17 0x1e 0x22>;
		compatible = "mediatek,smi_common";
		larbs = <0x21 0x22 0x23 0x24>;
		mmsys_config = <0x27>;
		nr_larbs = <0x4>;
		reg = <0x0 0x14002000 0x0 0x1000>;
	};

	smi_larb0@14003000 {
		cell-index = <0x0>;
		clock-names = "mtcmos-mm", "mm-larb0";
		clocks = <0x26 0x3 0x27 0x14>;
		compatible = "mediatek,smi_larb0", "mediatek,smi_larb";
		linux,phandle = <0x21>;
		phandle = <0x21>;
		reg = <0x0 0x14003000 0x0 0x1000>;
	};

	smi_larb1@17010000 {
		cell-index = <0x1>;
		clock-names = "mtcmos-vcodec", "venc-larb1";
		clocks = <0x26 0xa 0x44 0x1>;
		compatible = "mediatek,smi_larb1", "mediatek,smi_larb";
		linux,phandle = <0x22>;
		phandle = <0x22>;
		reg = <0x0 0x17010000 0x0 0x1000>;
	};

	smi_larb2@15021000 {
		cell-index = <0x2>;
		clock-names = "mtcmos-isp", "gals-img2mm", "img-larb2";
		clocks = <0x26 0x5 0x27 0x18 0x42 0x0>;
		compatible = "mediatek,smi_larb2", "mediatek,smi_larb";
		linux,phandle = <0x23>;
		phandle = <0x23>;
		reg = <0x0 0x15021000 0x0 0x1000>;
	};

	smi_larb3@1a002000 {
		cell-index = <0x3>;
		clock-names = "mtcmos-cam", "gals-cam2mm", "cam-larb3";
		clocks = <0x26 0x9 0x27 0x19 0x43 0x0>;
		compatible = "mediatek,smi_larb3", "mediatek,smi_larb";
		linux,phandle = <0x24>;
		phandle = <0x24>;
		reg = <0x0 0x1a002000 0x0 0x1000>;
	};

	spi@1100a000 {
		clock-names = "parent-clk", "sel-clk", "spi-clk";
		clocks = <0x1e 0xb 0x1e 0x6b 0x25 0x1b>;
		compatible = "mediatek,mt6765-spi";
		interrupts = <0x0 0x76 0x8>;
		linux,phandle = <0x8c>;
		mediatek,pad-select = <0x0>;
		phandle = <0x8c>;
		reg = <0x0 0x1100a000 0x0 0x1000>;
	};

	spi@11010000 {
		clock-names = "parent-clk", "sel-clk", "spi-clk";
		clocks = <0x1e 0xb 0x1e 0x6b 0x25 0x34>;
		compatible = "mediatek,mt6765-spi";
		interrupts = <0x0 0x7a 0x8>;
		linux,phandle = <0x8d>;
		mediatek,pad-select = <0x0>;
		phandle = <0x8d>;
		reg = <0x0 0x11010000 0x0 0x1000>;
	};

	spi@11012000 {
		clock-names = "parent-clk", "sel-clk", "spi-clk";
		clocks = <0x1e 0xb 0x1e 0x6b 0x25 0x37>;
		compatible = "mediatek,mt6765-spi";
		interrupts = <0x0 0x80 0x8>;
		linux,phandle = <0x8e>;
		mediatek,pad-select = <0x0>;
		phandle = <0x8e>;
		reg = <0x0 0x11012000 0x0 0x1000>;
	};

	spi@11013000 {
		clock-names = "parent-clk", "sel-clk", "spi-clk";
		clocks = <0x1e 0xb 0x1e 0x6b 0x25 0x38>;
		compatible = "mediatek,mt6765-spi";
		interrupts = <0x0 0x81 0x8>;
		linux,phandle = <0x8f>;
		mediatek,pad-select = <0x0 0x1>;
		phandle = <0x8f>;
		reg = <0x0 0x11013000 0x0 0x1000>;
	};

	spi@11014000 {
		clock-names = "parent-clk", "sel-clk", "spi-clk";
		clocks = <0x1e 0xb 0x1e 0x6b 0x25 0x41>;
		compatible = "mediatek,mt6765-spi";
		interrupts = <0x0 0x5f 0x8>;
		linux,phandle = <0x90>;
		mediatek,pad-select = <0x0>;
		phandle = <0x90>;
		reg = <0x0 0x11014000 0x0 0x1000>;
	};

	spi@11015000 {
		clock-names = "parent-clk", "sel-clk", "spi-clk";
		clocks = <0x1e 0xb 0x1e 0x6b 0x25 0x42>;
		compatible = "mediatek,mt6765-spi";
		interrupts = <0x0 0x60 0x8>;
		linux,phandle = <0x91>;
		mediatek,pad-select = <0x0>;
		phandle = <0x91>;
		reg = <0x0 0x11015000 0x0 0x1000>;
	};

	sramrom@10214000 {
		compatible = "mediatek,sramrom";
		reg = <0x0 0x10214000 0x0 0x1000>;
	};

	sspm@10440000 {
		compatible = "mediatek,sspm";
		interrupt-names = "ipc", "mbox0", "mbox1", "mbox2", "mbox3", "mbox4";
		interrupts = <0x0 0xca 0x4 0x0 0xcd 0x4 0x0 0xce 0x4 0x0 0xcf 0x4 0x0 0xd0 0x4 0x0 0xd1 0x4>;
		reg = <0x0 0x10440000 0x0 0x10000 0x0 0x10450000 0x0 0x100 0x0 0x10451000 0x0 0x8 0x0 0x10460000 0x0 0x100 0x0 0x10461000 0x0 0x8 0x0 0x10470000 0x0 0x100 0x0 0x10471000 0x0 0x8 0x0 0x10480000 0x0 0x100 0x0 0x10481000 0x0 0x8 0x0 0x10490000 0x0 0x100 0x0 0x10491000 0x0 0x8>;
		reg-names = "cfgreg", "mbox0_base", "mbox0_ctrl", "mbox1_base", "mbox1_ctrl", "mbox2_base", "mbox2_ctrl", "mbox3_base", "mbox3_ctrl", "mbox4_base", "mbox4_ctrl";
	};

	swtp {
		compatible = "mediatek, swtp-eint";
		linux,phandle = <0x9c>;
		phandle = <0x9c>;
	};

	swtp1 {
		compatible = "mediatek, swtp1-eint";
		linux,phandle = <0x9d>;
		phandle = <0x9d>;
	};

	sys_cirq@10204000 {
		compatible = "mediatek,sys_cirq";
		interrupts = <0x0 0x118 0x8>;
		mediatek,cirq_num = <0xd1>;
		mediatek,spi_start_offset = <0x48>;
		reg = <0x0 0x10204000 0x0 0x1000>;
	};

	sys_timer@10017000 {
		compatible = "mediatek,sys_timer";
		interrupts = <0x0 0xc2 0x4>;
		reg = <0x0 0x10017000 0x0 0x1000>;
		reg-names = "sys_timer_base";
	};

	syscfg_pctl_0@10005000 {
		compatible = "mediatek,mt6765-pctl-0-syscfg", "syscon";
		linux,phandle = <0x12>;
		phandle = <0x12>;
		reg = <0x0 0x10005000 0x0 0x1000>;
	};

	syscfg_pctl_1@0x10002000 {
		compatible = "mediatek,mt6765-pctl-1-syscfg", "syscon";
		linux,phandle = <0x13>;
		phandle = <0x13>;
		reg = <0x0 0x10002000 0x0 0x1000>;
	};

	syscfg_pctl_2@0x10002200 {
		compatible = "mediatek,mt6765-pctl-2-syscfg", "syscon";
		linux,phandle = <0x14>;
		phandle = <0x14>;
		reg = <0x0 0x10002200 0x0 0x1000>;
	};

	syscfg_pctl_3@0x10002400 {
		compatible = "mediatek,mt6765-pctl-3-syscfg", "syscon";
		linux,phandle = <0x15>;
		phandle = <0x15>;
		reg = <0x0 0x10002400 0x0 0x1000>;
	};

	syscfg_pctl_4@0x10002600 {
		compatible = "mediatek,mt6765-pctl-4-syscfg", "syscon";
		linux,phandle = <0x16>;
		phandle = <0x16>;
		reg = <0x0 0x10002600 0x0 0x1000>;
	};

	syscfg_pctl_5@0x10002800 {
		compatible = "mediatek,mt6765-pctl-5-syscfg", "syscon";
		linux,phandle = <0x17>;
		phandle = <0x17>;
		reg = <0x0 0x10002800 0x0 0x1000>;
	};

	syscfg_pctl_6@0x10002a00 {
		compatible = "mediatek,mt6765-pctl-6-syscfg", "syscon";
		linux,phandle = <0x18>;
		phandle = <0x18>;
		reg = <0x0 0x10002a00 0x0 0x1000>;
	};

	syscfg_pctl_7@0x10002c00 {
		compatible = "mediatek,mt6765-pctl-7-syscfg", "syscon";
		linux,phandle = <0x19>;
		phandle = <0x19>;
		reg = <0x0 0x10002c00 0x0 0x1000>;
	};

	therm_ctrl@1100b000 {
		clock-names = "therm-main";
		clocks = <0x25 0xa>;
		compatible = "mediatek,therm_ctrl";
		interrupts = <0x0 0x4e 0x8>;
		reg = <0x0 0x1100b000 0x0 0x1000>;
	};

	timer {
		clock-frequency = <0xc65d40>;
		compatible = "arm,armv8-timer";
		interrupt-parent = <0x11>;
		interrupts = <0x1 0xd 0x8 0x1 0xe 0x8 0x1 0xb 0x8 0x1 0xa 0x8>;
	};

	tkcore {
		compatible = "trustkernel,tkcore";
		interrupts = <0x0 0xf8 0x1>;
	};

	topckgen@10000000 {
		#clock-cells = <0x1>;
		compatible = "mediatek,topckgen", "syscon";
		linux,phandle = <0x1e>;
		phandle = <0x1e>;
		reg = <0x0 0x10000000 0x0 0x1000>;
	};

	topckgen_ao@1001b000 {
		compatible = "mediatek,topckgen_ao";
		reg = <0x0 0x1001b000 0x0 0x1000>;
	};

	topmisc@10011000 {
		compatible = "mediatek,topmisc";
		reg = <0x0 0x10011000 0x0 0x1000>;
	};

	toprgu@10007000 {
		compatible = "mediatek,mt6765-toprgu";
		interrupts = <0x0 0x8b 0x0>;
		reg = <0x0 0x10007000 0x0 0x1000>;
	};

	touch {
		compatible = "mediatek,touch";
		linux,phandle = <0x76>;
		phandle = <0x76>;
	};

	trng@1020f000 {
		compatible = "mediatek,trng";
		interrupts = <0x0 0xa1 0x8>;
		reg = <0x0 0x1020f000 0x0 0x1000>;
	};

	type_c_port0 {
		linux,phandle = <0xb8>;
		mt-tcpc,name = "type_c_port0";
		mt-tcpc,role_def = <0x4>;
		mt-tcpc,rp_level = <0x0>;
		mt-tcpc,vconn_supply = <0x0>;
		mt6370pd,intr_gpio = <0x20 0x18 0x0>;
		mt6370pd,intr_gpio_num = <0x18>;
		phandle = <0xb8>;
		tcpc-dual,supported_modes = <0x0>;

		dpm_caps {
			attemp_discover_cable;
			attemp_discover_id;
			dr_check = <0x0>;
			local_dr_data;
			local_dr_power;
			local_no_suspend;
			local_usb_comm;
			pr_check = <0x0>;
			pr_check_gp_source;
		};

		pd-data {
			bat,nr = <0x1>;
			pd,charging_policy = <0x21>;
			pd,country_nr = <0x0>;
			pd,id-vdo-data = <0xd10029cf 0x0 0x10000>;
			pd,id-vdo-size = <0x3>;
			pd,mfrs = "RichtekTCPC";
			pd,pid = <0x5081>;
			pd,sink-pdo-data = <0x190c8 0xc0761e3c>;
			pd,sink-pdo-size = <0x2>;
			pd,source-cap-ext = <0x171129cf 0x0 0x102 0x0 0x0 0x2000000>;
			pd,source-pdo-data = <0x19032>;
			pd,source-pdo-size = <0x1>;
			pd,vid = <0x29cf>;

			bat-info0 {
				bat,design_cap = <0xbb8>;
				bat,mfrs = "bat1";
				bat,pid = <0x5081>;
				bat,vid = <0x29cf>;
			};
		};
	};

	usb0@11200000 {
		clock-names = "usb0", "usb0_clk_top_sel", "usb0_clk_univpll3_d4";
		clocks = <0x25 0x8 0x1e 0x76 0x1e 0x20>;
		compatible = "mediatek,mt6765-usb20";
		interrupts = <0x0 0x49 0x8>;
		mode = <0x2>;
		multipoint = <0x1>;
		num_eps = <0x10>;
		reg = <0x0 0x11200000 0x0 0x10000 0x0 0x11cc0000 0x0 0x10000>;
	};

	usb1p_sif@11210000 {
		compatible = "mediatek,usb1p_sif";
		reg = <0x0 0x11210000 0x0 0x10000>;
	};

	usb_sif@11210000 {
		compatible = "mediatek,usb_sif";
		reg = <0x0 0x11210000 0x0 0x10000>;
	};

	utos {
		compatible = "microtrust,utos";
		interrupts = <0x0 0xf9 0x1 0x0 0xfa 0x1>;
	};

	utos_tester {
		compatible = "microtrust,tester-v1";
	};

	vdec@17040000 {
		compatible = "mediatek,vdec";
		interrupts = <0x0 0xe9 0x8>;
		reg = <0x0 0x17040000 0x0 0x10000>;
	};

	venc@17020000 {
		compatible = "mediatek,venc";
		interrupts = <0x0 0xe6 0x8>;
		reg = <0x0 0x17020000 0x0 0x10000>;
	};

	venc_gcon@17000000 {
		#clock-cells = <0x1>;
		clock-names = "MT_SCP_SYS_DIS", "MT_SCP_SYS_VCODEC", "MT_CG_MM_SMI_COMM0", "MT_CG_MM_SMI_COMM1", "MT_CG_MM_SMI_COMMON", "MT_CG_VDEC", "MT_CG_VENC";
		clocks = <0x26 0x3 0x26 0xa 0x27 0x15 0x27 0x16 0x27 0x13 0x44 0x3 0x44 0x1>;
		compatible = "mediatek,venc_gcon", "syscon";
		linux,phandle = <0x44>;
		phandle = <0x44>;
		reg = <0x0 0x17000000 0x0 0x10000>;
	};

	venc_jpg@17030000 {
		clock-names = "MT_CG_VENC_JPGENC";
		clocks = <0x44 0x2>;
		compatible = "mediatek,venc_jpg";
		interrupts = <0x0 0xe8 0x8>;
		reg = <0x0 0x17030000 0x0 0x10000>;
	};

	wifi@18000000 {
		compatible = "mediatek,wifi";
		interrupts = <0x0 0x10c 0x8>;
		reg = <0x0 0x18000000 0x0 0x100000>;
	};
};
